;Trace32 Script to read memory addresses and save address-value pairs to csv file

;The following are taken as parameters to the .cmm file at the time of execution

;pll_addr_file_path -> path of csv file containing pll addresses
;values_dir -> path of directory to which to save the csv file containing address-value pairs
;pll_values_file_name -> intended file name to contain address-value pairs of pll

LOCAL &pll_addr_file_path &values_dir &pll_values_file_name
PARAMETERS &pll_addr_file_path &values_dir &pll_values_file_name

OPEN #1 "&pll_addr_file_path" /Read

IF (OS.DIR("&values_dir"))
(
  ;if values_dir already exists, go to output creation step
  GOTO output
)
ELSE
(
  ;if values_dir does not exist, create directory
  OS.Command mkdir -p &values_dir
)

output:
&pll_values_file_path="&values_dir"+"/"+"&pll_values_file_name"

OPEN #2 "&pll_values_file_path" /Create


PRIVATE &address
;read addresses from the file, get values at these addresses and append to output file

WHILE TRUE()
(
  READ #1 %LINE &address
  IF EOF()
  (
    ;if end of file reached, exit loop
    GOTO loop_end
  )

  PRIVATE &value
  &value=Data.Long(D:&address)
  IF ERROR.POSITION()==1
    &value=-1
  WRITE #2 "&address," %Decimal &value
)
loop_end:PRINT "File &pll_addr_file_path Read"

;close all files
CLOSE #1
CLOSE #2