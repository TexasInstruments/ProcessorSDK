/**
 * @cliArgs --device "AM64x_beta" --package "ALV" --part "Default"
 * @versions {"data":"20201908","timestamp":"2020113022","tool":"1.6.0+1543","templates":"20190604"}
 */

/**
 * These are the peripherals and settings in this configuration
 */
const iADC1                            = scripting.addPeripheral("ADC");
iADC1.$name                            = "MyADC1";
iADC1.$assign                          = "ADC0";
iADC1.AIN0.$assign                     = "ADC0_AIN0";
iADC1.AIN0.$used                       = true;
iADC1.AIN1.$assign                     = "ADC0_AIN1";
iADC1.AIN1.$used                       = true;
iADC1.AIN2.$assign                     = "ADC0_AIN2";
iADC1.AIN2.$used                       = true;
iADC1.AIN3.$assign                     = "ADC0_AIN3";
iADC1.AIN3.$used                       = true;
iADC1.AIN4.$assign                     = "ADC0_AIN4";
iADC1.AIN4.$used                       = true;
iADC1.AIN5.$assign                     = "ADC0_AIN5";
iADC1.AIN5.$used                       = true;
iADC1.AIN6.$assign                     = "ADC0_AIN6";
iADC1.AIN6.$used                       = true;
iADC1.AIN7.$assign                     = "ADC0_AIN7";
iADC1.AIN7.$used                       = true;
const iDDRSS1                          = scripting.addPeripheral("DDRSS");
iDDRSS1.$name                          = "MyDDRSS1";
iDDRSS1.$assign                        = "DDR0";
const iFSI_RX1                         = scripting.addPeripheral("FSI_RX");
iFSI_RX1.$name                         = "MyFSI_RX1";
iFSI_RX1.$assign                       = "FSI_RX0";
iFSI_RX1.CLK.$assign                   = "GPMC0_AD8";
iFSI_RX1.D0.$assign                    = "GPMC0_AD9";
iFSI_RX1.D1.$assign                    = "GPMC0_AD10";
const iFSI_TX1                         = scripting.addPeripheral("FSI_TX");
iFSI_TX1.$name                         = "MyFSI_TX1";
iFSI_TX1.CLK.$assign                   = "GPMC0_BE1n";
iFSI_TX1.D0.$assign                    = "GPMC0_AD14";
iFSI_TX1.D1.$assign                    = "GPMC0_AD15";
const iGPIO1                           = scripting.addPeripheral("GPIO");
iGPIO1["1"].$assign                    = "OSPI0_LBCLKO";
iGPIO1["12"].$assign                   = "OSPI0_CSn1";
iGPIO1["12"].$used                     = true;
iGPIO1["13"].$assign                   = "OSPI0_CSn2";
iGPIO1["13"].$used                     = true;
iGPIO1["14"].$assign                   = "OSPI0_CSn3";
iGPIO1["14"].$used                     = true;
iGPIO1["52"].$assign                   = "U13";
iGPIO1["52"].$used                     = true;
iGPIO1["62"].$assign                   = "U7";
iGPIO1["62"].$used                     = true;
iGPIO1.$name                           = "MyGPIO1";
iGPIO1.$assign                         = "GPIO0";
const iGPIO2                           = scripting.addPeripheral("GPIO");
iGPIO2["43"].$used                     = true;
iGPIO2["70"].$assign                   = "EXTINTn";
iGPIO2["70"].$used                     = true;
iGPIO2["78"].$assign                   = "MMC1_SDWP";
iGPIO2["78"].$used                     = true;
iGPIO2.$name                           = "MyGPIO2";
iGPIO2.$assign                         = "GPIO1";
const iI2C1                            = scripting.addPeripheral("I2C");
iI2C1.$name                            = "MyI2C1";
iI2C1.$assign                          = "I2C0";
iI2C1.SCL.$assign                      = "I2C0_SCL";
iI2C1.SDA.$assign                      = "I2C0_SDA";
const iI2C2                            = scripting.addPeripheral("I2C");
iI2C2.$name                            = "MyI2C2";
iI2C2.$assign                          = "I2C1";
iI2C2.SCL.$assign                      = "I2C1_SCL";
iI2C2.SDA.$assign                      = "I2C1_SDA";
const iMCAN1                           = scripting.addPeripheral("MCAN");
iMCAN1.$name                           = "MyMCAN1";
iMCAN1.$assign                         = "MCAN0";
iMCAN1.RX.$assign                      = "MCAN0_RX";
iMCAN1.TX.$assign                      = "MCAN0_TX";
const iMCAN2                           = scripting.addPeripheral("MCAN");
iMCAN2.$name                           = "MyMCAN2";
iMCAN2.$assign                         = "MCAN1";
iMCAN2.RX.$assign                      = "MCAN1_RX";
iMCAN2.TX.$assign                      = "MCAN1_TX";
const iMCU_GPIO1                       = scripting.addPeripheral("MCU_GPIO");
iMCU_GPIO1["0"].$used                  = false;
iMCU_GPIO1["1"].$assign                = "MCU_UART0_CTSn";
iMCU_GPIO1["1"].$used                  = false;
iMCU_GPIO1["2"].$used                  = false;
iMCU_GPIO1["3"].$used                  = false;
iMCU_GPIO1["4"].$used                  = false;
iMCU_GPIO1["5"].$assign                = "A7";
iMCU_GPIO1["6"].$assign                = "B7";
iMCU_GPIO1["7"].$assign                = "D7";
iMCU_GPIO1["8"].$used                  = false;
iMCU_GPIO1["9"].$used                  = false;
iMCU_GPIO1["10"].$used                 = false;
iMCU_GPIO1["11"].$used                 = false;
iMCU_GPIO1["12"].$used                 = false;
iMCU_GPIO1["13"].$used                 = false;
iMCU_GPIO1["14"].$used                 = false;
iMCU_GPIO1["15"].$used                 = false;
iMCU_GPIO1["16"].$used                 = false;
iMCU_GPIO1["17"].$used                 = false;
iMCU_GPIO1["20"].$used                 = false;
iMCU_GPIO1["21"].$used                 = false;
iMCU_GPIO1["22"].$used                 = false;
iMCU_GPIO1.$name                       = "MyMCU_GPIO1";
iMCU_GPIO1.$assign                     = "MCU_GPIO0";
const iMCU_I2C1                        = scripting.addPeripheral("MCU_I2C");
iMCU_I2C1.$name                        = "MyMCU_I2C1";
iMCU_I2C1.$assign                      = "MCU_I2C0";
iMCU_I2C1.SCL.pu_pd                    = "pu";
iMCU_I2C1.SCL.$assign                  = "MCU_I2C0_SCL";
iMCU_I2C1.SDA.pu_pd                    = "pu";
iMCU_I2C1.SDA.$assign                  = "MCU_I2C0_SDA";
const iMCU_I2C2                        = scripting.addPeripheral("MCU_I2C");
iMCU_I2C2.$name                        = "MyMCU_I2C2";
iMCU_I2C2.$assign                      = "MCU_I2C1";
iMCU_I2C2.SCL.pu_pd                    = "pu";
iMCU_I2C2.SCL.$assign                  = "MCU_I2C1_SCL";
iMCU_I2C2.SDA.pu_pd                    = "pu";
iMCU_I2C2.SDA.$assign                  = "MCU_I2C1_SDA";
const iMCU_SPI1                        = scripting.addPeripheral("MCU_SPI");
iMCU_SPI1.$name                        = "MyMCU_SPI1";
iMCU_SPI1.CLK.$assign                  = "MCU_SPI0_CLK";
iMCU_SPI1.CS0.$assign                  = "MCU_SPI0_CS0";
iMCU_SPI1.CS1.$assign                  = "MCU_SPI0_CS1";
iMCU_SPI1.D0.$assign                   = "MCU_SPI0_D0";
iMCU_SPI1.D1.$assign                   = "MCU_SPI0_D1";
const iMCU_SYSTEM1                     = scripting.addPeripheral("MCU_SYSTEM");
iMCU_SYSTEM1.$name                     = "MyMCU_SYSTEM1";
iMCU_SYSTEM1.MCU_PORz.$assign          = "MCU_PORz";
iMCU_SYSTEM1.MCU_RESETSTATz.$assign    = "MCU_RESETSTATz";
iMCU_SYSTEM1.MCU_RESETz.$assign        = "MCU_RESETz";
iMCU_SYSTEM1.MCU_SAFETY_ERRORn.$assign = "MCU_SAFETY_ERRORn";
const iMCU_UART1                       = scripting.addPeripheral("MCU_UART");
iMCU_UART1.$name                       = "MyMCU_UART1";
iMCU_UART1.$assign                     = "MCU_USART0";
iMCU_UART1.CTSn.$assign                = "MCU_UART0_CTSn";
iMCU_UART1.RTSn.$assign                = "MCU_UART0_RTSn";
iMCU_UART1.RXD.$assign                 = "MCU_UART0_RXD";
iMCU_UART1.TXD.$assign                 = "MCU_UART0_TXD";
const iMCU_UART2                       = scripting.addPeripheral("MCU_UART");
iMCU_UART2.$name                       = "MyMCU_UART2";
iMCU_UART2.$assign                     = "MCU_USART1";
iMCU_UART2.CTSn.$assign                = "MCU_UART1_CTSn";
iMCU_UART2.RTSn.$assign                = "MCU_UART1_RTSn";
iMCU_UART2.RXD.$assign                 = "MCU_UART1_RXD";
iMCU_UART2.TXD.$assign                 = "MCU_UART1_TXD";
const iMDIO1                           = scripting.addPeripheral("MDIO");
iMDIO1.$name                           = "MyMDIO1";
iMDIO1.$assign                         = "MDIO0";
iMDIO1.MDC.$assign                     = "PRG0_PRU1_GPO19";
iMDIO1.MDIO.$assign                    = "PRG0_PRU1_GPO18";
const iMMC01                           = scripting.addPeripheral("MMC0");
iMMC01.$name                           = "MyMMC01";
iMMC01.$assign                         = "MMC0";
iMMC01.CMD.$assign                     = "MMC0_CMD";
iMMC01.CLK.$assign                     = "MMC0_CLK";
iMMC01.DS.$assign                      = "MMC0_DS";
iMMC01.DAT0.$assign                    = "MMC0_DAT0";
iMMC01.DAT1.$assign                    = "MMC0_DAT1";
iMMC01.DAT2.$assign                    = "MMC0_DAT2";
iMMC01.DAT3.$assign                    = "MMC0_DAT3";
iMMC01.DAT4.$assign                    = "MMC0_DAT4";
iMMC01.DAT5.$assign                    = "MMC0_DAT5";
iMMC01.DAT6.$assign                    = "MMC0_DAT6";
iMMC01.DAT7.$assign                    = "MMC0_DAT7";
const iMMC11                           = scripting.addPeripheral("MMC1");
iMMC11.$name                           = "MyMMC11";
iMMC11.$assign                         = "MMC1";
iMMC11.CMD.pu_pd                       = "pu";
iMMC11.CMD.$assign                     = "MMC1_CMD";
iMMC11.CLKLB.pu_pd                     = "pu";
iMMC11.CLKLB.rx                        = true;
iMMC11.CLKLB.$assign                   = "MMC1_CLKLB";
iMMC11.CLK.pu_pd                       = "pu";
iMMC11.CLK.$assign                     = "MMC1_CLK";
iMMC11.DAT0.pu_pd                      = "pu";
iMMC11.DAT0.$assign                    = "MMC1_DAT0";
iMMC11.DAT1.pu_pd                      = "pu";
iMMC11.DAT1.$assign                    = "MMC1_DAT1";
iMMC11.DAT2.pu_pd                      = "pu";
iMMC11.DAT2.$assign                    = "MMC1_DAT2";
iMMC11.DAT3.pu_pd                      = "pu";
iMMC11.DAT3.$assign                    = "MMC1_DAT3";
iMMC11.SDCD.pu_pd                      = "pu";
iMMC11.SDCD.$assign                    = "MMC1_SDCD";
iMMC11.SDWP.pu_pd                      = "pu";
iMMC11.SDWP.$assign                    = "MMC1_SDWP";
iMMC11.SDWP.$used                      = false;
const iOSPI1                           = scripting.addPeripheral("OSPI");
iOSPI1.$name                           = "MyOSPI1";
iOSPI1.$assign                         = "OSPI0";
iOSPI1.CLK.$assign                     = "OSPI0_CLK";
iOSPI1.CSn0.$assign                    = "OSPI0_CSn0";
iOSPI1.CSn1.$used                      = false;
iOSPI1.CSn2.$used                      = false;
iOSPI1.CSn3.$used                      = false;
iOSPI1.D0.$assign                      = "OSPI0_D0";
iOSPI1.D1.$assign                      = "OSPI0_D1";
iOSPI1.D2.$assign                      = "OSPI0_D2";
iOSPI1.D3.$assign                      = "OSPI0_D3";
iOSPI1.D4.$assign                      = "OSPI0_D4";
iOSPI1.D5.$assign                      = "OSPI0_D5";
iOSPI1.D6.$assign                      = "OSPI0_D6";
iOSPI1.D7.$assign                      = "OSPI0_D7";
iOSPI1.DQS.$assign                     = "OSPI0_DQS";
iOSPI1.LBCLKO.$assign                  = "OSPI0_LBCLKO";
const iPRU_ICSSG0_MDIO1                = scripting.addPeripheral("PRU_ICSSG0_MDIO");
iPRU_ICSSG0_MDIO1.$name                = "MyPRU_ICSSG0_MDIO1";
iPRU_ICSSG0_MDIO1.$assign              = "PRU_ICSSG0_MDIO0";
iPRU_ICSSG0_MDIO1.MDC.$assign          = "PRG0_MDIO0_MDC";
iPRU_ICSSG0_MDIO1.MDIO.$assign         = "PRG0_MDIO0_MDIO";
const iPRU_ICSSG0_PRU1                 = scripting.addPeripheral("PRU_ICSSG0_PRU");
iPRU_ICSSG0_PRU1.$name                 = "MyPRU_ICSSG0_PRU1";
iPRU_ICSSG0_PRU1.$assign               = "PRU_ICSSG0_PRU0";
iPRU_ICSSG0_PRU1.GPI0.$used            = false;
iPRU_ICSSG0_PRU1.GPI1.$used            = false;
iPRU_ICSSG0_PRU1.GPI10.$used           = false;
iPRU_ICSSG0_PRU1.GPI11.$used           = false;
iPRU_ICSSG0_PRU1.GPI12.$used           = false;
iPRU_ICSSG0_PRU1.GPI13.$used           = false;
iPRU_ICSSG0_PRU1.GPI14.$used           = false;
iPRU_ICSSG0_PRU1.GPI15.$used           = false;
iPRU_ICSSG0_PRU1.GPI16.$used           = false;
iPRU_ICSSG0_PRU1.GPI17.$used           = false;
iPRU_ICSSG0_PRU1.GPI18.$used           = false;
iPRU_ICSSG0_PRU1.GPI19.$used           = false;
iPRU_ICSSG0_PRU1.GPI2.$used            = false;
iPRU_ICSSG0_PRU1.GPI3.$used            = false;
iPRU_ICSSG0_PRU1.GPI4.$used            = false;
iPRU_ICSSG0_PRU1.GPI5.$used            = false;
iPRU_ICSSG0_PRU1.GPI6.$used            = false;
iPRU_ICSSG0_PRU1.GPI7.$used            = false;
iPRU_ICSSG0_PRU1.GPI8.$used            = false;
iPRU_ICSSG0_PRU1.GPI9.$used            = false;
iPRU_ICSSG0_PRU1.GPO0.$used            = false;
iPRU_ICSSG0_PRU1.GPO1.$used            = false;
iPRU_ICSSG0_PRU1.GPO10.$used           = false;
iPRU_ICSSG0_PRU1.GPO11.$used           = false;
iPRU_ICSSG0_PRU1.GPO12.$used           = false;
iPRU_ICSSG0_PRU1.GPO13.$used           = false;
iPRU_ICSSG0_PRU1.GPO14.$used           = false;
iPRU_ICSSG0_PRU1.GPO15.$used           = false;
iPRU_ICSSG0_PRU1.GPO16.$used           = false;
iPRU_ICSSG0_PRU1.GPO17.$used           = false;
iPRU_ICSSG0_PRU1.GPO18.$used           = false;
iPRU_ICSSG0_PRU1.GPO19.$used           = false;
iPRU_ICSSG0_PRU1.GPO2.$used            = false;
iPRU_ICSSG0_PRU1.GPO3.$used            = false;
iPRU_ICSSG0_PRU1.GPO4.$used            = false;
iPRU_ICSSG0_PRU1.GPO5.$used            = false;
iPRU_ICSSG0_PRU1.GPO6.$used            = false;
iPRU_ICSSG0_PRU1.GPO7.$used            = false;
iPRU_ICSSG0_PRU1.GPO8.$assign          = "PRG0_PRU0_GPO8";
iPRU_ICSSG0_PRU1.GPO9.$used            = false;
const iPRU_ICSSG0_PRU2                 = scripting.addPeripheral("PRU_ICSSG0_PRU");
iPRU_ICSSG0_PRU2.$name                 = "MyPRU_ICSSG0_PRU2";
iPRU_ICSSG0_PRU2.$assign               = "PRU_ICSSG0_PRU1";
iPRU_ICSSG0_PRU2.GPI0.$used            = false;
iPRU_ICSSG0_PRU2.GPI1.$used            = false;
iPRU_ICSSG0_PRU2.GPI10.$used           = false;
iPRU_ICSSG0_PRU2.GPI11.$used           = false;
iPRU_ICSSG0_PRU2.GPI12.$used           = false;
iPRU_ICSSG0_PRU2.GPI13.$used           = false;
iPRU_ICSSG0_PRU2.GPI14.$used           = false;
iPRU_ICSSG0_PRU2.GPI15.$used           = false;
iPRU_ICSSG0_PRU2.GPI16.$used           = false;
iPRU_ICSSG0_PRU2.GPI17.$used           = false;
iPRU_ICSSG0_PRU2.GPI18.$used           = false;
iPRU_ICSSG0_PRU2.GPI19.$used           = false;
iPRU_ICSSG0_PRU2.GPI2.$used            = false;
iPRU_ICSSG0_PRU2.GPI3.$used            = false;
iPRU_ICSSG0_PRU2.GPI4.$used            = false;
iPRU_ICSSG0_PRU2.GPI5.$used            = false;
iPRU_ICSSG0_PRU2.GPI6.$used            = false;
iPRU_ICSSG0_PRU2.GPI7.$used            = false;
iPRU_ICSSG0_PRU2.GPI8.$used            = false;
iPRU_ICSSG0_PRU2.GPI9.$used            = false;
iPRU_ICSSG0_PRU2.GPO0.$used            = false;
iPRU_ICSSG0_PRU2.GPO1.$used            = false;
iPRU_ICSSG0_PRU2.GPO10.$used           = false;
iPRU_ICSSG0_PRU2.GPO11.$used           = false;
iPRU_ICSSG0_PRU2.GPO12.$used           = false;
iPRU_ICSSG0_PRU2.GPO13.$used           = false;
iPRU_ICSSG0_PRU2.GPO14.$used           = false;
iPRU_ICSSG0_PRU2.GPO15.$used           = false;
iPRU_ICSSG0_PRU2.GPO16.$used           = false;
iPRU_ICSSG0_PRU2.GPO17.$used           = false;
iPRU_ICSSG0_PRU2.GPO18.$used           = false;
iPRU_ICSSG0_PRU2.GPO19.$used           = false;
iPRU_ICSSG0_PRU2.GPO2.$used            = false;
iPRU_ICSSG0_PRU2.GPO3.$used            = false;
iPRU_ICSSG0_PRU2.GPO4.$used            = false;
iPRU_ICSSG0_PRU2.GPO5.$used            = false;
iPRU_ICSSG0_PRU2.GPO6.$used            = false;
iPRU_ICSSG0_PRU2.GPO7.$used            = false;
iPRU_ICSSG0_PRU2.GPO8.$assign          = "PRG0_PRU1_GPO8";
iPRU_ICSSG0_PRU2.GPO9.$used            = false;
const iPRU_ICSSG1_IEP1                    = scripting.addPeripheral("PRU_ICSSG1_IEP");
iPRU_ICSSG1_IEP1.$name                    = "MyPRU_ICSSG1_IEP1";
iPRU_ICSSG1_IEP1.EDC_LATCH_IN0.$assign    = "V7";
iPRU_ICSSG1_IEP1.EDC_LATCH_IN1.$used      = false;
iPRU_ICSSG1_IEP1.EDC_SYNC_OUT0.$assign    = "W7";
iPRU_ICSSG1_IEP1.EDC_SYNC_OUT1.$used      = false;
iPRU_ICSSG1_IEP1.EDIO_DATA_IN_OUT28.$used = false;
iPRU_ICSSG1_IEP1.EDIO_DATA_IN_OUT29.$used = false;
iPRU_ICSSG1_IEP1.EDIO_DATA_IN_OUT30.$used = false;
iPRU_ICSSG1_IEP1.EDIO_DATA_IN_OUT31.$used = false;
iPRU_ICSSG1_IEP1.EDIO_OUTVALID.$used      = false;
const iPRU_ICSSG1_MDIO1                = scripting.addPeripheral("PRU_ICSSG1_MDIO");
iPRU_ICSSG1_MDIO1.$name                = "MyPRU_ICSSG1_MDIO1";
iPRU_ICSSG1_MDIO1.$assign              = "PRU_ICSSG1_MDIO0";
iPRU_ICSSG1_MDIO1.MDC.$assign          = "PRG1_MDIO0_MDC";
iPRU_ICSSG1_MDIO1.MDIO.$assign         = "PRG1_MDIO0_MDIO";
const iPRU_ICSSG1_RGMII1               = scripting.addPeripheral("PRU_ICSSG1_RGMII");
iPRU_ICSSG1_RGMII1.$name               = "MyPRU_ICSSG1_RGMII1";
iPRU_ICSSG1_RGMII1.$assign             = "PRU_ICSSG1_RGMII1";
iPRU_ICSSG1_RGMII1.RD0.$assign         = "PRG1_PRU0_GPO0";
iPRU_ICSSG1_RGMII1.RD1.$assign         = "PRG1_PRU0_GPO1";
iPRU_ICSSG1_RGMII1.RD2.$assign         = "PRG1_PRU0_GPO2";
iPRU_ICSSG1_RGMII1.RD3.$assign         = "PRG1_PRU0_GPO3";
iPRU_ICSSG1_RGMII1.RXC.$assign         = "PRG1_PRU0_GPO6";
iPRU_ICSSG1_RGMII1.RX_CTL.$assign      = "PRG1_PRU0_GPO4";
iPRU_ICSSG1_RGMII1.TD0.$assign         = "PRG1_PRU0_GPO11";
iPRU_ICSSG1_RGMII1.TD1.$assign         = "PRG1_PRU0_GPO12";
iPRU_ICSSG1_RGMII1.TD2.$assign         = "PRG1_PRU0_GPO13";
iPRU_ICSSG1_RGMII1.TD3.$assign         = "PRG1_PRU0_GPO14";
iPRU_ICSSG1_RGMII1.TXC.$assign         = "PRG1_PRU0_GPO16";
iPRU_ICSSG1_RGMII1.TX_CTL.$assign      = "PRG1_PRU0_GPO15";
const iPRU_ICSSG1_RGMII2               = scripting.addPeripheral("PRU_ICSSG1_RGMII");
iPRU_ICSSG1_RGMII2.$name               = "MyPRU_ICSSG1_RGMII2";
iPRU_ICSSG1_RGMII2.$assign             = "PRU_ICSSG1_RGMII2";
iPRU_ICSSG1_RGMII2.RD0.$assign         = "PRG1_PRU1_GPO0";
iPRU_ICSSG1_RGMII2.RD1.$assign         = "PRG1_PRU1_GPO1";
iPRU_ICSSG1_RGMII2.RD2.$assign         = "PRG1_PRU1_GPO2";
iPRU_ICSSG1_RGMII2.RD3.$assign         = "PRG1_PRU1_GPO3";
iPRU_ICSSG1_RGMII2.RXC.$assign         = "PRG1_PRU1_GPO6";
iPRU_ICSSG1_RGMII2.RX_CTL.$assign      = "PRG1_PRU1_GPO4";
iPRU_ICSSG1_RGMII2.TD0.$assign         = "PRG1_PRU1_GPO11";
iPRU_ICSSG1_RGMII2.TD1.$assign         = "PRG1_PRU1_GPO12";
iPRU_ICSSG1_RGMII2.TD2.$assign         = "PRG1_PRU1_GPO13";
iPRU_ICSSG1_RGMII2.TD3.$assign         = "PRG1_PRU1_GPO14";
iPRU_ICSSG1_RGMII2.TXC.$assign         = "PRG1_PRU1_GPO16";
iPRU_ICSSG1_RGMII2.TX_CTL.$assign      = "PRG1_PRU1_GPO15";
const iRGMII1                          = scripting.addPeripheral("RGMII");
iRGMII1.$name                          = "MyRGMII1";
iRGMII1.$assign                        = "RGMII1";
iRGMII1.RD0.$assign                    = "PRG0_PRU1_GPO7";
iRGMII1.RD1.$assign                    = "PRG0_PRU1_GPO9";
iRGMII1.RD2.$assign                    = "PRG0_PRU1_GPO10";
iRGMII1.RD3.$assign                    = "PRG0_PRU1_GPO17";
iRGMII1.RXC.$assign                    = "PRG0_PRU0_GPO10";
iRGMII1.RX_CTL.$assign                 = "PRG0_PRU0_GPO9";
iRGMII1.TD0.$assign                    = "PRG1_PRU1_GPO7";
iRGMII1.TD1.$assign                    = "PRG1_PRU1_GPO9";
iRGMII1.TD2.$assign                    = "PRG1_PRU1_GPO10";
iRGMII1.TD3.$assign                    = "PRG1_PRU1_GPO17";
iRGMII1.TXC.$assign                    = "PRG1_PRU0_GPO10";
iRGMII1.TX_CTL.$assign                 = "PRG1_PRU0_GPO9";
const iSERDES1                         = scripting.addPeripheral("SERDES");
iSERDES1.$name                         = "MySERDES1";
iSERDES1.REFCLK0N.$assign              = "SERDES0_REFCLK0N";
iSERDES1.REFCLK0P.$assign              = "SERDES0_REFCLK0P";
iSERDES1.RXN0.$assign                  = "SERDES0_RXN0";
iSERDES1.RXP0.$assign                  = "SERDES0_RXP0";
iSERDES1.TXN0.$assign                  = "SERDES0_TXN0";
iSERDES1.TXP0.$assign                  = "SERDES0_TXP0";
const iSPI1                            = scripting.addPeripheral("SPI");
iSPI1.$name                            = "MySPI1";
iSPI1.$assign                          = "SPI0";
iSPI1.CLK.$assign                      = "SPI0_CLK";
iSPI1.CS0.$assign                      = "SPI0_CS0";
iSPI1.CS1.$used                        = false;
iSPI1.CS2.$used                        = false;
iSPI1.CS3.$used                        = false;
iSPI1.D0.$assign                       = "SPI0_D0";
iSPI1.D1.$assign                       = "SPI0_D1";
const iSYSTEM1                         = scripting.addPeripheral("SYSTEM");
iSYSTEM1.$name                         = "MySYSTEM1";
iSYSTEM1.CLKOUT0.$assign               = "EXT_REFCLK1";
iSYSTEM1.EXT_REFCLK1.$assign           = "EXT_REFCLK1";
iSYSTEM1.EXT_REFCLK1.$used             = true;
iSYSTEM1.FCLK_MUX.$used                = true;
iSYSTEM1.RESET_REQz.$used              = false;
iSYSTEM1.SYNC0_OUT.$assign             = "ECAP0_IN_APWM_OUT";
iSYSTEM1.SYNC0_OUT.$used               = true;
const iUART1                           = scripting.addPeripheral("UART");
iUART1.$name                           = "MyUART1";
iUART1.CTSn.$assign                    = "UART0_CTSn";
iUART1.DCDn.$used                      = false;
iUART1.DSRn.$used                      = false;
iUART1.DTRn.$used                      = false;
iUART1.RIn.$used                       = false;
iUART1.RTSn.$assign                    = "UART0_RTSn";
iUART1.RXD.$assign                     = "UART0_RXD";
iUART1.TXD.$assign                     = "UART0_TXD";
const iUART2                           = scripting.addPeripheral("UART");
iUART2.$name                           = "MyUART2";
iUART2.$assign                         = "USART1";
iUART2.CTSn.$used                      = false;
iUART2.DCDn.$used                      = false;
iUART2.DSRn.$used                      = false;
iUART2.DTRn.$used                      = false;
iUART2.RIn.$used                       = false;
iUART2.RTSn.$used                      = false;
iUART2.RXD.$assign                     = "UART1_RXD";
iUART2.TXD.$assign                     = "UART1_TXD";
const iUART3                           = scripting.addPeripheral("UART");
iUART3.$name                           = "MyUART3";
iUART3.$assign                         = "USART3";
iUART3.CTSn.$used                      = false;
iUART3.DCDn.$used                      = false;
iUART3.DSRn.$used                      = false;
iUART3.DTRn.$used                      = false;
iUART3.RIn.$used                       = false;
iUART3.RTSn.$used                      = false;
iUART3.RXD.$assign                     = "UART1_CTSn";
iUART3.TXD.$assign                     = "UART1_RTSn";
const iUSB1                            = scripting.addPeripheral("USB");
iUSB1.$name                            = "MyUSB1";
iUSB1.$assign                          = "USB0";
iUSB1.DM.$assign                       = "USB0_DM";
iUSB1.DP.$assign                       = "USB0_DP";
iUSB1.DRVVBUS.$assign                  = "USB0_DRVVBUS";
iUSB1.ID.$assign                       = "USB0_ID";
iUSB1.VBUS.$assign                     = "USB0_VBUS";

/**
 * Pinmux solution for unlocked pins/peripherals. This ensures that minor changes to the automatic solver in a future
 * version of the tool will not impact the pinmux you originally saw.  These lines can be completely deleted in order to
 * re-solve from scratch.
 */
iDDRSS1.A0.$suggestSolution          = "DDR0_A0";
iDDRSS1.A1.$suggestSolution          = "DDR0_A1";
iDDRSS1.A10.$suggestSolution         = "DDR0_A10";
iDDRSS1.A11.$suggestSolution         = "DDR0_A11";
iDDRSS1.A12.$suggestSolution         = "DDR0_A12";
iDDRSS1.A13.$suggestSolution         = "DDR0_A13";
iDDRSS1.A2.$suggestSolution          = "DDR0_A2";
iDDRSS1.A3.$suggestSolution          = "DDR0_A3";
iDDRSS1.A4.$suggestSolution          = "DDR0_A4";
iDDRSS1.A5.$suggestSolution          = "DDR0_A5";
iDDRSS1.A6.$suggestSolution          = "DDR0_A6";
iDDRSS1.A7.$suggestSolution          = "DDR0_A7";
iDDRSS1.A8.$suggestSolution          = "DDR0_A8";
iDDRSS1.A9.$suggestSolution          = "DDR0_A9";
iDDRSS1.ACT_n.$suggestSolution       = "DDR0_ACT_n";
iDDRSS1.ALERT_n.$suggestSolution     = "DDR0_ALERT_n";
iDDRSS1.BA0.$suggestSolution         = "DDR0_BA0";
iDDRSS1.BA1.$suggestSolution         = "DDR0_BA1";
iDDRSS1.BG0.$suggestSolution         = "DDR0_BG0";
iDDRSS1.BG1.$suggestSolution         = "DDR0_BG1";
iDDRSS1.CAS_n.$suggestSolution       = "DDR0_CAS_n";
iDDRSS1.CK0.$suggestSolution         = "DDR0_CK0";
iDDRSS1.CK0_n.$suggestSolution       = "DDR0_CK0_n";
iDDRSS1.CKE0.$suggestSolution        = "DDR0_CKE0";
iDDRSS1.CKE1.$suggestSolution        = "DDR0_CKE1";
iDDRSS1.CS0_n.$suggestSolution       = "DDR0_CS0_n";
iDDRSS1.CS1_n.$suggestSolution       = "DDR0_CS1_n";
iDDRSS1.DM0.$suggestSolution         = "DDR0_DM0";
iDDRSS1.DM1.$suggestSolution         = "DDR0_DM1";
iDDRSS1.DQ0.$suggestSolution         = "DDR0_DQ0";
iDDRSS1.DQ1.$suggestSolution         = "DDR0_DQ1";
iDDRSS1.DQ10.$suggestSolution        = "DDR0_DQ10";
iDDRSS1.DQ11.$suggestSolution        = "DDR0_DQ11";
iDDRSS1.DQ12.$suggestSolution        = "DDR0_DQ12";
iDDRSS1.DQ13.$suggestSolution        = "DDR0_DQ13";
iDDRSS1.DQ14.$suggestSolution        = "DDR0_DQ14";
iDDRSS1.DQ15.$suggestSolution        = "DDR0_DQ15";
iDDRSS1.DQ2.$suggestSolution         = "DDR0_DQ2";
iDDRSS1.DQ3.$suggestSolution         = "DDR0_DQ3";
iDDRSS1.DQ4.$suggestSolution         = "DDR0_DQ4";
iDDRSS1.DQ5.$suggestSolution         = "DDR0_DQ5";
iDDRSS1.DQ6.$suggestSolution         = "DDR0_DQ6";
iDDRSS1.DQ7.$suggestSolution         = "DDR0_DQ7";
iDDRSS1.DQ8.$suggestSolution         = "DDR0_DQ8";
iDDRSS1.DQ9.$suggestSolution         = "DDR0_DQ9";
iDDRSS1.DQS0.$suggestSolution        = "DDR0_DQS0";
iDDRSS1.DQS0_n.$suggestSolution      = "DDR0_DQS0_n";
iDDRSS1.DQS1.$suggestSolution        = "DDR0_DQS1";
iDDRSS1.DQS1_n.$suggestSolution      = "DDR0_DQS1_n";
iDDRSS1.ODT0.$suggestSolution        = "DDR0_ODT0";
iDDRSS1.ODT1.$suggestSolution        = "DDR0_ODT1";
iDDRSS1.PAR.$suggestSolution         = "DDR0_PAR";
iDDRSS1.RAS_n.$suggestSolution       = "DDR0_RAS_n";
iDDRSS1.RESET0_n.$suggestSolution    = "DDR0_RESET0_n";
iDDRSS1.WE_n.$suggestSolution        = "DDR0_WE_n";
iFSI_TX1.$suggestSolution            = "FSI_TX0";
iGPIO2["43"].$suggestSolution        = "SPI0_CS1";
iMCU_SPI1.$suggestSolution           = "MCU_SPI0";
iMCU_SYSTEM1.$suggestSolution        = "MCU_SYSTEM0";
iPRU_ICSSG1_IEP1.$suggestSolution    = "PRU_ICSSG1_IEP0";
iSERDES1.$suggestSolution            = "SERDES0";
iSYSTEM1.$suggestSolution            = "SYSTEM0";
iSYSTEM1.FCLK_MUX.$suggestSolution   = "GPMC0_CLK";
iSYSTEM1.PORz_OUT.$suggestSolution   = "PORz_OUT";
iSYSTEM1.RESETSTATz.$suggestSolution = "RESETSTATz";
iUART1.$suggestSolution              = "USART0";
