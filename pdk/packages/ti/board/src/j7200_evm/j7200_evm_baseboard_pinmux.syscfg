/**
 * @cliArgs --device "J7200_DRA821_SR1.0_alpha" --package "ALM" --part "Default"
 * @versions {"data":"20201003","timestamp":"2020060911","tool":"1.4.0+1234","templates":"20190604"}
 */

/**
 * Import the modules used in this configuration.
 */
const powerDomains = scripting.addModule("/ti/corePinmux/powerDomains");

/**
 * Write custom configuration values to the imported modules.
 */
powerDomains.CANUART          = "3.3 V";
powerDomains.MMC1             = "3.3 V";
powerDomains.MCU_CPSW2G_RGMII = "3.3 V";
powerDomains.MCU_GENERAL      = "3.3 V";
powerDomains.GENERAL          = "3.3 V";

/**
 * These are the peripherals and settings in this configuration
 */
const iDDRSS1                           = scripting.addPeripheral("DDRSS");
iDDRSS1.$name                           = "MyDDRSS0";
iDDRSS1.$assignVoltage                  = "1.1 V";
iDDRSS1.CKN.$assign                     = "H1";
iDDRSS1.RET.$assign                     = "R5";
iDDRSS1.CKP.$assign                     = "G1";
iDDRSS1.RESETn.$assign                  = "J5";
iDDRSS1.CA0.$assign                     = "G4";
iDDRSS1.CA1.$assign                     = "H3";
iDDRSS1.CA2.$assign                     = "J4";
iDDRSS1.CA3.$assign                     = "K1";
iDDRSS1.CA4.$assign                     = "J2";
iDDRSS1.CA5.$assign                     = "H5";
iDDRSS1.CKE0.$assign                    = "G2";
iDDRSS1.CKE1.$assign                    = "H2";
iDDRSS1.CSn0_0.$assign                  = "G3";
iDDRSS1.CSn0_1.$assign                  = "K2";
iDDRSS1.CSn1_0.$assign                  = "G5";
iDDRSS1.CSn1_1.$assign                  = "J3";
iDDRSS1.DM0.$assign                     = "A3";
iDDRSS1.DM1.$assign                     = "E4";
iDDRSS1.DM2.$assign                     = "N1";
iDDRSS1.DM3.$assign                     = "R4";
iDDRSS1.DQ0.$assign                     = "B4";
iDDRSS1.DQ1.$assign                     = "A4";
iDDRSS1.DQ2.$assign                     = "C4";
iDDRSS1.DQ3.$assign                     = "C1";
iDDRSS1.DQ4.$assign                     = "C3";
iDDRSS1.DQ5.$assign                     = "C2";
iDDRSS1.DQ6.$assign                     = "A2";
iDDRSS1.DQ7.$assign                     = "B3";
iDDRSS1.DQ8.$assign                     = "D1";
iDDRSS1.DQ9.$assign                     = "D2";
iDDRSS1.DQ10.$assign                    = "F2";
iDDRSS1.DQ11.$assign                    = "E3";
iDDRSS1.DQ12.$assign                    = "F3";
iDDRSS1.DQ13.$assign                    = "F4";
iDDRSS1.DQ14.$assign                    = "D4";
iDDRSS1.DQ15.$assign                    = "F5";
iDDRSS1.DQ16.$assign                    = "K4";
iDDRSS1.DQ17.$assign                    = "L4";
iDDRSS1.DQ18.$assign                    = "M4";
iDDRSS1.DQ19.$assign                    = "L3";
iDDRSS1.DQ20.$assign                    = "L2";
iDDRSS1.DQ21.$assign                    = "L1";
iDDRSS1.DQ22.$assign                    = "M3";
iDDRSS1.DQ23.$assign                    = "N2";
iDDRSS1.DQ24.$assign                    = "R3";
iDDRSS1.DQ25.$assign                    = "T1";
iDDRSS1.DQ26.$assign                    = "P1";
iDDRSS1.DQ27.$assign                    = "P2";
iDDRSS1.DQ28.$assign                    = "N4";
iDDRSS1.DQ29.$assign                    = "P3";
iDDRSS1.DQ30.$assign                    = "P4";
iDDRSS1.DQ31.$assign                    = "N5";
iDDRSS1.DQS0N.$assign                   = "B1";
iDDRSS1.DQS0P.$assign                   = "B2";
iDDRSS1.DQS1N.$assign                   = "E1";
iDDRSS1.DQS1P.$assign                   = "E2";
iDDRSS1.DQS2N.$assign                   = "M1";
iDDRSS1.DQS2P.$assign                   = "M2";
iDDRSS1.DQS3N.$assign                   = "R1";
iDDRSS1.DQS3P.$assign                   = "R2";
const iDEBUGSS1                         = scripting.addPeripheral("DEBUGSS");
iDEBUGSS1.$name                         = "MyDEBUGSS1";
iDEBUGSS1.CLK.$used                     = false;
iDEBUGSS1.CTL.$used                     = false;
iDEBUGSS1.TMS.$assign                   = "U4";
iDEBUGSS1.TDI.$assign                   = "F19";
iDEBUGSS1.TDO.$assign                   = "F21";
iDEBUGSS1.DATA0.$used                   = false;
iDEBUGSS1.DATA1.$used                   = false;
iDEBUGSS1.DATA2.$used                   = false;
iDEBUGSS1.DATA3.$used                   = false;
iDEBUGSS1.DATA4.$used                   = false;
iDEBUGSS1.DATA5.$used                   = false;
iDEBUGSS1.DATA6.$used                   = false;
iDEBUGSS1.DATA7.$used                   = false;
iDEBUGSS1.DATA8.$used                   = false;
iDEBUGSS1.DATA9.$used                   = false;
iDEBUGSS1.DATA10.$used                  = false;
iDEBUGSS1.DATA11.$used                  = false;
iDEBUGSS1.DATA12.$used                  = false;
iDEBUGSS1.DATA13.$used                  = false;
iDEBUGSS1.DATA14.$used                  = false;
iDEBUGSS1.DATA15.$used                  = false;
iDEBUGSS1.DATA16.$used                  = false;
iDEBUGSS1.DATA17.$used                  = false;
iDEBUGSS1.DATA18.$used                  = false;
iDEBUGSS1.DATA19.$used                  = false;
iDEBUGSS1.DATA20.$used                  = false;
iDEBUGSS1.DATA21.$used                  = false;
iDEBUGSS1.DATA22.$used                  = false;
iDEBUGSS1.DATA23.$used                  = false;
iDEBUGSS1.EMU0.$assign                  = "A13";
iDEBUGSS1.EMU1.$assign                  = "D12";
iDEBUGSS1.TCK.$assign                   = "B15";
iDEBUGSS1.TRSTn.$assign                 = "B20";
const iGPIO1                            = scripting.addPeripheral("GPIO");
iGPIO1.$name                            = "MyGPIO1";
iGPIO1.$assignVoltage                   = "3.3 V";
iGPIO1["4"].$assign                     = "AA20";
iGPIO1["4"].$used                       = true;
iGPIO1["12"].$assign                    = "V16";
iGPIO1["12"].$used                      = true;
iGPIO1["27"].$assign                    = "T14";
iGPIO1["27"].$used                      = true;
iGPIO1["28"].$assign                    = "U18";
iGPIO1["28"].$used                      = true;
iGPIO1["44"].$assign                    = "U13";
iGPIO1["44"].$used                      = true;
iGPIO1["55"].$assign                    = "T5";
iGPIO1["55"].$used                      = true;
const iI2C1                             = scripting.addPeripheral("I2C");
iI2C1.$name                             = "MyI2C2";
iI2C1.$assign                           = "I2C2";
iI2C1.$assignVoltage                    = "3.3 V";
iI2C1.SCL.$assign                       = "Y1";
iI2C1.SDA.$assign                       = "V4";
const iI2C2                             = scripting.addPeripheral("I2C");
iI2C2.$name                             = "MyI2C0";
iI2C2.$assign                           = "I2C0";
iI2C2.$assignVoltage                    = "3.3 V";
iI2C2.SCL.$assign                       = "V3";
iI2C2.SDA.$assign                       = "W2";
const iI2C3                             = scripting.addPeripheral("I2C");
iI2C3.$name                             = "MyI2C1";
iI2C3.$assign                           = "I2C1";
iI2C3.$assignVoltage                    = "3.3 V";
iI2C3.SCL.$assign                       = "U3";
iI2C3.SDA.$assign                       = "T3";
const iMCAN1                            = scripting.addPeripheral("MCAN");
iMCAN1.$name                            = "MyMCAN0";
iMCAN1.$assign                          = "MCAN0";
iMCAN1.RX.$assign                       = "V20";
iMCAN1.TX.$assign                       = "V18";
const iMCAN2                            = scripting.addPeripheral("MCAN");
iMCAN2.$name                            = "MyMCAN3";
iMCAN2.$assign                          = "MCAN3";
iMCAN2.RX.$assign                       = "W16";
iMCAN2.TX.$assign                       = "Y21";
const iMCAN3                            = scripting.addPeripheral("MCAN");
iMCAN3.$name                            = "MyMCAN4";
iMCAN3.$assign                          = "MCAN4";
iMCAN3.$assignVoltage                   = "3.3 V";
iMCAN3.RX.$assign                       = "Y20";
iMCAN3.TX.$assign                       = "W15";
const iMCAN4                            = scripting.addPeripheral("MCAN");
iMCAN4.$name                            = "MyMCAN5";
iMCAN4.$assign                          = "MCAN5";
iMCAN4.$assignVoltage                   = "3.3 V";
iMCAN4.RX.$assign                       = "V19";
iMCAN4.TX.$assign                       = "V21";
const iMCAN5                            = scripting.addPeripheral("MCAN");
iMCAN5.$name                            = "MyMCAN6";
iMCAN5.$assign                          = "MCAN6";
iMCAN5.$assignVoltage                   = "3.3 V";
iMCAN5.RX.$assign                       = "U14";
iMCAN5.TX.$assign                       = "T13";
const iMCAN6                            = scripting.addPeripheral("MCAN");
iMCAN6.$name                            = "MyMCAN7";
iMCAN6.$assign                          = "MCAN7";
iMCAN6.$assignVoltage                   = "3.3 V";
iMCAN6.RX.$assign                       = "U15";
iMCAN6.TX.$assign                       = "U16";
const iMCAN7                            = scripting.addPeripheral("MCAN");
iMCAN7.$name                            = "MyMCAN10";
iMCAN7.$assign                          = "MCAN10";
iMCAN7.$assignVoltage                   = "3.3 V";
iMCAN7.RX.$assign                       = "U20";
iMCAN7.TX.$assign                       = "U17";
const iMCAN8                            = scripting.addPeripheral("MCAN");
iMCAN8.$name                            = "MyMCAN8";
iMCAN8.$assign                          = "MCAN8";
iMCAN8.RX.$assign                       = "U19";
iMCAN8.TX.$assign                       = "T15";
const iMCU_ADC1                         = scripting.addPeripheral("MCU_ADC");
iMCU_ADC1.$name                         = "MyMCU_ADC0";
iMCU_ADC1.$assignVoltage                = "1.8 V";
iMCU_ADC1.$useCase                      = "ADC_0";
iMCU_ADC1.AIN0.$assign                  = "H17";
iMCU_ADC1.AIN0.$used                    = true;
iMCU_ADC1.AIN1.$assign                  = "K18";
iMCU_ADC1.AIN1.$used                    = true;
iMCU_ADC1.AIN2.$assign                  = "M17";
iMCU_ADC1.AIN2.$used                    = true;
iMCU_ADC1.AIN3.$assign                  = "L18";
iMCU_ADC1.AIN3.$used                    = true;
iMCU_ADC1.AIN4.$assign                  = "J18";
iMCU_ADC1.AIN4.$used                    = true;
iMCU_ADC1.AIN5.$assign                  = "J17";
iMCU_ADC1.AIN5.$used                    = true;
iMCU_ADC1.AIN6.$assign                  = "K17";
iMCU_ADC1.AIN6.$used                    = true;
iMCU_ADC1.AIN7.$assign                  = "L17";
iMCU_ADC1.AIN7.$used                    = true;
const iMCU_FSS0_OSPI1                   = scripting.addPeripheral("MCU_FSS0_OSPI");
iMCU_FSS0_OSPI1.$name                   = "MyMCU_FSS0_OSPI0";
iMCU_FSS0_OSPI1.$assignVoltage          = "1.8 V";
iMCU_FSS0_OSPI1.$useCase                = "MCU_FSS0_OSPI_4";
iMCU_FSS0_OSPI1.CLK.$assign             = "B6";
iMCU_FSS0_OSPI1.CSn0.$assign            = "D6";
iMCU_FSS0_OSPI1.CSn0.$used              = true;
iMCU_FSS0_OSPI1.D0.$assign              = "D8";
iMCU_FSS0_OSPI1.D1.$assign              = "C7";
iMCU_FSS0_OSPI1.D2.$assign              = "C5";
iMCU_FSS0_OSPI1.D3.$assign              = "A5";
iMCU_FSS0_OSPI1.D4.$assign              = "A6";
iMCU_FSS0_OSPI1.D5.$assign              = "B8";
iMCU_FSS0_OSPI1.D6.$assign              = "A8";
iMCU_FSS0_OSPI1.D7.$assign              = "A7";
iMCU_FSS0_OSPI1.DQS.$assign             = "B7";
iMCU_FSS0_OSPI1.LBCLKO.$used            = false;
iMCU_FSS0_OSPI1.ECC_FAIL.$used          = false;
iMCU_FSS0_OSPI1.RESET_OUT0.$used        = false;
iMCU_FSS0_OSPI1.RESET_OUT1.$used        = false;
const iMCU_I2C1                         = scripting.addPeripheral("MCU_I2C");
iMCU_I2C1.$name                         = "MyMCU_I2C0";
iMCU_I2C1.$assign                       = "MCU_I2C0";
iMCU_I2C1.$assignVoltage                = "3.3 V";
iMCU_I2C1.SCL.$assign                   = "G21";
iMCU_I2C1.SDA.$assign                   = "G20";
const iMCU_I3C1                         = scripting.addPeripheral("MCU_I3C");
iMCU_I3C1.$name                         = "MyMCU_I3C0";
iMCU_I3C1.$assignVoltage                = "3.3 V";
iMCU_I3C1.SCL.$assign                   = "C21";
iMCU_I3C1.SDA.$assign                   = "C19";
iMCU_I3C1.SDAPULLEN.$assign             = "C16";
const iMCU_MCAN1                        = scripting.addPeripheral("MCU_MCAN");
iMCU_MCAN1.$name                        = "MyMCU_MCAN0";
iMCU_MCAN1.$assign                      = "MCU_MCAN0";
iMCU_MCAN1.$assignVoltage               = "3.3 V";
iMCU_MCAN1.RX.$assign                   = "A17";
iMCU_MCAN1.TX.$assign                   = "A16";
const iMCU_MCAN2                        = scripting.addPeripheral("MCU_MCAN");
iMCU_MCAN2.$name                        = "MyMCU_MCAN1";
iMCU_MCAN2.$assign                      = "MCU_MCAN1";
iMCU_MCAN2.$assignVoltage               = "3.3 V";
iMCU_MCAN2.RX.$assign                   = "B16";
iMCU_MCAN2.TX.$assign                   = "D13";
const iMCU_MDIO1                        = scripting.addPeripheral("MCU_MDIO");
iMCU_MDIO1.$name                        = "MyMCU_MDIO0";
iMCU_MDIO1.$assignVoltage               = "3.3 V";
iMCU_MDIO1.MDC.$assign                  = "D9";
iMCU_MDIO1.MDIO.$assign                 = "C9";
const iMCU_RGMII1                       = scripting.addPeripheral("MCU_RGMII");
iMCU_RGMII1.$name                       = "MyMCU_RGMII1";
iMCU_RGMII1.$assignVoltage              = "3.3 V";
iMCU_RGMII1.RD0.$assign                 = "A9";
iMCU_RGMII1.RD1.$assign                 = "B9";
iMCU_RGMII1.RD2.$assign                 = "A10";
iMCU_RGMII1.RD3.$assign                 = "C10";
iMCU_RGMII1.RXC.$assign                 = "B10";
iMCU_RGMII1.RX_CTL.$assign              = "A11";
iMCU_RGMII1.TD0.$assign                 = "D10";
iMCU_RGMII1.TD1.$assign                 = "B11";
iMCU_RGMII1.TD2.$assign                 = "B12";
iMCU_RGMII1.TD3.$assign                 = "C12";
iMCU_RGMII1.TXC.$assign                 = "A12";
iMCU_RGMII1.TX_CTL.$assign              = "D11";
const iMCU_UART1                        = scripting.addPeripheral("MCU_UART");
iMCU_UART1.$name                        = "MyMCU_UART0";
iMCU_UART1.$assignVoltage               = "3.3 V";
iMCU_UART1.$useCase                     = "MCU_UART_1";
iMCU_UART1.RXD.$assign                  = "D20";
iMCU_UART1.TXD.$assign                  = "D19";
iMCU_UART1.CTSn.$assign                 = "E20";
iMCU_UART1.RTSn.$assign                 = "E21";
const iMDIO1                            = scripting.addPeripheral("MDIO");
iMDIO1.$name                            = "MyMDIO0";
iMDIO1.$assignVoltage                   = "3.3 V";
iMDIO1.MDC.$assign                      = "W19";
iMDIO1.MDIO.$assign                     = "W14";
const iMMCSD1                           = scripting.addPeripheral("MMCSD");
iMMCSD1.$name                           = "MyMMCSD1";
iMMCSD1.$assign                         = "MMC1";
iMMCSD1.$assignVoltage                  = "3.3 V";
iMMCSD1.$useCase                        = "MMCSD_2";
iMMCSD1.CMD.$assign                     = "M20";
iMMCSD1.CLK.$assign                     = "P21";
iMMCSD1.DAT0.$assign                    = "M19";
iMMCSD1.DAT1.$assign                    = "N21";
iMMCSD1.DAT2.$assign                    = "N20";
iMMCSD1.DAT3.$assign                    = "N19";
iMMCSD1.SDCD.$assign                    = "V1";
iMMCSD1.SDWP.$used                      = false;
const iMMCSD2                           = scripting.addPeripheral("MMCSD");
iMMCSD2.$name                           = "MyMMCSD0";
iMMCSD2.$assign                         = "MMC0";
iMMCSD2.$assignVoltage                  = "1.8 V";
iMMCSD2.$useCase                        = "MMCSD_5";
iMMCSD2.CMD.$assign                     = "R17";
iMMCSD2.CLK.$assign                     = "P18";
iMMCSD2.DS.$assign                      = "P19";
iMMCSD2.DS.$used                        = true;
iMMCSD2.DAT0.$assign                    = "R16";
iMMCSD2.DAT1.$assign                    = "P17";
iMMCSD2.DAT2.$assign                    = "R18";
iMMCSD2.DAT3.$assign                    = "R20";
iMMCSD2.DAT4.$assign                    = "R19";
iMMCSD2.DAT5.$assign                    = "P16";
iMMCSD2.DAT6.$assign                    = "R21";
iMMCSD2.DAT7.$assign                    = "T21";
const iOSC1                             = scripting.addPeripheral("OSC");
iOSC1.$name                             = "MyOSC1";
iOSC1.$assignVoltage                    = "1.8 V";
iOSC1.XO.$assign                        = "J19";
iOSC1.XI.$assign                        = "K19";
const iPCIE1                            = scripting.addPeripheral("PCIE");
iPCIE1.$name                            = "MyPCIE1";
iPCIE1.$assignVoltage                   = "1.8 V";
iPCIE1.$useCase                         = "PCIE_2";
iPCIE1.CLKREQn.$used                    = false;
iPCIE1.TX0_N.$assign                    = "W11";
iPCIE1.TX1_N.$assign                    = "Y10";
iPCIE1.TX0_P.$assign                    = "W12";
iPCIE1.TX1_P.$assign                    = "Y11";
iPCIE1.RX0_N.$assign                    = "AA11";
iPCIE1.RX1_N.$assign                    = "W8";
iPCIE1.RX0_P.$assign                    = "AA12";
iPCIE1.RX1_P.$assign                    = "W9";
const iRGMII1                           = scripting.addPeripheral("RGMII");
iRGMII1.$name                           = "MyRGMII2";
iRGMII1.$assign                         = "RGMII2";
iRGMII1.$assignVoltage                  = "3.3 V";
iRGMII1.RD0.$assign                     = "Y13";
iRGMII1.RD1.$assign                     = "AA15";
iRGMII1.RD2.$assign                     = "AA14";
iRGMII1.RD3.$assign                     = "AA18";
iRGMII1.RXC.$assign                     = "Y14";
iRGMII1.RX_CTL.$assign                  = "AA16";
iRGMII1.TD0.$assign                     = "W17";
iRGMII1.TD1.$assign                     = "W20";
iRGMII1.TD2.$assign                     = "V14";
iRGMII1.TD3.$assign                     = "V13";
iRGMII1.TXC.$assign                     = "W21";
iRGMII1.TX_CTL.$assign                  = "U12";
const iSERDES1                          = scripting.addPeripheral("SERDES");
iSERDES1.$name                          = "MySERDES0";
iSERDES1.$assignVoltage                 = "1.8 V";
iSERDES1.REFCLK_N.$assign               = "AA8";
iSERDES1.REFCLK_P.$assign               = "AA9";
const iSGMII1                           = scripting.addPeripheral("SGMII");
iSGMII1.$name                           = "MySGMII1";
iSGMII1.$assign                         = "SGMII1";
iSGMII1.$assignVoltage                  = "1.8 V";
iSGMII1.RXN0.$assign                    = "Y7";
iSGMII1.RXP0.$assign                    = "Y8";
iSGMII1.TXN0.$assign                    = "AA5";
iSGMII1.TXP0.$assign                    = "AA6";
const iSYSTEM1                          = scripting.addPeripheral("SYSTEM");
iSYSTEM1.$name                          = "MySYSTEM1";
iSYSTEM1.$assignVoltage                 = "3.3 V";
iSYSTEM1.AUDIO_EXT_REFCLK0.$used        = false;
iSYSTEM1.AUDIO_EXT_REFCLK1.$used        = false;
iSYSTEM1.EXTINTn.$assign                = "U6";
iSYSTEM1.EXT_REFCLK1.$used              = false;
iSYSTEM1.FCLK_MUX.$used                 = false;
iSYSTEM1.OBSCLK0.$used                  = false;
iSYSTEM1.OBSCLK1.$used                  = false;
iSYSTEM1.OBSCLK2.$used                  = false;
iSYSTEM1.RESETSTATz.$assign             = "U2";
iSYSTEM1.SOC_SAFETY_ERRORn.$assign      = "V2";
iSYSTEM1.SYNC0_OUT.$used                = false;
iSYSTEM1.SYNC1_OUT.$used                = false;
iSYSTEM1.SYNC2_OUT.$used                = false;
iSYSTEM1.SYNC3_OUT.$used                = false;
iSYSTEM1.SYSCLKOUT0.$used               = false;
const iUART1                            = scripting.addPeripheral("UART");
iUART1.$name                            = "MyUART5";
iUART1.$assign                          = "USART5";
iUART1.$assignVoltage                   = "3.3 V";
iUART1.$useCase                         = "UART_5";
iUART1.RXD.$assign                      = "Y15";
iUART1.TXD.$assign                      = "AA17";
const iUART2                            = scripting.addPeripheral("UART");
iUART2.$name                            = "MyUART6";
iUART2.$assign                          = "USART6";
iUART2.$assignVoltage                   = "3.3 V";
iUART2.$useCase                         = "UART_5";
iUART2.RXD.$assign                      = "Y16";
iUART2.TXD.$assign                      = "Y17";
const iUART3                            = scripting.addPeripheral("UART");
iUART3.$name                            = "MyUART9";
iUART3.$assign                          = "USART9";
iUART3.$assignVoltage                   = "3.3 V";
iUART3.$useCase                         = "UART_5";
iUART3.RXD.$assign                      = "AA19";
iUART3.TXD.$assign                      = "V17";
const iUART4                            = scripting.addPeripheral("UART");
iUART4.$name                            = "MyUART3";
iUART4.$assign                          = "USART3";
iUART4.$assignVoltage                   = "3.3 V";
iUART4.$useCase                         = "UART_2";
iUART4.RXD.$assign                      = "Y18";
iUART4.TXD.$assign                      = "Y19";
iUART4.CTSn.$assign                     = "T15";
iUART4.CTSn.$used                       = false;
iUART4.RTSn.$assign                     = "U19";
iUART4.RTSn.$used                       = false;
const iUART5                            = scripting.addPeripheral("UART");
iUART5.$name                            = "MyUART7";
iUART5.$assign                          = "USART7";
iUART5.$assignVoltage                   = "3.3 V";
iUART5.$useCase                         = "UART_5";
iUART5.RXD.$assign                      = "U21";
iUART5.TXD.$assign                      = "V15";
const iUART6                            = scripting.addPeripheral("UART");
iUART6.$name                            = "MyUART0";
iUART6.$assign                          = "USART0";
iUART6.$assignVoltage                   = "3.3 V";
iUART6.$useCase                         = "UART_2";
iUART6.RXD.$assign                      = "T16";
iUART6.TXD.$assign                      = "T17";
iUART6.CTSn.$assign                     = "W3";
iUART6.RTSn.$assign                     = "U5";
const iUART7                            = scripting.addPeripheral("UART");
iUART7.$name                            = "MyUART1";
iUART7.$assign                          = "USART1";
iUART7.$assignVoltage                   = "3.3 V";
iUART7.$useCase                         = "UART_5";
iUART7.RXD.$assign                      = "T18";
iUART7.TXD.$assign                      = "T20";
const iUSB1                             = scripting.addPeripheral("USB");
iUSB1.$name                             = "MyUSB0";
iUSB1.DM.$assign                        = "AA3";
iUSB1.DP.$assign                        = "AA2";
iUSB1.DRVVBUS.$assign                   = "T4";
iUSB1.ID.$assign                        = "V6";
iUSB1.VBUS.$assign                      = "Y2";
iUSB1.SSRX2N.$assign                    = "W5";
iUSB1.SSRX2P.$assign                    = "W6";
iUSB1.SSTX2N.$assign                    = "Y4";
iUSB1.SSTX2P.$assign                    = "Y5";
iUSB1.SSRX1N.$used                      = false;
iUSB1.SSRX1P.$used                      = false;
iUSB1.SSTX1N.$used                      = false;
iUSB1.SSTX1P.$used                      = false;
const iWKUP_GPIO1                       = scripting.addPeripheral("WKUP_GPIO");
iWKUP_GPIO1.$name                       = "MyWKUP_GPIO1";
iWKUP_GPIO1["0"].$assign                = "B18";
iWKUP_GPIO1["0"].$used                  = true;
iWKUP_GPIO1["1"].$assign                = "B19";
iWKUP_GPIO1["1"].$used                  = true;
iWKUP_GPIO1["2"].$assign                = "D14";
iWKUP_GPIO1["2"].$used                  = true;
iWKUP_GPIO1["3"].$assign                = "B21";
iWKUP_GPIO1["3"].$used                  = true;
iWKUP_GPIO1["6"].$assign                = "C14";
iWKUP_GPIO1["6"].$used                  = true;
iWKUP_GPIO1["7"].$assign                = "C18";
iWKUP_GPIO1["7"].$used                  = true;
iWKUP_GPIO1["17"].$assign               = "C8";
iWKUP_GPIO1["17"].$used                 = true;
iWKUP_GPIO1["56"].$assign               = "C13";
iWKUP_GPIO1["56"].$used                 = true;
iWKUP_GPIO1["57"].$assign               = "A20";
iWKUP_GPIO1["57"].$used                 = true;
iWKUP_GPIO1["58"].$assign               = "B17";
iWKUP_GPIO1["58"].$used                 = true;
iWKUP_GPIO1["59"].$assign               = "A19";
iWKUP_GPIO1["59"].$used                 = true;
iWKUP_GPIO1["77"].$assign               = "D21";
iWKUP_GPIO1["77"].$used                 = true;
iWKUP_GPIO1["78"].$assign               = "E19";
iWKUP_GPIO1["78"].$used                 = true;
iWKUP_GPIO1["80"].$assign               = "D18";
iWKUP_GPIO1["80"].$used                 = true;
iWKUP_GPIO1["84"].$assign               = "E18";
iWKUP_GPIO1["84"].$used                 = true;
const iWKUP_I2C1                        = scripting.addPeripheral("WKUP_I2C");
iWKUP_I2C1.$name                        = "MyWKUP_I2C0";
iWKUP_I2C1.$assignVoltage               = "3.3 V";
iWKUP_I2C1.SCL.$assign                  = "F20";
iWKUP_I2C1.SDA.$assign                  = "H21";
const iWKUP_OSC1                        = scripting.addPeripheral("WKUP_OSC");
iWKUP_OSC1.$name                        = "MyWKUP_OSC0";
iWKUP_OSC1.$assignVoltage               = "1.8 V";
iWKUP_OSC1.XO.$assign                   = "L21";
iWKUP_OSC1.XI.$assign                   = "K21";
iWKUP_OSC1.LF_CLKIN.$assign             = "C17";
const iWKUP_SYSTEM1                     = scripting.addPeripheral("WKUP_SYSTEM");
iWKUP_SYSTEM1.$name                     = "MyWKUP_SYSTEM1";
iWKUP_SYSTEM1.$assignVoltage            = "3.3 V";
iWKUP_SYSTEM1.MCU_CLKOUT0.$used         = false;
iWKUP_SYSTEM1.MCU_EXT_REFCLK0.$used     = false;
iWKUP_SYSTEM1.MCU_OBSCLK0.$used         = false;
iWKUP_SYSTEM1.MCU_PORz.$assign          = "G19";
iWKUP_SYSTEM1.MCU_RESETSTATz.$assign    = "B13";
iWKUP_SYSTEM1.MCU_RESETz.$assign        = "A18";
iWKUP_SYSTEM1.MCU_SAFETY_ERRORn.$assign = "G18";
iWKUP_SYSTEM1.MCU_SYSCLKOUT0.$used      = false;
iWKUP_SYSTEM1.PMIC_POWER_EN1.$assign    = "C15";
iWKUP_SYSTEM1.PMIC_WAKE0.$assign        = "T19";
iWKUP_SYSTEM1.PMIC_WAKE1.$used          = false;
iWKUP_SYSTEM1.PORz.$assign              = "H20";
iWKUP_SYSTEM1.RESET_REQz.$assign        = "A15";
const iWKUP_UART1                       = scripting.addPeripheral("WKUP_UART");
iWKUP_UART1.$name                       = "MyWKUP_UART0";
iWKUP_UART1.CTSn.$used                  = false;
iWKUP_UART1.RTSn.$used                  = false;
iWKUP_UART1.RXD.$assign                 = "B14";
iWKUP_UART1.TXD.$assign                 = "A14";

/**
 * Pinmux solution for unlocked pins/peripherals. This ensures that minor changes to the automatic solver in a future
 * version of the tool will not impact the pinmux you originally saw.  These lines can be completely deleted in order to
 * re-solve from scratch.
 */
iDDRSS1.$suggestSolution         = "DDR0";
iDEBUGSS1.$suggestSolution       = "DEBUG0";
iGPIO1.$suggestSolution          = "GPIO0";
iMCU_ADC1.$suggestSolution       = "MCU_ADC0";
iMCU_FSS0_OSPI1.$suggestSolution = "MCU_OSPI0";
iMCU_I3C1.$suggestSolution       = "MCU_I3C0";
iMCU_MDIO1.$suggestSolution      = "MCU_MDIO0";
iMCU_RGMII1.$suggestSolution     = "MCU_RGMII1";
iMCU_UART1.$suggestSolution      = "MCU_USART0";
iMDIO1.$suggestSolution          = "MDIO0";
iOSC1.$suggestSolution           = "OSC1";
iPCIE1.$suggestSolution          = "PCIE1";
iSERDES1.$suggestSolution        = "SERDES0";
iSYSTEM1.$suggestSolution        = "SYSTEM0";
iUSB1.$suggestSolution           = "USB0";
iWKUP_GPIO1.$suggestSolution     = "WKUP_GPIO0";
iWKUP_I2C1.$suggestSolution      = "WKUP_I2C0";
iWKUP_OSC1.$suggestSolution      = "WKUP_OSC0";
iWKUP_SYSTEM1.$suggestSolution   = "WKUP_SYSTEM0";
iWKUP_UART1.$suggestSolution     = "WKUP_USART0";
