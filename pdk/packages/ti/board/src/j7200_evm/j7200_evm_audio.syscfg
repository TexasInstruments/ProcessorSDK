/**
 * @cliArgs --device "J7200_DRA821_SR1.0_alpha" --package "ALM" --part "Default"
 * @versions {"data":"20201003","timestamp":"2020060911","tool":"1.4.0+1234","templates":"20190604"}
 */

/**
 * Import the modules used in this configuration.
 */
const powerDomains = scripting.addModule("/ti/corePinmux/powerDomains");

/**
 * Write custom configuration values to the imported modules.
 */
powerDomains.CANUART          = "3.3 V";
powerDomains.MMC1             = "3.3 V";
powerDomains.MCU_CPSW2G_RGMII = "3.3 V";
powerDomains.MCU_GENERAL      = "3.3 V";
powerDomains.GENERAL          = "3.3 V";

/**
 * These are the peripherals and settings in this configuration
 */
const iMCASP1                      = scripting.addPeripheral("MCASP");
iMCASP1.$name                      = "MyMCASP0";
iMCASP1.$assign                    = "MCASP0";
iMCASP1.ACLKR.$assign              = "U17";
iMCASP1.ACLKR.$used                = true;
iMCASP1.ACLKX.$assign              = "W15";
iMCASP1.AFSX.$assign               = "Y16";
iMCASP1.$pinGroup.AXR0.$assign     = "W16";
iMCASP1.$pinGroup.AXR1.$assign     = "Y21";
iMCASP1.$pinGroup.AXR10.$used      = false;
iMCASP1.$pinGroup.AXR11.$used      = false;
iMCASP1.$pinGroup.AXR12.$used      = false;
iMCASP1.$pinGroup.AXR13.$used      = false;
iMCASP1.$pinGroup.AXR14.$used      = false;
iMCASP1.$pinGroup.AXR15.$used      = false;
iMCASP1.$pinGroup.AXR2.$assign     = "Y20";
iMCASP1.$pinGroup.AXR3.$assign     = "AA19";
iMCASP1.$pinGroup.AXR4.$assign     = "U19";
iMCASP1.$pinGroup.AXR5.$assign     = "T15";
iMCASP1.$pinGroup.AXR6.$assign     = "U20";
iMCASP1.$pinGroup.AXR7.$used       = false;
iMCASP1.$pinGroup.AXR8.$used       = false;
iMCASP1.$pinGroup.AXR9.$used       = false;
iMCASP1.$pinGroup.$numPins         = 7;
const iMCASP2                      = scripting.addPeripheral("MCASP");
iMCASP2.$name                      = "MyMCASP1";
iMCASP2.ACLKX.$assign              = "Y19";
iMCASP2.AFSX.$assign               = "Y18";
iMCASP2.$pinGroup.AXR0.$assign     = "Y17";
iMCASP2.$pinGroup.AXR1.$assign     = "AA20";
iMCASP2.$pinGroup.AXR10.$used      = false;
iMCASP2.$pinGroup.AXR11.$used      = false;
iMCASP2.$pinGroup.AXR12.$used      = false;
iMCASP2.$pinGroup.AXR13.$used      = false;
iMCASP2.$pinGroup.AXR14.$used      = false;
iMCASP2.$pinGroup.AXR15.$used      = false;
iMCASP2.$pinGroup.AXR2.$assign     = "Y15";
iMCASP2.$pinGroup.AXR3.$assign     = "AA17";
iMCASP2.$pinGroup.AXR4.$assign     = "U16";
iMCASP2.$pinGroup.AXR5.$assign     = "U14";
iMCASP2.$pinGroup.AXR6.$assign     = "T13";
iMCASP2.$pinGroup.AXR7.$assign     = "V19";
iMCASP2.$pinGroup.AXR8.$used       = false;
iMCASP2.$pinGroup.AXR9.$used       = false;
iMCASP2.$pinGroup.$numPins         = 8;
const iSYSTEM1                     = scripting.addPeripheral("SYSTEM");
iSYSTEM1.$name                     = "MySYSTEM1";
iSYSTEM1.AUDIO_EXT_REFCLK0.$used   = false;
iSYSTEM1.AUDIO_EXT_REFCLK1.$assign = "U21";
iSYSTEM1.EXTINTn.$used             = false;
iSYSTEM1.EXT_REFCLK1.$used         = false;
iSYSTEM1.FCLK_MUX.$used            = false;
iSYSTEM1.OBSCLK0.$used             = false;
iSYSTEM1.OBSCLK1.$used             = false;
iSYSTEM1.OBSCLK2.$used             = false;
iSYSTEM1.RESETSTATz.$used          = false;
iSYSTEM1.SOC_SAFETY_ERRORn.$used   = false;
iSYSTEM1.SYNC0_OUT.$used           = false;
iSYSTEM1.SYNC1_OUT.$used           = false;
iSYSTEM1.SYNC2_OUT.$used           = false;
iSYSTEM1.SYNC3_OUT.$used           = false;
iSYSTEM1.SYSCLKOUT0.$used          = false;

/**
 * Pinmux solution for unlocked pins/peripherals. This ensures that minor changes to the automatic solver in a future
 * version of the tool will not impact the pinmux you originally saw.  These lines can be completely deleted in order to
 * re-solve from scratch.
 */
iMCASP2.$suggestSolution  = "MCASP1";
iSYSTEM1.$suggestSolution = "SYSTEM0";
