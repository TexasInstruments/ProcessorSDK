/**
 * @cliArgs --device "J721S2_TDA4VE_TDA4AL_TDA4VL_AM68x" --package "ALZ" --part "Default"
 * @versions {"tool":"1.20.0+3587"}
 */

/**
 * These are the peripherals and settings in this configuration
 */
const iAUXPHY1                      = scripting.addPeripheral("AUXPHY");
iAUXPHY1.$name                      = "MyAUXPHY0";
iAUXPHY1.AUXN.$assign               = "ball.AG11";
iAUXPHY1.AUXP.$assign               = "ball.AF11";
const iCPSW2G1                      = scripting.addPeripheral("CPSW2G");
iCPSW2G1.$name                      = "MyCPSW2G0";
iCPSW2G1.$assign                    = "CPSW2G_0";
iCPSW2G1.CLKOUT.$used               = false;
iCPSW2G1.CRS_DV.$used               = false;
iCPSW2G1.MDC.$assign                = "ball.T28";
iCPSW2G1.MDIO.$assign               = "ball.V28";
iCPSW2G1.RD0.$assign                = "ball.AA24";
iCPSW2G1.RD1.$assign                = "ball.AB25";
iCPSW2G1.RD2.$assign                = "ball.T23";
iCPSW2G1.RD3.$assign                = "ball.U24";
iCPSW2G1.RMII_REF_CLK.$used         = false;
iCPSW2G1.RXC.$assign                = "ball.AD26";
iCPSW2G1.RXD0.$used                 = false;
iCPSW2G1.RXD1.$used                 = false;
iCPSW2G1.RX_CTL.$assign             = "ball.AC25";
iCPSW2G1.RX_ER.$used                = false;
iCPSW2G1.TD0.$assign                = "ball.T25";
iCPSW2G1.TD1.$assign                = "ball.W24";
iCPSW2G1.TD2.$assign                = "ball.AA25";
iCPSW2G1.TD3.$assign                = "ball.V25";
iCPSW2G1.TXC.$assign                = "ball.U25";
iCPSW2G1.TXD0.$used                 = false;
iCPSW2G1.TXD1.$used                 = false;
iCPSW2G1.TX_CTL.$assign             = "ball.T24";
iCPSW2G1.TX_EN.$used                = false;
const iCSI1                         = scripting.addPeripheral("CSI");
iCSI1.$name                         = "MyCSIRX0";
iCSI1.RXCLKN.$assign                = "ball.AH19";
iCSI1.RXCLKP.$assign                = "ball.AH20";
iCSI1.RXN0.$assign                  = "ball.AG18";
iCSI1.RXN1.$assign                  = "ball.AF19";
iCSI1.RXN2.$assign                  = "ball.AE18";
iCSI1.RXN3.$assign                  = "ball.AD19";
iCSI1.RXP0.$assign                  = "ball.AG19";
iCSI1.RXP1.$assign                  = "ball.AF20";
iCSI1.RXP2.$assign                  = "ball.AE19";
iCSI1.RXP3.$assign                  = "ball.AD20";
iCSI1.RXRCALIB.$assign              = "ball.AC18";
iCSI1.TXCLKN.$used                  = false;
iCSI1.TXCLKP.$used                  = false;
iCSI1.TXN0.$used                    = false;
iCSI1.TXN1.$used                    = false;
iCSI1.TXN2.$used                    = false;
iCSI1.TXN3.$used                    = false;
iCSI1.TXP0.$used                    = false;
iCSI1.TXP1.$used                    = false;
iCSI1.TXP2.$used                    = false;
iCSI1.TXP3.$used                    = false;
const iCSI2                         = scripting.addPeripheral("CSI");
iCSI2.$name                         = "MyCSIRX1";
iCSI2.RXCLKN.$assign                = "ball.AH22";
iCSI2.RXCLKP.$assign                = "ball.AH23";
iCSI2.RXN0.$assign                  = "ball.AG21";
iCSI2.RXN1.$assign                  = "ball.AF22";
iCSI2.RXN2.$assign                  = "ball.AE21";
iCSI2.RXN3.$assign                  = "ball.AD22";
iCSI2.RXP0.$assign                  = "ball.AG22";
iCSI2.RXP1.$assign                  = "ball.AF23";
iCSI2.RXP2.$assign                  = "ball.AE22";
iCSI2.RXP3.$assign                  = "ball.AD23";
iCSI2.RXRCALIB.$assign              = "ball.AC21";
iCSI2.TXCLKN.$used                  = false;
iCSI2.TXCLKP.$used                  = false;
iCSI2.TXN0.$used                    = false;
iCSI2.TXN1.$used                    = false;
iCSI2.TXN2.$used                    = false;
iCSI2.TXN3.$used                    = false;
iCSI2.TXP0.$used                    = false;
iCSI2.TXP1.$used                    = false;
iCSI2.TXP2.$used                    = false;
iCSI2.TXP3.$used                    = false;
const iDDRSS1                       = scripting.addPeripheral("DDRSS");
iDDRSS1.$name                       = "MyDDRSS0";
iDDRSS1.$assign                     = "DDR_0";
iDDRSS1.CA0.$assign                 = "ball.P3";
iDDRSS1.CA1.$assign                 = "ball.P5";
iDDRSS1.CA2.$assign                 = "ball.N5";
iDDRSS1.CA3.$assign                 = "ball.P2";
iDDRSS1.CA4.$assign                 = "ball.P4";
iDDRSS1.CA5.$assign                 = "ball.R3";
iDDRSS1.CAL0.$assign                = "ball.R8";
iDDRSS1.CKE0.$assign                = "ball.R2";
iDDRSS1.CKE1.$assign                = "ball.R4";
iDDRSS1.CKN.$assign                 = "ball.R1";
iDDRSS1.CKP.$assign                 = "ball.P1";
iDDRSS1.CSn0_0.$assign              = "ball.V5";
iDDRSS1.CSn0_1.$assign              = "ball.W5";
iDDRSS1.CSn1_0.$assign              = "ball.T5";
iDDRSS1.CSn1_1.$assign              = "ball.U6";
iDDRSS1.DM0.$assign                 = "ball.H5";
iDDRSS1.DM1.$assign                 = "ball.M3";
iDDRSS1.DM2.$assign                 = "ball.U4";
iDDRSS1.DM3.$assign                 = "ball.AD1";
iDDRSS1.DQ0.$assign                 = "ball.F3";
iDDRSS1.DQ1.$assign                 = "ball.G4";
iDDRSS1.DQ10.$assign                = "ball.K3";
iDDRSS1.DQ11.$assign                = "ball.K1";
iDDRSS1.DQ12.$assign                = "ball.N4";
iDDRSS1.DQ13.$assign                = "ball.N2";
iDDRSS1.DQ14.$assign                = "ball.L4";
iDDRSS1.DQ15.$assign                = "ball.L2";
iDDRSS1.DQ16.$assign                = "ball.T1";
iDDRSS1.DQ17.$assign                = "ball.T3";
iDDRSS1.DQ18.$assign                = "ball.V3";
iDDRSS1.DQ19.$assign                = "ball.U2";
iDDRSS1.DQ2.$assign                 = "ball.F5";
iDDRSS1.DQ20.$assign                = "ball.W2";
iDDRSS1.DQ21.$assign                = "ball.W4";
iDDRSS1.DQ22.$assign                = "ball.Y1";
iDDRSS1.DQ23.$assign                = "ball.Y3";
iDDRSS1.DQ24.$assign                = "ball.AB3";
iDDRSS1.DQ25.$assign                = "ball.AA2";
iDDRSS1.DQ26.$assign                = "ball.AA4";
iDDRSS1.DQ27.$assign                = "ball.Y5";
iDDRSS1.DQ28.$assign                = "ball.AC2";
iDDRSS1.DQ29.$assign                = "ball.AB5";
iDDRSS1.DQ3.$assign                 = "ball.F1";
iDDRSS1.DQ30.$assign                = "ball.AD2";
iDDRSS1.DQ31.$assign                = "ball.AC4";
iDDRSS1.DQ4.$assign                 = "ball.J4";
iDDRSS1.DQ5.$assign                 = "ball.H3";
iDDRSS1.DQ6.$assign                 = "ball.J2";
iDDRSS1.DQ7.$assign                 = "ball.G2";
iDDRSS1.DQ8.$assign                 = "ball.K5";
iDDRSS1.DQ9.$assign                 = "ball.M5";
iDDRSS1.DQS0N.$assign               = "ball.H1";
iDDRSS1.DQS0P.$assign               = "ball.G1";
iDDRSS1.DQS1N.$assign               = "ball.M1";
iDDRSS1.DQS1P.$assign               = "ball.L1";
iDDRSS1.DQS2N.$assign               = "ball.U1";
iDDRSS1.DQS2P.$assign               = "ball.V1";
iDDRSS1.DQS3N.$assign               = "ball.AC1";
iDDRSS1.DQS3P.$assign               = "ball.AB1";
iDDRSS1.RESETn.$assign              = "ball.R5";
iDDRSS1.RET.$assign                 = "ball.T8";
const iDDRSS2                       = scripting.addPeripheral("DDRSS");
iDDRSS2.$name                       = "MyDDRSS1";
iDDRSS2.$assign                     = "DDR_1";
iDDRSS2.CA0.$assign                 = "ball.C10";
iDDRSS2.CA1.$assign                 = "ball.E10";
iDDRSS2.CA2.$assign                 = "ball.E9";
iDDRSS2.CA3.$assign                 = "ball.B10";
iDDRSS2.CA4.$assign                 = "ball.D10";
iDDRSS2.CA5.$assign                 = "ball.C9";
iDDRSS2.CAL0.$assign                = "ball.E8";
iDDRSS2.CKE0.$assign                = "ball.B9";
iDDRSS2.CKE1.$assign                = "ball.D9";
iDDRSS2.CKN.$assign                 = "ball.A9";
iDDRSS2.CKP.$assign                 = "ball.A10";
iDDRSS2.CSn0_0.$assign              = "ball.F9";
iDDRSS2.CSn0_1.$assign              = "ball.F8";
iDDRSS2.CSn1_0.$assign              = "ball.F11";
iDDRSS2.CSn1_1.$assign              = "ball.F10";
iDDRSS2.DM0.$assign                 = "ball.D16";
iDDRSS2.DM1.$assign                 = "ball.E13";
iDDRSS2.DM2.$assign                 = "ball.F7";
iDDRSS2.DM3.$assign                 = "ball.B3";
iDDRSS2.DQ0.$assign                 = "ball.B18";
iDDRSS2.DQ1.$assign                 = "ball.E17";
iDDRSS2.DQ10.$assign                = "ball.C13";
iDDRSS2.DQ11.$assign                = "ball.C11";
iDDRSS2.DQ12.$assign                = "ball.E11";
iDDRSS2.DQ13.$assign                = "ball.A11";
iDDRSS2.DQ14.$assign                = "ball.B12";
iDDRSS2.DQ15.$assign                = "ball.D12";
iDDRSS2.DQ16.$assign                = "ball.B7";
iDDRSS2.DQ17.$assign                = "ball.D7";
iDDRSS2.DQ18.$assign                = "ball.C8";
iDDRSS2.DQ19.$assign                = "ball.A8";
iDDRSS2.DQ2.$assign                 = "ball.D18";
iDDRSS2.DQ20.$assign                = "ball.C6";
iDDRSS2.DQ21.$assign                = "ball.E6";
iDDRSS2.DQ22.$assign                = "ball.B5";
iDDRSS2.DQ23.$assign                = "ball.D5";
iDDRSS2.DQ24.$assign                = "ball.B1";
iDDRSS2.DQ25.$assign                = "ball.A4";
iDDRSS2.DQ26.$assign                = "ball.C4";
iDDRSS2.DQ27.$assign                = "ball.E4";
iDDRSS2.DQ28.$assign                = "ball.D1";
iDDRSS2.DQ29.$assign                = "ball.D3";
iDDRSS2.DQ3.$assign                 = "ball.A17";
iDDRSS2.DQ30.$assign                = "ball.C2";
iDDRSS2.DQ31.$assign                = "ball.E2";
iDDRSS2.DQ4.$assign                 = "ball.E15";
iDDRSS2.DQ5.$assign                 = "ball.B16";
iDDRSS2.DQ6.$assign                 = "ball.C15";
iDDRSS2.DQ7.$assign                 = "ball.C17";
iDDRSS2.DQ8.$assign                 = "ball.B14";
iDDRSS2.DQ9.$assign                 = "ball.D14";
iDDRSS2.DQS0N.$assign               = "ball.A15";
iDDRSS2.DQS0P.$assign               = "ball.A16";
iDDRSS2.DQS1N.$assign               = "ball.A12";
iDDRSS2.DQS1P.$assign               = "ball.A13";
iDDRSS2.DQS2N.$assign               = "ball.A7";
iDDRSS2.DQS2P.$assign               = "ball.A6";
iDDRSS2.DQS3N.$assign               = "ball.A2";
iDDRSS2.DQS3P.$assign               = "ball.A3";
iDDRSS2.RESETn.$assign              = "ball.F12";
iDDRSS2.RET.$assign                 = "ball.J10";
const iDP1                          = scripting.addPeripheral("DP");
iDP1.$name                          = "MyDP0";
iDP1.HPD.$used                      = false;
iDP1.TXN0.$assign                   = "ball.AG5";
iDP1.TXN1.$assign                   = "ball.AD7";
iDP1.TXN2.$used                     = false;
iDP1.TXN3.$used                     = false;
iDP1.TXP0.$assign                   = "ball.AG6";
iDP1.TXP1.$assign                   = "ball.AD8";
iDP1.TXP2.$used                     = false;
iDP1.TXP3.$used                     = false;
const iDSI1                         = scripting.addPeripheral("DSI");
iDSI1.$name                         = "MyDSI0";
iDSI1.$assign                       = "DSI_TX_0";
iDSI1.TXCLKN.$assign                = "ball.AH13";
iDSI1.TXCLKP.$assign                = "ball.AH14";
iDSI1.TXN0.$assign                  = "ball.AG12";
iDSI1.TXN1.$assign                  = "ball.AF13";
iDSI1.TXN2.$assign                  = "ball.AE12";
iDSI1.TXN3.$assign                  = "ball.AD13";
iDSI1.TXP0.$assign                  = "ball.AG13";
iDSI1.TXP1.$assign                  = "ball.AF14";
iDSI1.TXP2.$assign                  = "ball.AE13";
iDSI1.TXP3.$assign                  = "ball.AD14";
iDSI1.TXRCALIB.$assign              = "ball.AC13";
const iGPIO1                        = scripting.addPeripheral("GPIO");
iGPIO1["0"].$used                   = false;
iGPIO1["1"].$used                   = false;
iGPIO1["2"].$used                   = false;
iGPIO1["3"].$assign                 = "ball.AE28";
iGPIO1["4"].$used                   = false;
iGPIO1["5"].$used                   = false;
iGPIO1["6"].$used                   = false;
iGPIO1["7"].$used                   = false;
iGPIO1["8"].$assign                 = "ball.AA23";
iGPIO1["9"].$used                   = false;
iGPIO1["10"].$used                  = false;
iGPIO1["11"].$assign                = "ball.V23";
iGPIO1["12"].$used                  = false;
iGPIO1["13"].$assign                = "ball.AD24";
iGPIO1["14"].$used                  = false;
iGPIO1["15"].$used                  = false;
iGPIO1["16"].$used                  = false;
iGPIO1["17"].$used                  = false;
iGPIO1["18"].$assign                = "ball.AB27";
iGPIO1["19"].$used                  = false;
iGPIO1["20"].$used                  = false;
iGPIO1["21"].$used                  = false;
iGPIO1["22"].$used                  = false;
iGPIO1["23"].$assign                = "ball.AA26";
iGPIO1["24"].$used                  = false;
iGPIO1["25"].$used                  = false;
iGPIO1["26"].$assign                = "ball.U28";
iGPIO1["27"].$used                  = false;
iGPIO1["28"].$assign                = "ball.R27";
iGPIO1["29"].$used                  = false;
iGPIO1["30"].$used                  = false;
iGPIO1["31"].$used                  = false;
iGPIO1["32"].$used                  = false;
iGPIO1["33"].$used                  = false;
iGPIO1["34"].$used                  = false;
iGPIO1["35"].$used                  = false;
iGPIO1["36"].$used                  = false;
iGPIO1["37"].$used                  = false;
iGPIO1["38"].$used                  = false;
iGPIO1["39"].$used                  = false;
iGPIO1["40"].$used                  = false;
iGPIO1["41"].$used                  = false;
iGPIO1["42"].$used                  = false;
iGPIO1["43"].$used                  = false;
iGPIO1["44"].$used                  = false;
iGPIO1["45"].$used                  = false;
iGPIO1["46"].$used                  = false;
iGPIO1["47"].$used                  = false;
iGPIO1["48"].$used                  = false;
iGPIO1["49"].$used                  = false;
iGPIO1["50"].$used                  = false;
iGPIO1["51"].$assign                = "ball.AE27";
iGPIO1["52"].$used                  = false;
iGPIO1["53"].$used                  = false;
iGPIO1["54"].$used                  = false;
iGPIO1["55"].$used                  = false;
iGPIO1["56"].$used                  = false;
iGPIO1["57"].$used                  = false;
iGPIO1["58"].$used                  = false;
iGPIO1["59"].$used                  = false;
iGPIO1["60"].$used                  = false;
iGPIO1["61"].$used                  = false;
iGPIO1["62"].$used                  = false;
iGPIO1["63"].$used                  = false;
iGPIO1["64"].$used                  = false;
iGPIO1["65"].$used                  = false;
iGPIO1.$name                        = "MyGPIO0";
iGPIO1.$assign                      = "GPIO_0";
const iI2C1                         = scripting.addPeripheral("I2C");
iI2C1.$name                         = "MyI2C0";
iI2C1.$assign                       = "I2C_0";
iI2C1.SCL.$assign                   = "ball.AH25";
iI2C1.SDA.$assign                   = "ball.AE24";
const iI2C2                         = scripting.addPeripheral("I2C");
iI2C2.$name                         = "MyI2C1";
iI2C2.$assign                       = "I2C_1";
iI2C2.SCL.$assign                   = "ball.AB26";
iI2C2.SDA.$assign                   = "ball.AD28";
const iI2C3                         = scripting.addPeripheral("I2C");
iI2C3.$name                         = "MyI2C3";
iI2C3.$assign                       = "I2C_3";
iI2C3.SCL.$assign                   = "ball.W28";
iI2C3.SDA.$assign                   = "ball.AC27";
const iI2C4                         = scripting.addPeripheral("I2C");
iI2C4.$name                         = "MyI2C4";
iI2C4.$assign                       = "I2C_4";
iI2C4.SCL.$assign                   = "ball.AD25";
iI2C4.SDA.$assign                   = "ball.AF28";
const iI2C5                         = scripting.addPeripheral("I2C");
iI2C5.$name                         = "MyI2C5";
iI2C5.$assign                       = "I2C_5";
iI2C5.SCL.$assign                   = "ball.Y24";
iI2C5.SDA.$assign                   = "ball.W23";
const iMCAN1                        = scripting.addPeripheral("MCAN");
iMCAN1.$name                        = "MyMCAN16";
iMCAN1.$assign                      = "MCAN_16";
iMCAN1.RX.$assign                   = "ball.AB24";
iMCAN1.TX.$assign                   = "ball.Y28";
const iMCU_ADC1                     = scripting.addPeripheral("MCU_ADC");
iMCU_ADC1.$name                     = "MyMCU_ADC0";
iMCU_ADC1.$assign                   = "MCU_ADC_0";
iMCU_ADC1.AIN0.$assign              = "ball.L25";
iMCU_ADC1.AIN1.$assign              = "ball.K25";
iMCU_ADC1.AIN2.$assign              = "ball.M24";
iMCU_ADC1.AIN3.$assign              = "ball.L24";
iMCU_ADC1.AIN4.$assign              = "ball.L27";
iMCU_ADC1.AIN5.$assign              = "ball.K24";
iMCU_ADC1.AIN6.$assign              = "ball.M27";
iMCU_ADC1.AIN7.$assign              = "ball.M26";
const iMCU_ADC2                     = scripting.addPeripheral("MCU_ADC");
iMCU_ADC2.$name                     = "MyMCU_ADC1";
iMCU_ADC2.AIN0.$assign              = "ball.P25";
iMCU_ADC2.AIN1.$assign              = "ball.R25";
iMCU_ADC2.AIN2.$assign              = "ball.P28";
iMCU_ADC2.AIN3.$assign              = "ball.P27";
iMCU_ADC2.AIN4.$assign              = "ball.N25";
iMCU_ADC2.AIN5.$assign              = "ball.P26";
iMCU_ADC2.AIN6.$assign              = "ball.N26";
iMCU_ADC2.AIN7.$assign              = "ball.N27";
const iMCU_CPSW2G1                  = scripting.addPeripheral("MCU_CPSW2G");
iMCU_CPSW2G1.$name                  = "MyMCU_CPSW2G0";
iMCU_CPSW2G1.$assign                = "MCU_CPSW2G_0";
iMCU_CPSW2G1.CRS_DV.$used           = false;
iMCU_CPSW2G1.RD0.$assign            = "ball.B22";
iMCU_CPSW2G1.RD1.$assign            = "ball.B21";
iMCU_CPSW2G1.RD2.$assign            = "ball.C22";
iMCU_CPSW2G1.RD3.$assign            = "ball.D23";
iMCU_CPSW2G1.REF_CLK.$used          = false;
iMCU_CPSW2G1.RXC.$assign            = "ball.D22";
iMCU_CPSW2G1.RXD0.$used             = false;
iMCU_CPSW2G1.RXD1.$used             = false;
iMCU_CPSW2G1.RX_CTL.$assign         = "ball.E23";
iMCU_CPSW2G1.RX_ER.$used            = false;
iMCU_CPSW2G1.TD0.$assign            = "ball.F23";
iMCU_CPSW2G1.TD1.$assign            = "ball.G22";
iMCU_CPSW2G1.TD2.$assign            = "ball.E21";
iMCU_CPSW2G1.TD3.$assign            = "ball.E22";
iMCU_CPSW2G1.TXC.$assign            = "ball.F21";
iMCU_CPSW2G1.TXD0.$used             = false;
iMCU_CPSW2G1.TXD1.$used             = false;
iMCU_CPSW2G1.TX_CTL.$assign         = "ball.F22";
iMCU_CPSW2G1.TX_EN.$used            = false;
const iMCU_I2C1                     = scripting.addPeripheral("MCU_I2C");
iMCU_I2C1.$name                     = "MyMCU_I2C0";
iMCU_I2C1.$assign                   = "MCU_I2C_0";
iMCU_I2C1.SCL.$assign               = "ball.G24";
iMCU_I2C1.SDA.$assign               = "ball.J25";
const iMCU_I3C1                     = scripting.addPeripheral("MCU_I3C");
iMCU_I3C1.$name                     = "MyMCU_I3C1";
iMCU_I3C1.$assign                   = "MCU_I3C_0";
iMCU_I3C1.SCL.$assign               = "ball.F24";
iMCU_I3C1.SDA.$assign               = "ball.H26";
iMCU_I3C1.SDAPULLEN.$assign         = "ball.F25";
const iMCU_MCAN1                    = scripting.addPeripheral("MCU_MCAN");
iMCU_MCAN1.$name                    = "MyMCU_MCAN0";
iMCU_MCAN1.$assign                  = "MCU_MCAN_0";
iMCU_MCAN1.RX.$assign               = "ball.E28";
iMCU_MCAN1.TX.$assign               = "ball.E27";
const iMCU_MCAN2                    = scripting.addPeripheral("MCU_MCAN");
iMCU_MCAN2.$name                    = "MyMCU_MCAN1";
iMCU_MCAN2.$assign                  = "MCU_MCAN_1";
iMCU_MCAN2.RX.$assign               = "ball.F26";
iMCU_MCAN2.TX.$assign               = "ball.C23";
const iMCU_MDIO1                    = scripting.addPeripheral("MCU_MDIO");
iMCU_MDIO1.$name                    = "MyMCU_MDIO0";
iMCU_MDIO1.$assign                  = "MCU_MDIO_0";
iMCU_MDIO1.MDC.$assign              = "ball.A21";
iMCU_MDIO1.MDIO.$assign             = "ball.A22";
const iMCU_OSPI1                    = scripting.addPeripheral("MCU_OSPI");
iMCU_OSPI1.$name                    = "MyMCU_OSPI0";
iMCU_OSPI1.CLK.$assign              = "ball.D19";
iMCU_OSPI1.CSn0.$assign             = "ball.F15";
iMCU_OSPI1.CSn1.$used               = false;
iMCU_OSPI1.CSn2.$used               = false;
iMCU_OSPI1.CSn3.$used               = false;
iMCU_OSPI1.D0.$assign               = "ball.C19";
iMCU_OSPI1.D1.$assign               = "ball.F16";
iMCU_OSPI1.D2.$assign               = "ball.G15";
iMCU_OSPI1.D3.$assign               = "ball.F18";
iMCU_OSPI1.D4.$assign               = "ball.E19";
iMCU_OSPI1.D5.$assign               = "ball.G19";
iMCU_OSPI1.D6.$assign               = "ball.F19";
iMCU_OSPI1.D7.$assign               = "ball.F20";
iMCU_OSPI1.DQS.$assign              = "ball.E18";
iMCU_OSPI1.ECC_FAIL.$assign         = "ball.F17";
iMCU_OSPI1.LBCLKO.$used             = false;
iMCU_OSPI1.RESET_OUT0.$assign       = "ball.F14";
iMCU_OSPI1.RESET_OUT1.$used         = false;
const iMCU_OSPI2                    = scripting.addPeripheral("MCU_OSPI");
iMCU_OSPI2.$name                    = "MyMCU_OSPI1";
iMCU_OSPI2.CLK.$assign              = "ball.A19";
iMCU_OSPI2.CSn0.$assign             = "ball.D20";
iMCU_OSPI2.CSn1.$used               = false;
iMCU_OSPI2.CSn2.$used               = false;
iMCU_OSPI2.CSn3.$used               = false;
iMCU_OSPI2.D0.$assign               = "ball.D21";
iMCU_OSPI2.D1.$assign               = "ball.G20";
iMCU_OSPI2.D2.$assign               = "ball.C20";
iMCU_OSPI2.D3.$assign               = "ball.A20";
iMCU_OSPI2.D4.$used                 = false;
iMCU_OSPI2.D5.$used                 = false;
iMCU_OSPI2.D6.$used                 = false;
iMCU_OSPI2.D7.$used                 = false;
iMCU_OSPI2.DQS.$assign              = "ball.B19";
iMCU_OSPI2.ECC_FAIL.$used           = false;
iMCU_OSPI2.LBCLKO.$assign           = "ball.B20";
iMCU_OSPI2.RESET_OUT0.$used         = false;
iMCU_OSPI2.RESET_OUT1.$used         = false;
const iMCU_UART1                    = scripting.addPeripheral("MCU_UART");
iMCU_UART1.$name                    = "MyMCU_UART0";
iMCU_UART1.$assign                  = "MCU_USART_0";
iMCU_UART1.CTSn.$assign             = "ball.B24";
iMCU_UART1.RTSn.$assign             = "ball.D25";
iMCU_UART1.RXD.$assign              = "ball.C24";
iMCU_UART1.TXD.$assign              = "ball.C25";
const iMMCSD1                       = scripting.addPeripheral("MMCSD");
iMMCSD1.$name                       = "MyMMCSD0";
iMMCSD1.$assign                     = "MMC_0";
iMMCSD1.CALPAD.$assign              = "ball.AF1";
iMMCSD1.CLK.$assign                 = "ball.AC6";
iMMCSD1.CMD.$assign                 = "ball.AF2";
iMMCSD1.DAT0.$assign                = "ball.AF4";
iMMCSD1.DAT1.$assign                = "ball.AD3";
iMMCSD1.DAT2.$assign                = "ball.AD4";
iMMCSD1.DAT3.$assign                = "ball.AF3";
iMMCSD1.DAT4.$assign                = "ball.AE2";
iMMCSD1.DAT5.$assign                = "ball.AG3";
iMMCSD1.DAT6.$assign                = "ball.AE1";
iMMCSD1.DAT7.$assign                = "ball.AG1";
iMMCSD1.DS.$assign                  = "ball.AE3";
iMMCSD1.SDCD.$used                  = false;
iMMCSD1.SDWP.$used                  = false;
const iMMCSD2                       = scripting.addPeripheral("MMCSD");
iMMCSD2.$name                       = "MyMMCSD1";
iMMCSD2.$assign                     = "MMC_1";
iMMCSD2.CALPAD.$used                = false;
iMMCSD2.CLK.$assign                 = "ball.P23";
iMMCSD2.CMD.$assign                 = "ball.N24";
iMMCSD2.DAT0.$assign                = "ball.M23";
iMMCSD2.DAT1.$assign                = "ball.P24";
iMMCSD2.DAT2.$assign                = "ball.R24";
iMMCSD2.DAT3.$assign                = "ball.R22";
iMMCSD2.DAT4.$used                  = false;
iMMCSD2.DAT5.$used                  = false;
iMMCSD2.DAT6.$used                  = false;
iMMCSD2.DAT7.$used                  = false;
iMMCSD2.DS.$used                    = false;
iMMCSD2.SDCD.$assign                = "ball.AE25";
iMMCSD2.SDWP.$used                  = false;
const iOSC1                         = scripting.addPeripheral("OSC");
iOSC1.$name                         = "MyOSC1";
iOSC1.$assign                       = "OSC_1";
iOSC1.XI.$assign                    = "ball.M28";
iOSC1.XO.$assign                    = "ball.L28";
const iPCIE1                        = scripting.addPeripheral("PCIE");
iPCIE1.$name                        = "MyPCIE1";
iPCIE1.REFCLKN.$used                = false;
iPCIE1.REFCLKP.$used                = false;
iPCIE1.CLKREQn.$used                = false;
iPCIE1.RXN0.$assign                 = "ball.AF9";
iPCIE1.RXN1.$used                   = false;
iPCIE1.RXN2.$used                   = false;
iPCIE1.RXN3.$used                   = false;
iPCIE1.RXP0.$assign                 = "ball.AF10";
iPCIE1.RXP1.$used                   = false;
iPCIE1.RXP2.$used                   = false;
iPCIE1.RXP3.$used                   = false;
iPCIE1.TXN0.$assign                 = "ball.AH7";
iPCIE1.TXN1.$used                   = false;
iPCIE1.TXN2.$used                   = false;
iPCIE1.TXN3.$used                   = false;
iPCIE1.TXP0.$assign                 = "ball.AH8";
iPCIE1.TXP1.$used                   = false;
iPCIE1.TXP2.$used                   = false;
iPCIE1.TXP3.$used                   = false;
const iSERDES1                      = scripting.addPeripheral("SERDES");
iSERDES1.$name                      = "MySERDES0";
iSERDES1.REFCLK_N.$assign           = "ball.AH4";
iSERDES1.REFCLK_P.$assign           = "ball.AH5";
iSERDES1.REXT.$assign               = "ball.AC10";
const iSYSTEM1                      = scripting.addPeripheral("SYSTEM");
iSYSTEM1.$name                      = "MySYSTEM0";
iSYSTEM1.$assign                    = "SYSTEM_0";
iSYSTEM1.MCU_ADC_EXT_TRIGGER0.$used = false;
iSYSTEM1.MCU_ADC_EXT_TRIGGER1.$used = false;
iSYSTEM1.AUDIO_EXT_REFCLK0.$used    = false;
iSYSTEM1.AUDIO_EXT_REFCLK1.$used    = false;
iSYSTEM1.EXTINTn.$assign            = "ball.AG24";
iSYSTEM1.EXT_REFCLK1.$used          = false;
iSYSTEM1.FCLK_MUX.$used             = false;
iSYSTEM1.OBSCLK0.$used              = false;
iSYSTEM1.OBSCLK1.$used              = false;
iSYSTEM1.RESETSTATz.$assign         = "ball.AF27";
iSYSTEM1.SOC_SAFETY_ERRORn.$assign  = "ball.AF25";
iSYSTEM1.SYSCLKOUT0.$used           = false;
const iUART1                        = scripting.addPeripheral("UART");
iUART1.$name                        = "MyUART8";
iUART1.$assign                      = "USART_8";
iUART1.CTSn.$assign                 = "ball.AC28";
iUART1.DCDn.$used                   = false;
iUART1.DSRn.$used                   = false;
iUART1.DTRn.$used                   = false;
iUART1.RIn.$used                    = false;
iUART1.RTSn.$assign                 = "ball.Y26";
iUART1.RXD.$assign                  = "ball.AF26";
iUART1.TXD.$assign                  = "ball.AH27";
const iUART2                        = scripting.addPeripheral("UART");
iUART2.$name                        = "MyUART2";
iUART2.$assign                      = "USART_2";
iUART2.CTSn.$used                   = false;
iUART2.DCDn.$used                   = false;
iUART2.DSRn.$used                   = false;
iUART2.DTRn.$used                   = false;
iUART2.RIn.$used                    = false;
iUART2.RTSn.$used                   = false;
iUART2.RXD.$assign                  = "ball.AG26";
iUART2.TXD.$assign                  = "ball.AH26";
const iUART3                        = scripting.addPeripheral("UART");
iUART3.$name                        = "MyUART5";
iUART3.$assign                      = "USART_5";
iUART3.CTSn.$used                   = false;
iUART3.DCDn.$used                   = false;
iUART3.DSRn.$used                   = false;
iUART3.DTRn.$used                   = false;
iUART3.RIn.$used                    = false;
iUART3.RTSn.$used                   = false;
iUART3.RXD.$assign                  = "ball.AC24";
iUART3.TXD.$assign                  = "ball.W25";
const iUSB1                         = scripting.addPeripheral("USB");
iUSB1.$name                         = "MyUSB0";
iUSB1.DM.$assign                    = "ball.AG2";
iUSB1.DP.$assign                    = "ball.AH2";
iUSB1.DRVVBUS.$assign               = "ball.AG25";
iUSB1.ID.$assign                    = "ball.AC9";
iUSB1.RCALIB.$assign                = "ball.AA6";
iUSB1.SSRX1N.$used                  = false;
iUSB1.SSRX1P.$used                  = false;
iUSB1.SSRX2N.$assign                = "ball.AE8";
iUSB1.SSRX2P.$assign                = "ball.AE9";
iUSB1.SSTX1N.$used                  = false;
iUSB1.SSTX1P.$used                  = false;
iUSB1.SSTX2N.$assign                = "ball.AG8";
iUSB1.SSTX2P.$assign                = "ball.AG9";
iUSB1.VBUS.$assign                  = "ball.AA8";
const iWKUP_GPIO1                   = scripting.addPeripheral("WKUP_GPIO");
iWKUP_GPIO1["0"].$assign            = "ball.D26";
iWKUP_GPIO1["1"].$assign            = "ball.E24";
iWKUP_GPIO1["2"].$assign            = "ball.C28";
iWKUP_GPIO1["3"].$assign            = "ball.C27";
iWKUP_GPIO1["4"].$used              = false;
iWKUP_GPIO1["5"].$used              = false;
iWKUP_GPIO1["6"].$assign            = "ball.E25";
iWKUP_GPIO1["7"].$assign            = "ball.F28";
iWKUP_GPIO1["8"].$used              = false;
iWKUP_GPIO1["9"].$used              = false;
iWKUP_GPIO1["10"].$used             = false;
iWKUP_GPIO1["11"].$used             = false;
iWKUP_GPIO1["12"].$used             = false;
iWKUP_GPIO1["13"].$used             = false;
iWKUP_GPIO1["14"].$used             = false;
iWKUP_GPIO1["15"].$used             = false;
iWKUP_GPIO1["16"].$used             = false;
iWKUP_GPIO1["17"].$used             = false;
iWKUP_GPIO1["18"].$used             = false;
iWKUP_GPIO1["19"].$used             = false;
iWKUP_GPIO1["20"].$used             = false;
iWKUP_GPIO1["21"].$used             = false;
iWKUP_GPIO1["22"].$used             = false;
iWKUP_GPIO1["23"].$used             = false;
iWKUP_GPIO1["24"].$used             = false;
iWKUP_GPIO1["25"].$used             = false;
iWKUP_GPIO1["26"].$used             = false;
iWKUP_GPIO1["27"].$used             = false;
iWKUP_GPIO1["28"].$used             = false;
iWKUP_GPIO1["29"].$used             = false;
iWKUP_GPIO1["30"].$used             = false;
iWKUP_GPIO1["31"].$used             = false;
iWKUP_GPIO1["32"].$used             = false;
iWKUP_GPIO1["33"].$used             = false;
iWKUP_GPIO1["34"].$used             = false;
iWKUP_GPIO1["35"].$used             = false;
iWKUP_GPIO1["36"].$used             = false;
iWKUP_GPIO1["37"].$used             = false;
iWKUP_GPIO1["38"].$used             = false;
iWKUP_GPIO1["39"].$assign           = "ball.C21";
iWKUP_GPIO1["40"].$used             = false;
iWKUP_GPIO1["41"].$used             = false;
iWKUP_GPIO1["42"].$used             = false;
iWKUP_GPIO1["43"].$used             = false;
iWKUP_GPIO1["44"].$used             = false;
iWKUP_GPIO1["45"].$used             = false;
iWKUP_GPIO1["46"].$used             = false;
iWKUP_GPIO1["47"].$used             = false;
iWKUP_GPIO1["48"].$used             = false;
iWKUP_GPIO1["49"].$assign           = "ball.K26";
iWKUP_GPIO1["50"].$used             = false;
iWKUP_GPIO1["51"].$used             = false;
iWKUP_GPIO1["52"].$used             = false;
iWKUP_GPIO1["53"].$used             = false;
iWKUP_GPIO1["54"].$assign           = "ball.B27";
iWKUP_GPIO1["54"].$used             = false;
iWKUP_GPIO1["55"].$assign           = "ball.D24";
iWKUP_GPIO1["56"].$assign           = "ball.G27";
iWKUP_GPIO1["57"].$assign           = "ball.J26";
iWKUP_GPIO1["57"].$used             = false;
iWKUP_GPIO1["58"].$used             = false;
iWKUP_GPIO1["59"].$used             = false;
iWKUP_GPIO1["60"].$used             = false;
iWKUP_GPIO1["61"].$used             = false;
iWKUP_GPIO1["62"].$used             = false;
iWKUP_GPIO1["63"].$used             = false;
iWKUP_GPIO1["64"].$used             = false;
iWKUP_GPIO1["65"].$used             = false;
iWKUP_GPIO1["66"].$assign           = "ball.G25";
iWKUP_GPIO1["66"].$used             = false;
iWKUP_GPIO1["67"].$used             = false;
iWKUP_GPIO1["68"].$used             = false;
iWKUP_GPIO1["69"].$assign           = "ball.B25";
iWKUP_GPIO1["70"].$assign           = "ball.B26";
iWKUP_GPIO1["71"].$used             = false;
iWKUP_GPIO1["72"].$used             = false;
iWKUP_GPIO1["73"].$used             = false;
iWKUP_GPIO1["74"].$used             = false;
iWKUP_GPIO1["75"].$used             = false;
iWKUP_GPIO1["76"].$used             = false;
iWKUP_GPIO1["77"].$used             = false;
iWKUP_GPIO1["78"].$used             = false;
iWKUP_GPIO1["79"].$used             = false;
iWKUP_GPIO1["80"].$used             = false;
iWKUP_GPIO1["81"].$used             = false;
iWKUP_GPIO1["82"].$used             = false;
iWKUP_GPIO1["83"].$used             = false;
iWKUP_GPIO1["84"].$used             = false;
iWKUP_GPIO1["85"].$used             = false;
iWKUP_GPIO1["86"].$used             = false;
iWKUP_GPIO1["87"].$used             = false;
iWKUP_GPIO1["88"].$used             = false;
iWKUP_GPIO1.$name                   = "MyWKUP_GPIO0";
iWKUP_GPIO1.$assign                 = "WKUP_GPIO_0";
const iWKUP_I2C1                    = scripting.addPeripheral("WKUP_I2C");
iWKUP_I2C1.$name                    = "MyWKUP_I2C0";
iWKUP_I2C1.$assign                  = "WKUP_I2C_0";
iWKUP_I2C1.SCL.$assign              = "ball.H24";
iWKUP_I2C1.SDA.$assign              = "ball.H27";
const iWKUP_OSC1                    = scripting.addPeripheral("WKUP_OSC");
iWKUP_OSC1.$name                    = "MyWKUP_OSC1";
iWKUP_OSC1.$assign                  = "WKUP_OSC_0";
iWKUP_OSC1.XI.$assign               = "ball.H28";
iWKUP_OSC1.XO.$assign               = "ball.J28";
const iWKUP_UART1                   = scripting.addPeripheral("WKUP_UART");
iWKUP_UART1.$name                   = "MyWKUP_UART0";
iWKUP_UART1.CTSn.$used              = false;
iWKUP_UART1.RTSn.$used              = false;
iWKUP_UART1.RXD.$assign             = "ball.D28";
iWKUP_UART1.TXD.$assign             = "ball.D27";

/**
 * Pinmux solution for unlocked pins/peripherals. This ensures that minor changes to the automatic solver in a future
 * version of the tool will not impact the pinmux you originally saw.  These lines can be completely deleted in order to
 * re-solve from scratch.
 */
iAUXPHY1.$suggestSolution    = "AUXPHY_0";
iCSI1.$suggestSolution       = "CSI_RX_0";
iCSI2.$suggestSolution       = "CSI_RX_1";
iDP1.$suggestSolution        = "DP_0";
iMCU_ADC2.$suggestSolution   = "MCU_ADC_1";
iMCU_OSPI1.$suggestSolution  = "MCU_OSPI_0";
iMCU_OSPI2.$suggestSolution  = "MCU_OSPI_1";
iPCIE1.$suggestSolution      = "PCIE_1";
iSERDES1.$suggestSolution    = "SERDES_0";
iUSB1.$suggestSolution       = "USB_0";
iWKUP_UART1.$suggestSolution = "WKUP_USART_0";
