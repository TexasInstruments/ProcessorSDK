/**
 * @cliArgs --device "J721E_DRA829_TDA4VM_AM752x" --package "ALF" --part "Default"
 * @versions {"tool":"1.11.0+2225"}
 */

/**
 * These are the peripherals and settings in this configuration
 */
const iGPIO1                       = scripting.addPeripheral("GPIO");
iGPIO1["11"].$assign               = "ball.AD21";
iGPIO1["11"].$used                 = true;
iGPIO1["45"].$assign               = "ball.AE27";
iGPIO1["45"].$used                 = true;
iGPIO1["46"].$assign               = "ball.AD26";
iGPIO1["46"].$used                 = true;
iGPIO1["65"].$assign               = "ball.AD27";
iGPIO1["65"].$used                 = true;
iGPIO1["66"].$assign               = "ball.AC25";
iGPIO1["66"].$used                 = true;
iGPIO1["76"].$assign               = "ball.AF26";
iGPIO1["76"].$used                 = true;
iGPIO1["78"].$assign               = "ball.AF29";
iGPIO1["78"].$used                 = true;
iGPIO1["79"].$assign               = "ball.AG29";
iGPIO1["79"].$used                 = true;
iGPIO1.$name                       = "MyGPIO0";
iGPIO1.$assign                     = "GPIO0";
const iGPIO2                       = scripting.addPeripheral("GPIO");
iGPIO2["23"].$assign               = "ball.T28";
iGPIO2["23"].$used                 = true;
iGPIO2["24"].$assign               = "ball.T29";
iGPIO2["24"].$used                 = true;
iGPIO2.$name                       = "MyGPIO1";
iGPIO2.$assign                     = "GPIO1";
const iMCASP1                      = scripting.addPeripheral("MCASP");
iMCASP1.$name                      = "MyMCASP1";
iMCASP1.$assign                    = "MCASP1";
iMCASP1.ACLKX.$assign              = "ball.AB27";
iMCASP1.AFSX.$assign               = "ball.AA28";
iMCASP1.$pinGroup.AXR0.$assign     = "ball.AE29";
iMCASP1.$pinGroup.AXR1.$assign     = "ball.AD28";
iMCASP1.$pinGroup.AXR10.$used      = false;
iMCASP1.$pinGroup.AXR11.$used      = false;
iMCASP1.$pinGroup.AXR12.$used      = false;
iMCASP1.$pinGroup.AXR13.$used      = false;
iMCASP1.$pinGroup.AXR14.$used      = false;
iMCASP1.$pinGroup.AXR15.$used      = false;
iMCASP1.$pinGroup.AXR2.$assign     = "ball.AD29";
iMCASP1.$pinGroup.AXR3.$assign     = "ball.AC26";
iMCASP1.$pinGroup.AXR4.$used       = false;
iMCASP1.$pinGroup.AXR5.$assign     = "ball.Y24";
iMCASP1.$pinGroup.AXR6.$assign     = "ball.AA25";
iMCASP1.$pinGroup.AXR7.$assign     = "ball.AG26";
iMCASP1.$pinGroup.AXR8.$assign     = "ball.AF27";
iMCASP1.$pinGroup.AXR9.$used       = false;
iMCASP1.$pinGroup.$numPins         = 8;
const iMCASP2                      = scripting.addPeripheral("MCASP");
iMCASP2.$name                      = "MyMCASP0";
iMCASP2.$assign                    = "MCASP0";
iMCASP2.ACLKX.$assign              = "ball.AB26";
iMCASP2.AFSX.$assign               = "ball.AB25";
iMCASP2.$pinGroup.AXR0.$assign     = "ball.AF28";
iMCASP2.$pinGroup.AXR1.$assign     = "ball.AE28";
iMCASP2.$pinGroup.AXR10.$assign    = "ball.AG28";
iMCASP2.$pinGroup.AXR11.$assign    = "ball.AG27";
iMCASP2.$pinGroup.AXR12.$assign    = "ball.AH28";
iMCASP2.$pinGroup.AXR13.$assign    = "ball.AB24";
iMCASP2.$pinGroup.AXR14.$used      = false;
iMCASP2.$pinGroup.AXR15.$used      = false;
iMCASP2.$pinGroup.AXR2.$assign     = "ball.AD25";
iMCASP2.$pinGroup.AXR3.$assign     = "ball.AC29";
iMCASP2.$pinGroup.AXR4.$assign     = "ball.AE26";
iMCASP2.$pinGroup.AXR5.$assign     = "ball.AC28";
iMCASP2.$pinGroup.AXR6.$assign     = "ball.AC27";
iMCASP2.$pinGroup.AXR7.$assign     = "ball.AJ28";
iMCASP2.$pinGroup.AXR8.$assign     = "ball.AH27";
iMCASP2.$pinGroup.AXR9.$assign     = "ball.AH29";
iMCASP2.$pinGroup.$numPins         = 14;
const iMCASP3                      = scripting.addPeripheral("MCASP");
iMCASP3.$name                      = "MyMCASP2";
iMCASP3.$assign                    = "MCASP2";
iMCASP3.ACLKX.$used                = false;
iMCASP3.AFSX.$used                 = false;
iMCASP3.$pinGroup.AXR0.$assign     = "ball.AE25";
iMCASP3.$pinGroup.AXR1.$used       = false;
iMCASP3.$pinGroup.AXR10.$used      = false;
iMCASP3.$pinGroup.AXR11.$used      = false;
iMCASP3.$pinGroup.AXR12.$used      = false;
iMCASP3.$pinGroup.AXR13.$used      = false;
iMCASP3.$pinGroup.AXR14.$used      = false;
iMCASP3.$pinGroup.AXR15.$used      = false;
iMCASP3.$pinGroup.AXR2.$used       = false;
iMCASP3.$pinGroup.AXR3.$used       = false;
iMCASP3.$pinGroup.AXR4.$used       = false;
iMCASP3.$pinGroup.AXR5.$used       = false;
iMCASP3.$pinGroup.AXR6.$used       = false;
iMCASP3.$pinGroup.AXR7.$used       = false;
iMCASP3.$pinGroup.AXR8.$used       = false;
iMCASP3.$pinGroup.AXR9.$used       = false;
const iMCASP4                      = scripting.addPeripheral("MCASP");
iMCASP4.$useCase                   = "MCASP_1";
iMCASP4.$name                      = "MyMCASP6";
iMCASP4.$assign                    = "MCASP6";
iMCASP4.ACLKR.$assign              = "ball.AH23";
iMCASP4.ACLKX.$assign              = "ball.AC23";
iMCASP4.AFSR.$used                 = false;
iMCASP4.AFSX.$assign               = "ball.AG22";
iMCASP4.$pinGroup.AXR0.$assign     = "ball.AF22";
iMCASP4.$pinGroup.AXR1.$assign     = "ball.AJ23";
iMCASP4.$pinGroup.AXR10.$used      = false;
iMCASP4.$pinGroup.AXR11.$used      = false;
iMCASP4.$pinGroup.AXR12.$used      = false;
iMCASP4.$pinGroup.AXR13.$used      = false;
iMCASP4.$pinGroup.AXR14.$used      = false;
iMCASP4.$pinGroup.AXR15.$used      = false;
iMCASP4.$pinGroup.AXR2.$used       = false;
iMCASP4.$pinGroup.AXR3.$used       = false;
iMCASP4.$pinGroup.AXR4.$used       = false;
iMCASP4.$pinGroup.AXR5.$used       = false;
iMCASP4.$pinGroup.AXR6.$used       = false;
iMCASP4.$pinGroup.AXR7.$used       = false;
iMCASP4.$pinGroup.AXR8.$used       = false;
iMCASP4.$pinGroup.AXR9.$used       = false;
iMCASP4.$pinGroup.$numPins         = 2;
const iSPI1                        = scripting.addPeripheral("SPI");
iSPI1.$name                        = "MySPI3";
iSPI1.$assign                      = "SPI3";
iSPI1.CLK.$assign                  = "ball.Y25";
iSPI1.CS0.$assign                  = "ball.AA24";
iSPI1.CS1.$used                    = false;
iSPI1.CS2.$used                    = false;
iSPI1.CS3.$used                    = false;
iSPI1.D0.$assign                   = "ball.AA26";
iSPI1.D1.$assign                   = "ball.AA29";
const iSYSTEM1                     = scripting.addPeripheral("SYSTEM");
iSYSTEM1.$name                     = "MySYSTEM1";
iSYSTEM1.$assign                   = "SYSTEM0";
iSYSTEM1.AUDIO_EXT_REFCLK0.$assign = "ball.AD22";
iSYSTEM1.AUDIO_EXT_REFCLK1.$assign = "ball.AE20";
iSYSTEM1.AUDIO_EXT_REFCLK2.$used   = false;
iSYSTEM1.AUDIO_EXT_REFCLK3.$used   = false;
iSYSTEM1.EXTINTn.$used             = false;
iSYSTEM1.EXT_REFCLK1.$used         = false;
iSYSTEM1.FCLK_MUX.$used            = false;
iSYSTEM1.OBSCLK0.$used             = false;
iSYSTEM1.OBSCLK1.$used             = false;
iSYSTEM1.OBSCLK2.$used             = false;
iSYSTEM1.PORz_OUT.$used            = false;
iSYSTEM1.RESETSTATz.$used          = false;
iSYSTEM1.SOC_SAFETY_ERRORn.$used   = false;
iSYSTEM1.SYNC0_OUT.$used           = false;
iSYSTEM1.SYNC1_OUT.$used           = false;
iSYSTEM1.SYNC2_OUT.$used           = false;
iSYSTEM1.SYNC3_OUT.$used           = false;
iSYSTEM1.SYSCLKOUT0.$used          = false;
iSYSTEM1.REF_CLK.$used             = false;
const iVOUT1                       = scripting.addPeripheral("VOUT");
iVOUT1.$name                       = "MyVOUT1";
iVOUT1.DATA0.$assign               = "ball.AE22";
iVOUT1.DATA1.$assign               = "ball.AG23";
iVOUT1.DATA2.$assign               = "ball.AF23";
iVOUT1.DATA3.$assign               = "ball.AD23";
iVOUT1.DATA4.$assign               = "ball.AH24";
iVOUT1.DATA5.$assign               = "ball.AG21";
iVOUT1.DATA6.$assign               = "ball.AE23";
iVOUT1.DATA7.$assign               = "ball.AC21";
iVOUT1.DATA8.$assign               = "ball.Y23";
iVOUT1.DATA9.$assign               = "ball.AF21";
iVOUT1.DATA10.$assign              = "ball.AB23";
iVOUT1.DATA11.$assign              = "ball.AJ25";
iVOUT1.DATA12.$assign              = "ball.AH25";
iVOUT1.DATA13.$assign              = "ball.AG25";
iVOUT1.DATA14.$assign              = "ball.AH26";
iVOUT1.DATA15.$assign              = "ball.AJ27";
iVOUT1.DATA16.$assign              = "ball.AF24";
iVOUT1.DATA17.$assign              = "ball.AJ24";
iVOUT1.DATA18.$assign              = "ball.AG24";
iVOUT1.DATA19.$assign              = "ball.AD24";
iVOUT1.DATA20.$assign              = "ball.AC24";
iVOUT1.DATA21.$assign              = "ball.AE24";
iVOUT1.DATA22.$assign              = "ball.AJ20";
iVOUT1.DATA23.$assign              = "ball.AG20";
iVOUT1.DE.$assign                  = "ball.AC22";
iVOUT1.EXTPCLKIN.$assign           = "ball.AH21";
iVOUT1.EXTPCLKIN.$used             = true;
iVOUT1.HSYNC.$assign               = "ball.AJ26";
iVOUT1.PCLK.$assign                = "ball.AH22";
iVOUT1.VP0_DE.$assign              = "ball.AC22";
iVOUT1.VP0_HSYNC.$assign           = "ball.AJ26";
iVOUT1.VP0_VSYNC.$assign           = "ball.AJ22";
iVOUT1.VP2_DE.$assign              = "ball.AC22";
iVOUT1.VSYNC.$assign               = "ball.AJ22";
const iVPFE1                       = scripting.addPeripheral("VPFE");
iVPFE1.$name                       = "MyVPFE1";
iVPFE1.DATA0.$used                 = false;
iVPFE1.DATA1.$used                 = false;
iVPFE1.DATA2.$used                 = false;
iVPFE1.DATA3.$used                 = false;
iVPFE1.DATA4.$used                 = false;
iVPFE1.DATA5.$used                 = false;
iVPFE1.DATA6.$assign               = "ball.AJ21";
iVPFE1.DATA7.$assign               = "ball.AE21";
iVPFE1.DATA8.$used                 = false;
iVPFE1.DATA9.$used                 = false;
iVPFE1.DATA10.$used                = false;
iVPFE1.DATA11.$assign              = "ball.AD19";
iVPFE1.DATA12.$assign              = "ball.AD18";
iVPFE1.DATA13.$used                = false;
iVPFE1.DATA14.$used                = false;
iVPFE1.DATA15.$used                = false;
iVPFE1.FIELD.$used                 = false;
iVPFE1.HD.$used                    = false;
iVPFE1.PCLK.$used                  = false;
iVPFE1.VD.$used                    = false;
iVPFE1.WEN.$used                   = false;

/**
 * Pinmux solution for unlocked pins/peripherals. This ensures that minor changes to the automatic solver in a future
 * version of the tool will not impact the pinmux you originally saw.  These lines can be completely deleted in order to
 * re-solve from scratch.
 */
iVOUT1.$suggestSolution = "VOUT0";
iVPFE1.$suggestSolution = "VPFE0";
