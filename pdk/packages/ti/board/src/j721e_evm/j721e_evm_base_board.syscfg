/**
 * @cliArgs --device "J721E_DRA829_TDA4VM_AM752x" --package "ALF" --part "Default"
 * @versions {"tool":"1.11.0+2225"}
 */

/**
 * These are the peripherals and settings in this configuration
 */
const iCSI1                             = scripting.addPeripheral("CSI");
iCSI1.$name                             = "MyCSI0";
iCSI1.$assign                           = "CSI_RX0";
iCSI1.RXCLKN.$assign                    = "ball.B20";
iCSI1.RXCLKP.$assign                    = "ball.A21";
iCSI1.RXN0.$assign                      = "ball.B19";
iCSI1.RXN1.$assign                      = "ball.D18";
iCSI1.RXN2.$assign                      = "ball.D17";
iCSI1.RXN3.$assign                      = "ball.E16";
iCSI1.RXP0.$assign                      = "ball.A20";
iCSI1.RXP1.$assign                      = "ball.C19";
iCSI1.RXP2.$assign                      = "ball.C18";
iCSI1.RXP3.$assign                      = "ball.E17";
const iCSI2                             = scripting.addPeripheral("CSI");
iCSI2.$name                             = "MyCSI1";
iCSI2.$assign                           = "CSI_RX1";
iCSI2.RXCLKN.$assign                    = "ball.B17";
iCSI2.RXCLKP.$assign                    = "ball.A18";
iCSI2.RXN0.$assign                      = "ball.B16";
iCSI2.RXN1.$assign                      = "ball.D15";
iCSI2.RXN2.$assign                      = "ball.D14";
iCSI2.RXN3.$assign                      = "ball.E13";
iCSI2.RXP0.$assign                      = "ball.A17";
iCSI2.RXP1.$assign                      = "ball.C16";
iCSI2.RXP2.$assign                      = "ball.C15";
iCSI2.RXP3.$assign                      = "ball.E14";
const iDDRSS1                           = scripting.addPeripheral("DDRSS");
iDDRSS1.$name                           = "MyDDRSS0";
iDDRSS1.CKN.$assign                     = "ball.J1";
iDDRSS1.CKP.$assign                     = "ball.H1";
iDDRSS1.RESETn.$assign                  = "ball.K6";
iDDRSS1.CA0.$assign                     = "ball.G4";
iDDRSS1.CA1.$assign                     = "ball.H3";
iDDRSS1.CA2.$assign                     = "ball.K5";
iDDRSS1.CA3.$assign                     = "ball.J4";
iDDRSS1.CA4.$assign                     = "ball.K2";
iDDRSS1.CA5.$assign                     = "ball.H5";
iDDRSS1.CKE0.$assign                    = "ball.G3";
iDDRSS1.CKE1.$assign                    = "ball.J3";
iDDRSS1.CSn0_0.$assign                  = "ball.J5";
iDDRSS1.CSn0_1.$assign                  = "ball.K3";
iDDRSS1.CSn1_0.$assign                  = "ball.G5";
iDDRSS1.CSn1_1.$assign                  = "ball.J2";
iDDRSS1.DM0.$assign                     = "ball.A3";
iDDRSS1.DM1.$assign                     = "ball.E4";
iDDRSS1.DM2.$assign                     = "ball.N1";
iDDRSS1.DM3.$assign                     = "ball.R5";
iDDRSS1.DQ0.$assign                     = "ball.A5";
iDDRSS1.DQ1.$assign                     = "ball.A6";
iDDRSS1.DQ2.$assign                     = "ball.B5";
iDDRSS1.DQ3.$assign                     = "ball.C2";
iDDRSS1.DQ4.$assign                     = "ball.B4";
iDDRSS1.DQ5.$assign                     = "ball.C3";
iDDRSS1.DQ6.$assign                     = "ball.A2";
iDDRSS1.DQ7.$assign                     = "ball.A4";
iDDRSS1.DQ8.$assign                     = "ball.D1";
iDDRSS1.DQ9.$assign                     = "ball.C4";
iDDRSS1.DQ10.$assign                    = "ball.F1";
iDDRSS1.DQ11.$assign                    = "ball.G2";
iDDRSS1.DQ12.$assign                    = "ball.F2";
iDDRSS1.DQ13.$assign                    = "ball.F3";
iDDRSS1.DQ14.$assign                    = "ball.D3";
iDDRSS1.DQ15.$assign                    = "ball.F5";
iDDRSS1.DQ16.$assign                    = "ball.L5";
iDDRSS1.DQ17.$assign                    = "ball.M5";
iDDRSS1.DQ18.$assign                    = "ball.N5";
iDDRSS1.DQ19.$assign                    = "ball.L4";
iDDRSS1.DQ20.$assign                    = "ball.L2";
iDDRSS1.DQ21.$assign                    = "ball.L1";
iDDRSS1.DQ22.$assign                    = "ball.N2";
iDDRSS1.DQ23.$assign                    = "ball.N4";
iDDRSS1.DQ24.$assign                    = "ball.T3";
iDDRSS1.DQ25.$assign                    = "ball.T2";
iDDRSS1.DQ26.$assign                    = "ball.P2";
iDDRSS1.DQ27.$assign                    = "ball.P3";
iDDRSS1.DQ28.$assign                    = "ball.P5";
iDDRSS1.DQ29.$assign                    = "ball.R4";
iDDRSS1.DQ30.$assign                    = "ball.T4";
iDDRSS1.DQ31.$assign                    = "ball.T5";
iDDRSS1.DQS0N.$assign                   = "ball.B1";
iDDRSS1.DQS0P.$assign                   = "ball.B2";
iDDRSS1.DQS1N.$assign                   = "ball.E2";
iDDRSS1.DQS1P.$assign                   = "ball.E3";
iDDRSS1.DQS2N.$assign                   = "ball.M2";
iDDRSS1.DQS2P.$assign                   = "ball.M3";
iDDRSS1.DQS3N.$assign                   = "ball.R1";
iDDRSS1.DQS3P.$assign                   = "ball.R2";
const iDEBUGSS1                         = scripting.addPeripheral("DEBUGSS");
iDEBUGSS1.$name                         = "MyDEBUG1";
iDEBUGSS1.CLK.$used                     = false;
iDEBUGSS1.CTL.$used                     = false;
iDEBUGSS1.TMS.$assign                   = "ball.V2";
iDEBUGSS1.TDI.$assign                   = "ball.V1";
iDEBUGSS1.TDO.$assign                   = "ball.V3";
iDEBUGSS1.DATA0.$used                   = false;
iDEBUGSS1.DATA1.$used                   = false;
iDEBUGSS1.DATA2.$used                   = false;
iDEBUGSS1.DATA3.$used                   = false;
iDEBUGSS1.DATA4.$used                   = false;
iDEBUGSS1.DATA5.$used                   = false;
iDEBUGSS1.DATA6.$used                   = false;
iDEBUGSS1.DATA7.$used                   = false;
iDEBUGSS1.DATA8.$used                   = false;
iDEBUGSS1.DATA9.$used                   = false;
iDEBUGSS1.DATA10.$used                  = false;
iDEBUGSS1.DATA11.$used                  = false;
iDEBUGSS1.DATA12.$used                  = false;
iDEBUGSS1.DATA13.$used                  = false;
iDEBUGSS1.DATA14.$used                  = false;
iDEBUGSS1.DATA15.$used                  = false;
iDEBUGSS1.DATA16.$used                  = false;
iDEBUGSS1.DATA17.$used                  = false;
iDEBUGSS1.DATA18.$used                  = false;
iDEBUGSS1.DATA19.$used                  = false;
iDEBUGSS1.DATA20.$used                  = false;
iDEBUGSS1.DATA21.$used                  = false;
iDEBUGSS1.DATA22.$used                  = false;
iDEBUGSS1.DATA23.$used                  = false;
const iDP1                              = scripting.addPeripheral("DP");
iDP1.$name                              = "MyDP0";
iDP1.AUXN.$assign                       = "ball.G6";
iDP1.AUXP.$assign                       = "ball.F7";
iDP1.TX0_N.$assign                      = "ball.B11";
iDP1.TX0_P.$assign                      = "ball.A12";
iDP1.TX1_N.$assign                      = "ball.B10";
iDP1.TX1_P.$assign                      = "ball.A11";
iDP1.TX2_N.$assign                      = "ball.B8";
iDP1.TX2_P.$assign                      = "ball.A9";
iDP1.TX3_N.$assign                      = "ball.B7";
iDP1.TX3_P.$assign                      = "ball.A8";
iDP1.HPD.$assign                        = "ball.Y4";
const iDSI1                             = scripting.addPeripheral("DSI");
iDSI1.$name                             = "MyDSI1";
iDSI1.TXCLKN.$assign                    = "ball.E10";
iDSI1.TXCLKP.$assign                    = "ball.E11";
iDSI1.TXN0.$assign                      = "ball.D11";
iDSI1.TXN1.$assign                      = "ball.D12";
iDSI1.TXN2.$assign                      = "ball.B13";
iDSI1.TXN3.$assign                      = "ball.B14";
iDSI1.TXP0.$assign                      = "ball.C12";
iDSI1.TXP1.$assign                      = "ball.C13";
iDSI1.TXP2.$assign                      = "ball.A14";
iDSI1.TXP3.$assign                      = "ball.A15";
const iGPIO1                            = scripting.addPeripheral("GPIO");
iGPIO1["0"].$assign                     = "ball.AC18";
iGPIO1["0"].$used                       = true;
iGPIO1["97"].$assign                    = "ball.Y28";
iGPIO1["97"].$used                      = true;
iGPIO1["98"].$assign                    = "ball.V23";
iGPIO1["98"].$used                      = true;
iGPIO1["117"].$assign                   = "ball.W4";
iGPIO1["117"].$used                     = true;
iGPIO1["127"].$assign                   = "ball.AC4";
iGPIO1["127"].$used                     = true;
iGPIO1.$name                            = "MyGPIO0";
iGPIO1.$assign                          = "GPIO0";
const iGPIO2                            = scripting.addPeripheral("GPIO");
iGPIO2["0"].$assign                     = "ball.AD5";
iGPIO2["0"].$used                       = true;
iGPIO2["3"].$assign                     = "ball.W3";
iGPIO2["3"].$used                       = true;
iGPIO2["5"].$assign                     = "ball.W2";
iGPIO2["5"].$used                       = true;
iGPIO2["6"].$assign                     = "ball.W1";
iGPIO2["6"].$used                       = true;
iGPIO2["11"].$assign                    = "ball.U2";
iGPIO2["11"].$used                      = true;
iGPIO2["12"].$assign                    = "ball.U3";
iGPIO2["12"].$used                      = true;
iGPIO2["22"].$assign                    = "ball.R28";
iGPIO2["22"].$used                      = true;
iGPIO2["23"].$assign                    = "ball.T28";
iGPIO2["23"].$used                      = true;
iGPIO2["24"].$assign                    = "ball.T29";
iGPIO2["24"].$used                      = true;
iGPIO2["25"].$assign                    = "ball.T27";
iGPIO2["25"].$used                      = true;
iGPIO2["26"].$assign                    = "ball.T24";
iGPIO2["26"].$used                      = true;
iGPIO2.$name                            = "MyGPIO1";
iGPIO2.$assign                          = "GPIO1";
const iI2C1                             = scripting.addPeripheral("I2C");
iI2C1.$name                             = "MyI2C2";
iI2C1.$assign                           = "I2C2";
iI2C1.SCL.$assign                       = "ball.AA1";
iI2C1.SDA.$assign                       = "ball.AB5";
const iI2C2                             = scripting.addPeripheral("I2C");
iI2C2.$name                             = "MyI2C6";
iI2C2.$assign                           = "I2C6";
iI2C2.SCL.$assign                       = "ball.AA3";
iI2C2.SDA.$assign                       = "ball.Y2";
const iI2C3                             = scripting.addPeripheral("I2C");
iI2C3.$name                             = "MyI2C0";
iI2C3.$assign                           = "I2C0";
iI2C3.SCL.$assign                       = "ball.AC5";
iI2C3.SDA.$assign                       = "ball.AA5";
const iI2C4                             = scripting.addPeripheral("I2C");
iI2C4.$name                             = "MyI2C1";
iI2C4.$assign                           = "I2C1";
iI2C4.SCL.$assign                       = "ball.Y6";
iI2C4.SDA.$assign                       = "ball.AA6";
const iI2C5                             = scripting.addPeripheral("I2C");
iI2C5.$name                             = "MyI2C3";
iI2C5.$assign                           = "I2C3";
iI2C5.SCL.$assign                       = "ball.T26";
iI2C5.SDA.$assign                       = "ball.T25";
const iMCAN1                            = scripting.addPeripheral("MCAN");
iMCAN1.$name                            = "MyMCAN2";
iMCAN1.$assign                          = "MCAN2";
iMCAN1.RX.$assign                       = "ball.AC2";
iMCAN1.TX.$assign                       = "ball.AB1";
const iMCAN2                            = scripting.addPeripheral("MCAN");
iMCAN2.$name                            = "MyMCAN0";
iMCAN2.$assign                          = "MCAN0";
iMCAN2.RX.$assign                       = "ball.W5";
iMCAN2.TX.$assign                       = "ball.W6";
const iMCASP1                           = scripting.addPeripheral("MCASP");
iMCASP1.$name                           = "MyMCASP2";
iMCASP1.$assign                         = "MCASP2";
iMCASP1.ACLKX.$assign                   = "ball.AA29";
iMCASP1.AFSX.$assign                    = "ball.AA26";
iMCASP1.$pinGroup.AXR0.$used            = false;
iMCASP1.$pinGroup.AXR1.$used            = false;
iMCASP1.$pinGroup.AXR10.$used           = false;
iMCASP1.$pinGroup.AXR11.$used           = false;
iMCASP1.$pinGroup.AXR12.$used           = false;
iMCASP1.$pinGroup.AXR13.$used           = false;
iMCASP1.$pinGroup.AXR14.$used           = false;
iMCASP1.$pinGroup.AXR15.$used           = false;
iMCASP1.$pinGroup.AXR2.$used            = false;
iMCASP1.$pinGroup.AXR3.$assign          = "ball.Y25";
iMCASP1.$pinGroup.AXR4.$assign          = "ball.Y26";
iMCASP1.$pinGroup.AXR5.$used            = false;
iMCASP1.$pinGroup.AXR6.$used            = false;
iMCASP1.$pinGroup.AXR7.$used            = false;
iMCASP1.$pinGroup.AXR8.$used            = false;
iMCASP1.$pinGroup.AXR9.$used            = false;
const iMCASP2                           = scripting.addPeripheral("MCASP");
iMCASP2.$name                           = "MyMCASP10";
iMCASP2.$assign                         = "MCASP10";
iMCASP2.ACLKX.$assign                   = "ball.U23";
iMCASP2.AFSX.$assign                    = "ball.U26";
iMCASP2.$pinGroup.AXR0.$assign          = "ball.V28";
iMCASP2.$pinGroup.AXR1.$assign          = "ball.V29";
iMCASP2.$pinGroup.AXR10.$used           = false;
iMCASP2.$pinGroup.AXR11.$used           = false;
iMCASP2.$pinGroup.AXR12.$used           = false;
iMCASP2.$pinGroup.AXR13.$used           = false;
iMCASP2.$pinGroup.AXR14.$used           = false;
iMCASP2.$pinGroup.AXR15.$used           = false;
iMCASP2.$pinGroup.AXR2.$assign          = "ball.U29";
iMCASP2.$pinGroup.AXR3.$assign          = "ball.U25";
iMCASP2.$pinGroup.AXR4.$assign          = "ball.V25";
iMCASP2.$pinGroup.AXR5.$assign          = "ball.W27";
iMCASP2.$pinGroup.AXR6.$assign          = "ball.W29";
iMCASP2.$pinGroup.AXR7.$used            = false;
iMCASP2.$pinGroup.AXR8.$used            = false;
iMCASP2.$pinGroup.AXR9.$used            = false;
iMCASP2.$pinGroup.$numPins              = 7;
const iMCASP3                           = scripting.addPeripheral("MCASP");
iMCASP3.$name                           = "MyMCASP11";
iMCASP3.$assign                         = "MCASP11";
iMCASP3.ACLKX.$assign                   = "ball.V27";
iMCASP3.AFSX.$assign                    = "ball.U28";
iMCASP3.$pinGroup.AXR0.$assign          = "ball.U27";
iMCASP3.$pinGroup.AXR1.$assign          = "ball.U24";
iMCASP3.$pinGroup.AXR10.$used           = false;
iMCASP3.$pinGroup.AXR11.$used           = false;
iMCASP3.$pinGroup.AXR12.$used           = false;
iMCASP3.$pinGroup.AXR13.$used           = false;
iMCASP3.$pinGroup.AXR14.$used           = false;
iMCASP3.$pinGroup.AXR15.$used           = false;
iMCASP3.$pinGroup.AXR2.$assign          = "ball.R23";
iMCASP3.$pinGroup.AXR3.$assign          = "ball.T23";
iMCASP3.$pinGroup.AXR4.$assign          = "ball.Y29";
iMCASP3.$pinGroup.AXR5.$assign          = "ball.Y27";
iMCASP3.$pinGroup.AXR6.$assign          = "ball.W24";
iMCASP3.$pinGroup.AXR7.$assign          = "ball.W25";
iMCASP3.$pinGroup.AXR8.$used            = false;
iMCASP3.$pinGroup.AXR9.$used            = false;
iMCASP3.$pinGroup.$numPins              = 8;
const iMCU_ADC1                         = scripting.addPeripheral("MCU_ADC");
iMCU_ADC1.$useCase                      = "ADC_0";
iMCU_ADC1.$name                         = "MyMCU_ADC0";
iMCU_ADC1.AIN0.$assign                  = "ball.K25";
iMCU_ADC1.AIN0.$used                    = true;
iMCU_ADC1.AIN1.$assign                  = "ball.K26";
iMCU_ADC1.AIN1.$used                    = true;
iMCU_ADC1.AIN2.$assign                  = "ball.K28";
iMCU_ADC1.AIN2.$used                    = true;
iMCU_ADC1.AIN3.$assign                  = "ball.L28";
iMCU_ADC1.AIN3.$used                    = true;
iMCU_ADC1.AIN4.$assign                  = "ball.K24";
iMCU_ADC1.AIN4.$used                    = true;
iMCU_ADC1.AIN5.$assign                  = "ball.K27";
iMCU_ADC1.AIN5.$used                    = true;
iMCU_ADC1.AIN6.$assign                  = "ball.K29";
iMCU_ADC1.AIN6.$used                    = true;
iMCU_ADC1.AIN7.$assign                  = "ball.L29";
iMCU_ADC1.AIN7.$used                    = true;
const iMCU_FSS0_OSPI1                   = scripting.addPeripheral("MCU_FSS0_OSPI");
iMCU_FSS0_OSPI1.$name                   = "MyMCU_OSPI0";
iMCU_FSS0_OSPI1.$assign                 = "MCU_OSPI0";
iMCU_FSS0_OSPI1.CLK.$assign             = "ball.E20";
iMCU_FSS0_OSPI1.CSn0.$assign            = "ball.F19";
iMCU_FSS0_OSPI1.CSn1.$used              = false;
iMCU_FSS0_OSPI1.CSn2.$used              = false;
iMCU_FSS0_OSPI1.CSn3.$used              = false;
iMCU_FSS0_OSPI1.D0.$assign              = "ball.D20";
iMCU_FSS0_OSPI1.D1.$assign              = "ball.G19";
iMCU_FSS0_OSPI1.D2.$assign              = "ball.G20";
iMCU_FSS0_OSPI1.D3.$assign              = "ball.F20";
iMCU_FSS0_OSPI1.D4.$assign              = "ball.F21";
iMCU_FSS0_OSPI1.D5.$assign              = "ball.E21";
iMCU_FSS0_OSPI1.D6.$assign              = "ball.B22";
iMCU_FSS0_OSPI1.D7.$assign              = "ball.G21";
iMCU_FSS0_OSPI1.DQS.$assign             = "ball.D21";
iMCU_FSS0_OSPI1.LBCLKO.$used            = false;
iMCU_FSS0_OSPI1.ECC_FAIL.$used          = false;
iMCU_FSS0_OSPI1.RESET_OUT0.$used        = false;
iMCU_FSS0_OSPI1.RESET_OUT1.$used        = false;
const iMCU_FSS0_OSPI2                   = scripting.addPeripheral("MCU_FSS0_OSPI");
iMCU_FSS0_OSPI2.$name                   = "MyMCU_OSPI1";
iMCU_FSS0_OSPI2.$assign                 = "MCU_OSPI1";
iMCU_FSS0_OSPI2.CLK.$assign             = "ball.F22";
iMCU_FSS0_OSPI2.CSn0.$assign            = "ball.C22";
iMCU_FSS0_OSPI2.CSn1.$used              = false;
iMCU_FSS0_OSPI2.CSn2.$used              = false;
iMCU_FSS0_OSPI2.CSn3.$used              = false;
iMCU_FSS0_OSPI2.D0.$assign              = "ball.D22";
iMCU_FSS0_OSPI2.D1.$assign              = "ball.G22";
iMCU_FSS0_OSPI2.D2.$assign              = "ball.D23";
iMCU_FSS0_OSPI2.D3.$assign              = "ball.C23";
iMCU_FSS0_OSPI2.D4.$used                = false;
iMCU_FSS0_OSPI2.D5.$used                = false;
iMCU_FSS0_OSPI2.D6.$used                = false;
iMCU_FSS0_OSPI2.D7.$used                = false;
iMCU_FSS0_OSPI2.DQS.$assign             = "ball.B23";
iMCU_FSS0_OSPI2.LBCLKO.$assign          = "ball.A23";
iMCU_FSS0_OSPI2.ECC_FAIL.$used          = false;
iMCU_FSS0_OSPI2.RESET_OUT0.$used        = false;
iMCU_FSS0_OSPI2.RESET_OUT1.$used        = false;
const iMCU_I2C1                         = scripting.addPeripheral("MCU_I2C");
iMCU_I2C1.$name                         = "MyMCU_I2C0";
iMCU_I2C1.$assign                       = "MCU_I2C0";
iMCU_I2C1.SCL.$assign                   = "ball.J26";
iMCU_I2C1.SDA.$assign                   = "ball.H25";
const iMCU_I3C1                         = scripting.addPeripheral("MCU_I3C");
iMCU_I3C1.$name                         = "MyMCU_I3C0";
iMCU_I3C1.SCL.$assign                   = "ball.D26";
iMCU_I3C1.SDA.$assign                   = "ball.D25";
iMCU_I3C1.SDAPULLEN.$assign             = "ball.E26";
const iMCU_MCAN1                        = scripting.addPeripheral("MCU_MCAN");
iMCU_MCAN1.$name                        = "MyMCU_MCAN0";
iMCU_MCAN1.$assign                      = "MCU_MCAN0";
iMCU_MCAN1.RX.$assign                   = "ball.C29";
iMCU_MCAN1.TX.$assign                   = "ball.D29";
const iMCU_MCAN2                        = scripting.addPeripheral("MCU_MCAN");
iMCU_MCAN2.$name                        = "MyMCU_MCAN1";
iMCU_MCAN2.$assign                      = "MCU_MCAN1";
iMCU_MCAN2.RX.$assign                   = "ball.G24";
iMCU_MCAN2.TX.$assign                   = "ball.G25";
const iMCU_MDIO1                        = scripting.addPeripheral("MCU_MDIO");
iMCU_MDIO1.$name                        = "MyMCU_MDIO1";
iMCU_MDIO1.MDC.$assign                  = "ball.F23";
iMCU_MDIO1.MDIO.$assign                 = "ball.E23";
const iMCU_RGMII1                       = scripting.addPeripheral("MCU_RGMII");
iMCU_RGMII1.$name                       = "MyMCU_RGMII1";
iMCU_RGMII1.RD0.$assign                 = "ball.B24";
iMCU_RGMII1.RD1.$assign                 = "ball.A24";
iMCU_RGMII1.RD2.$assign                 = "ball.D24";
iMCU_RGMII1.RD3.$assign                 = "ball.A25";
iMCU_RGMII1.RXC.$assign                 = "ball.C24";
iMCU_RGMII1.RX_CTL.$assign              = "ball.C25";
iMCU_RGMII1.TD0.$assign                 = "ball.B25";
iMCU_RGMII1.TD1.$assign                 = "ball.A26";
iMCU_RGMII1.TD2.$assign                 = "ball.A27";
iMCU_RGMII1.TD3.$assign                 = "ball.A28";
iMCU_RGMII1.TXC.$assign                 = "ball.B26";
iMCU_RGMII1.TX_CTL.$assign              = "ball.B27";
const iMCU_UART1                        = scripting.addPeripheral("MCU_UART");
iMCU_UART1.$name                        = "MyMCU_UART0";
iMCU_UART1.CTSn.$assign                 = "ball.H29";
iMCU_UART1.RTSn.$assign                 = "ball.J27";
iMCU_UART1.RXD.$assign                  = "ball.H28";
iMCU_UART1.TXD.$assign                  = "ball.G29";
const iMDIO1                            = scripting.addPeripheral("MDIO");
iMDIO1.$name                            = "MyMDIO1";
iMDIO1.MDC.$assign                      = "ball.V24";
iMDIO1.MDIO.$assign                     = "ball.V26";
const iMLB1                             = scripting.addPeripheral("MLB");
iMLB1.$name                             = "MyMLB0";
iMLB1.MLBCN.$assign                     = "ball.AE2";
iMLB1.MLBCP.$assign                     = "ball.AD2";
iMLB1.MLBDN.rx                          = false;
iMLB1.MLBDN.$assign                     = "ball.AD3";
iMLB1.MLBDP.rx                          = false;
iMLB1.MLBDP.$assign                     = "ball.AC3";
iMLB1.MLBSN.rx                          = false;
iMLB1.MLBSN.$assign                     = "ball.AC1";
iMLB1.MLBSP.rx                          = false;
iMLB1.MLBSP.$assign                     = "ball.AD1";
iMLB1.MLBCLK.$used                      = false;
iMLB1.MLBDAT.$used                      = false;
iMLB1.MLBSIG.$used                      = false;
const iMMCSD1                           = scripting.addPeripheral("MMCSD");
iMMCSD1.$name                           = "MyMMC0";
iMMCSD1.CMD.$assign                     = "ball.AE3";
iMMCSD1.CLK.$assign                     = "ball.AF1";
iMMCSD1.DS.$assign                      = "ball.AE4";
iMMCSD1.DAT0.$assign                    = "ball.AG2";
iMMCSD1.DAT1.$assign                    = "ball.AH1";
iMMCSD1.DAT2.$assign                    = "ball.AG3";
iMMCSD1.DAT3.$assign                    = "ball.AF4";
iMMCSD1.DAT4.$assign                    = "ball.AE5";
iMMCSD1.DAT5.$assign                    = "ball.AF3";
iMMCSD1.DAT6.$assign                    = "ball.AG1";
iMMCSD1.DAT7.$assign                    = "ball.AF2";
iMMCSD1.SDCD.$used                      = false;
iMMCSD1.SDWP.$used                      = false;
const iMMCSD2                           = scripting.addPeripheral("MMCSD");
iMMCSD2.$name                           = "MyMMC1";
iMMCSD2.$assign                         = "MMC1";
iMMCSD2.CMD.pu_pd                       = "pu";
iMMCSD2.CLK.pu_pd                       = "pu";
iMMCSD2.DS.$used                        = false;
iMMCSD2.DAT0.pu_pd                      = "pu";
iMMCSD2.DAT1.pu_pd                      = "pu";
iMMCSD2.DAT2.pu_pd                      = "pu";
iMMCSD2.DAT3.pu_pd                      = "pu";
iMMCSD2.DAT4.$used                      = false;
iMMCSD2.DAT5.$used                      = false;
iMMCSD2.DAT6.$used                      = false;
iMMCSD2.DAT7.$used                      = false;
iMMCSD2.SDCD.pu_pd                      = "pu";
iMMCSD2.SDWP.$used                      = false;
const iSERDES1                          = scripting.addPeripheral("SERDES");
iSERDES1.$name                          = "MySERDES4";
iSERDES1.REFCLK_N.$assign               = "ball.E7";
iSERDES1.REFCLK_P.$assign               = "ball.E8";
const iSYSTEM1                          = scripting.addPeripheral("SYSTEM");
iSYSTEM1.$name                          = "MySYSTEM1";
iSYSTEM1.AUDIO_EXT_REFCLK0.$used        = false;
iSYSTEM1.AUDIO_EXT_REFCLK1.$assign      = "ball.AE20";
iSYSTEM1.AUDIO_EXT_REFCLK2.$assign      = "ball.W26";
iSYSTEM1.AUDIO_EXT_REFCLK3.$used        = false;
iSYSTEM1.EXTINTn.$assign                = "ball.AC18";
iSYSTEM1.EXTINTn.$used                  = false;
iSYSTEM1.EXT_REFCLK1.$used              = false;
iSYSTEM1.FCLK_MUX.$used                 = false;
iSYSTEM1.OBSCLK0.$assign                = "ball.V5";
iSYSTEM1.OBSCLK1.$used                  = false;
iSYSTEM1.OBSCLK2.$used                  = false;
iSYSTEM1.PORz_OUT.$assign               = "ball.U1";
iSYSTEM1.RESETSTATz.$assign             = "ball.T6";
iSYSTEM1.SOC_SAFETY_ERRORn.$assign      = "ball.U4";
iSYSTEM1.SYNC0_OUT.$used                = false;
iSYSTEM1.SYNC1_OUT.$used                = false;
iSYSTEM1.SYNC2_OUT.$used                = false;
iSYSTEM1.SYNC3_OUT.$used                = false;
iSYSTEM1.SYSCLKOUT0.$assign             = "ball.V6";
const iUART1                            = scripting.addPeripheral("UART");
iUART1.$name                            = "MyUART4";
iUART1.$assign                          = "USART4";
iUART1.CTSn.$used                       = false;
iUART1.DCDn.$used                       = false;
iUART1.DSRn.$used                       = false;
iUART1.DTRn.$used                       = false;
iUART1.RIn.$used                        = false;
iUART1.RTSn.$used                       = false;
iUART1.RXD.$assign                      = "ball.W23";
iUART1.TXD.$assign                      = "ball.W28";
const iUART2                            = scripting.addPeripheral("UART");
iUART2.$name                            = "MyUART0";
iUART2.$assign                          = "USART0";
iUART2.CTSn.$assign                     = "ball.Y3";
iUART2.DCDn.$used                       = false;
iUART2.DSRn.$used                       = false;
iUART2.DTRn.$used                       = false;
iUART2.RIn.$used                        = false;
iUART2.RTSn.$assign                     = "ball.AA2";
iUART2.RXD.$assign                      = "ball.AB2";
iUART2.TXD.$assign                      = "ball.AB3";
const iUART3                            = scripting.addPeripheral("UART");
iUART3.$name                            = "MyUART2";
iUART3.$assign                          = "USART2";
iUART3.CTSn.$used                       = false;
iUART3.DCDn.$used                       = false;
iUART3.DSRn.$used                       = false;
iUART3.DTRn.$used                       = false;
iUART3.RIn.$used                        = false;
iUART3.RTSn.$used                       = false;
iUART3.RXD.$assign                      = "ball.Y1";
iUART3.TXD.$assign                      = "ball.Y5";
const iUART4                            = scripting.addPeripheral("UART");
iUART4.$name                            = "MyUART1";
iUART4.$assign                          = "USART1";
iUART4.CTSn.$used                       = false;
iUART4.DCDn.$used                       = false;
iUART4.DSRn.$used                       = false;
iUART4.DTRn.$used                       = false;
iUART4.RIn.$used                        = false;
iUART4.RTSn.$used                       = false;
iUART4.RXD.$assign                      = "ball.AA4";
iUART4.TXD.$assign                      = "ball.AB4";
const iUFS1                             = scripting.addPeripheral("UFS");
iUFS1.$name                             = "MyUFS0";
iUFS1.REF_CLK.$assign                   = "ball.AE6";
iUFS1.RSTn.$assign                      = "ball.AD6";
iUFS1.RX_DN0.$assign                    = "ball.AH3";
iUFS1.RX_DN1.$assign                    = "ball.AH4";
iUFS1.RX_DP0.$assign                    = "ball.AJ2";
iUFS1.RX_DP1.$assign                    = "ball.AJ3";
iUFS1.TX_DN0.$assign                    = "ball.AG6";
iUFS1.TX_DN1.$assign                    = "ball.AG5";
iUFS1.TX_DP0.$assign                    = "ball.AF7";
iUFS1.TX_DP1.$assign                    = "ball.AF6";
const iUSB1                             = scripting.addPeripheral("USB");
iUSB1.$name                             = "MyUSB1";
iUSB1.$assign                           = "USB0";
iUSB1.DM.$used                          = false;
iUSB1.DP.$used                          = false;
iUSB1.DRVVBUS.$assign                   = "ball.U6";
iUSB1.ID.$used                          = false;
iUSB1.VBUS.$used                        = false;
iUSB1.SSRX2N.$used                      = false;
iUSB1.SSRX2P.$used                      = false;
iUSB1.SSTX2N.$used                      = false;
iUSB1.SSTX2P.$used                      = false;
iUSB1.SSRX1N.$used                      = false;
iUSB1.SSRX1P.$used                      = false;
iUSB1.SSTX1N.$used                      = false;
iUSB1.SSTX1P.$used                      = false;
const iUSB2                             = scripting.addPeripheral("USB");
iUSB2.$name                             = "MyUSB2";
iUSB2.$assign                           = "USB1";
iUSB2.DM.$used                          = false;
iUSB2.DP.$used                          = false;
iUSB2.DRVVBUS.$assign                   = "ball.V4";
iUSB2.ID.$used                          = false;
iUSB2.VBUS.$used                        = false;
iUSB2.SSRX2N.$used                      = false;
iUSB2.SSRX2P.$used                      = false;
iUSB2.SSTX2N.$used                      = false;
iUSB2.SSTX2P.$used                      = false;
iUSB2.SSRX1N.$used                      = false;
iUSB2.SSRX1P.$used                      = false;
iUSB2.SSTX1N.$used                      = false;
iUSB2.SSTX1P.$used                      = false;
const iWKUP_DEBUGSS1                    = scripting.addPeripheral("WKUP_DEBUGSS");
iWKUP_DEBUGSS1.$name                    = "MyWKUP_DEBUG";
iWKUP_DEBUGSS1.EMU0.$assign             = "ball.C26";
iWKUP_DEBUGSS1.EMU1.$assign             = "ball.B29";
iWKUP_DEBUGSS1.TCK.$assign              = "ball.E29";
iWKUP_DEBUGSS1.TRSTn.$assign            = "ball.F24";
const iWKUP_GPIO1                       = scripting.addPeripheral("WKUP_GPIO");
iWKUP_GPIO1["0"].$used                  = true;
iWKUP_GPIO1["1"].$used                  = true;
iWKUP_GPIO1["2"].$used                  = true;
iWKUP_GPIO1["3"].$used                  = true;
iWKUP_GPIO1["6"].$assign                = "ball.F29";
iWKUP_GPIO1["6"].$used                  = true;
iWKUP_GPIO1["7"].$used                  = true;
iWKUP_GPIO1["8"].$used                  = true;
iWKUP_GPIO1["9"].$used                  = true;
iWKUP_GPIO1["17"].$assign               = "ball.C21";
iWKUP_GPIO1["17"].$used                 = true;
iWKUP_GPIO1["53"].$used                 = true;
iWKUP_GPIO1["54"].$used                 = true;
iWKUP_GPIO1["55"].$used                 = true;
iWKUP_GPIO1.$name                       = "MyWKUP_GPIO0";
const iWKUP_I2C1                        = scripting.addPeripheral("WKUP_I2C");
iWKUP_I2C1.$name                        = "MyWKUP_I2C0";
iWKUP_I2C1.SCL.$assign                  = "ball.J25";
iWKUP_I2C1.SDA.$assign                  = "ball.H24";
const iWKUP_SYSTEM1                     = scripting.addPeripheral("WKUP_SYSTEM");
iWKUP_SYSTEM1.$name                     = "MyWKUP_SYSTEM";
iWKUP_SYSTEM1.MCU_CLKOUT0.$used         = false;
iWKUP_SYSTEM1.MCU_EXT_REFCLK0.$used     = false;
iWKUP_SYSTEM1.MCU_OBSCLK0.$used         = false;
iWKUP_SYSTEM1.MCU_PORz.$assign          = "ball.H23";
iWKUP_SYSTEM1.MCU_PORz_OUT.$assign      = "ball.B28";
iWKUP_SYSTEM1.MCU_RESETSTATz.$assign    = "ball.C27";
iWKUP_SYSTEM1.MCU_RESETz.$assign        = "ball.D28";
iWKUP_SYSTEM1.MCU_SAFETY_ERRORn.$assign = "ball.D27";
iWKUP_SYSTEM1.MCU_SYSCLKOUT0.$used      = false;
iWKUP_SYSTEM1.PMIC_POWER_EN1.$assign    = "ball.G23";
iWKUP_SYSTEM1.PORz.$assign              = "ball.J24";
iWKUP_SYSTEM1.RESET_REQz.$assign        = "ball.C28";
const iWKUP_UART1                       = scripting.addPeripheral("WKUP_UART");
iWKUP_UART1.$name                       = "MyWKUP_UART0";
iWKUP_UART1.CTSn.$used                  = false;
iWKUP_UART1.RTSn.$used                  = false;
iWKUP_UART1.RXD.$assign                 = "ball.J29";
iWKUP_UART1.TXD.$assign                 = "ball.J28";

/**
 * Pinmux solution for unlocked pins/peripherals. This ensures that minor changes to the automatic solver in a future
 * version of the tool will not impact the pinmux you originally saw.  These lines can be completely deleted in order to
 * re-solve from scratch.
 */
iDDRSS1.$suggestSolution           = "DDR0";
iDEBUGSS1.$suggestSolution         = "DEBUG0";
iDP1.$suggestSolution              = "DP0";
iDSI1.$suggestSolution             = "DSI_TX0";
iMCU_ADC1.$suggestSolution         = "MCU_ADC0";
iMCU_I3C1.$suggestSolution         = "MCU_I3C0";
iMCU_MDIO1.$suggestSolution        = "MCU_MDIO0";
iMCU_RGMII1.$suggestSolution       = "MCU_RGMII1";
iMCU_UART1.$suggestSolution        = "MCU_USART0";
iMDIO1.$suggestSolution            = "MDIO0";
iMLB1.$suggestSolution             = "MLB0";
iMMCSD1.$suggestSolution           = "MMC0";
iMMCSD2.CMD.$suggestSolution       = "ball.R29";
iMMCSD2.CLK.$suggestSolution       = "ball.P25";
iMMCSD2.DAT0.$suggestSolution      = "ball.R24";
iMMCSD2.DAT1.$suggestSolution      = "ball.P24";
iMMCSD2.DAT2.$suggestSolution      = "ball.R25";
iMMCSD2.DAT3.$suggestSolution      = "ball.R26";
iMMCSD2.SDCD.$suggestSolution      = "ball.P23";
iSERDES1.$suggestSolution          = "SERDES4";
iSYSTEM1.$suggestSolution          = "SYSTEM0";
iSYSTEM1.REF_CLK.$suggestSolution  = "ball.AD18";
iUFS1.$suggestSolution             = "UFS0";
iWKUP_DEBUGSS1.$suggestSolution    = "WKUP_DEBUG0";
iWKUP_GPIO1["0"].$suggestSolution  = "ball.F26";
iWKUP_GPIO1["1"].$suggestSolution  = "ball.F25";
iWKUP_GPIO1["2"].$suggestSolution  = "ball.F28";
iWKUP_GPIO1["3"].$suggestSolution  = "ball.F27";
iWKUP_GPIO1["7"].$suggestSolution  = "ball.G28";
iWKUP_GPIO1["8"].$suggestSolution  = "ball.G27";
iWKUP_GPIO1["9"].$suggestSolution  = "ball.G26";
iWKUP_GPIO1["53"].$suggestSolution = "ball.E24";
iWKUP_GPIO1["54"].$suggestSolution = "ball.E28";
iWKUP_GPIO1["55"].$suggestSolution = "ball.E25";
iWKUP_GPIO1.$suggestSolution       = "WKUP_GPIO0";
iWKUP_I2C1.$suggestSolution        = "WKUP_I2C0";
iWKUP_SYSTEM1.$suggestSolution     = "WKUP_SYSTEM0";
iWKUP_UART1.$suggestSolution       = "WKUP_USART0";
