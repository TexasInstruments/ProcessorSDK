/**
 * @cliArgs --device "J721E_DRA829_TDA4VM_AM752x" --package "ALF" --part "Default"
 * @versions {"tool":"1.11.0+2225"}
 */

/**
 * These are the peripherals and settings in this configuration
 */
const iEHRPWM1                            = scripting.addPeripheral("EHRPWM");
iEHRPWM1.$name                            = "MyEHRPWM0";
iEHRPWM1.A.$assign                        = "ball.V29";
iEHRPWM1.B.$assign                        = "ball.V27";
iEHRPWM1.SYNCI.$assign                    = "ball.U23";
iEHRPWM1.SYNCO.$assign                    = "ball.U26";
const iEHRPWM2                            = scripting.addPeripheral("EHRPWM");
iEHRPWM2.$name                            = "MyEHRPWM1";
iEHRPWM2.$assign                          = "EHRPWM1";
iEHRPWM2.A.$assign                        = "ball.U28";
iEHRPWM2.B.$assign                        = "ball.U29";
iEHRPWM2.SYNCI.$used                      = false;
iEHRPWM2.SYNCO.$used                      = false;
const iEHRPWM3                            = scripting.addPeripheral("EHRPWM");
iEHRPWM3.$name                            = "MyEHRPWM2";
iEHRPWM3.$assign                          = "EHRPWM2";
iEHRPWM3.A.$assign                        = "ball.U27";
iEHRPWM3.B.$assign                        = "ball.U24";
iEHRPWM3.SYNCI.$used                      = false;
iEHRPWM3.SYNCO.$used                      = false;
const iEQEP1                              = scripting.addPeripheral("EQEP");
iEQEP1.$name                              = "MyEQEP0";
iEQEP1.$assign                            = "EQEP0";
iEQEP1.A_in.$assign                       = "ball.AC2";
iEQEP1.B_in.$assign                       = "ball.AB1";
iEQEP1.Index.$assign                      = "ball.AD5";
iEQEP1.Strobe.$assign                     = "ball.AC4";
const iGPIO1                              = scripting.addPeripheral("GPIO");
iGPIO1["60"].$assign                      = "ball.AB24";
iGPIO1["60"].$used                        = true;
iGPIO1["61"].$assign                      = "ball.AB29";
iGPIO1["61"].$used                        = true;
iGPIO1["62"].$assign                      = "ball.AB28";
iGPIO1["62"].$used                        = true;
iGPIO1["68"].$assign                      = "ball.AB27";
iGPIO1["68"].$used                        = true;
iGPIO1["96"].$assign                      = "ball.T23";
iGPIO1["96"].$used                        = true;
iGPIO1.$name                              = "MyGPIO1";
const iGPIO2                              = scripting.addPeripheral("GPIO");
iGPIO2["23"].$assign                      = "ball.T28";
iGPIO2["23"].$used                        = true;
iGPIO2["24"].$assign                      = "ball.T29";
iGPIO2["24"].$used                        = true;
iGPIO2.$name                              = "MyGPIO2";
iGPIO2.$assign                            = "GPIO1";
const iMCAN1                              = scripting.addPeripheral("MCAN");
iMCAN1.$name                              = "MyMCAN6";
iMCAN1.$assign                            = "MCAN6";
iMCAN1.RX.$assign                         = "ball.AG21";
iMCAN1.TX.$assign                         = "ball.AH21";
const iMCAN2                              = scripting.addPeripheral("MCAN");
iMCAN2.$name                              = "MyMCAN7";
iMCAN2.$assign                            = "MCAN7";
iMCAN2.RX.$assign                         = "ball.Y23";
iMCAN2.TX.$assign                         = "ball.AC21";
const iMCAN3                              = scripting.addPeripheral("MCAN");
iMCAN3.$name                              = "MyMCAN9";
iMCAN3.$assign                            = "MCAN9";
iMCAN3.RX.$assign                         = "ball.AC27";
iMCAN3.TX.$assign                         = "ball.AC28";
const iMCAN4                              = scripting.addPeripheral("MCAN");
iMCAN4.$name                              = "MyMCAN11";
iMCAN4.$assign                            = "MCAN11";
iMCAN4.RX.$assign                         = "ball.AA28";
iMCAN4.TX.$assign                         = "ball.AA24";
const iMCAN5                              = scripting.addPeripheral("MCAN");
iMCAN5.$name                              = "MyMCAN5";
iMCAN5.$assign                            = "MCAN5";
iMCAN5.RX.$assign                         = "ball.AE21";
iMCAN5.TX.$assign                         = "ball.AJ21";
const iMCAN6                              = scripting.addPeripheral("MCAN");
iMCAN6.$name                              = "MyMCAN4";
iMCAN6.$assign                            = "MCAN4";
iMCAN6.RX.$assign                         = "ball.AJ20";
iMCAN6.TX.$assign                         = "ball.AE20";
const iMCU_ADC1                           = scripting.addPeripheral("MCU_ADC");
iMCU_ADC1.$useCase                        = "ADC_0";
iMCU_ADC1.$name                           = "MyMCU_ADC1";
iMCU_ADC1.$assign                         = "MCU_ADC1";
iMCU_ADC1.AIN0.$assign                    = "ball.N23";
iMCU_ADC1.AIN0.$used                      = true;
iMCU_ADC1.AIN1.$assign                    = "ball.M25";
iMCU_ADC1.AIN1.$used                      = true;
iMCU_ADC1.AIN2.$assign                    = "ball.L24";
iMCU_ADC1.AIN2.$used                      = true;
iMCU_ADC1.AIN3.$assign                    = "ball.L26";
iMCU_ADC1.AIN3.$used                      = true;
iMCU_ADC1.AIN4.$assign                    = "ball.N24";
iMCU_ADC1.AIN4.$used                      = true;
iMCU_ADC1.AIN5.$assign                    = "ball.M24";
iMCU_ADC1.AIN5.$used                      = true;
iMCU_ADC1.AIN6.$assign                    = "ball.L25";
iMCU_ADC1.AIN6.$used                      = true;
iMCU_ADC1.AIN7.$assign                    = "ball.L27";
iMCU_ADC1.AIN7.$used                      = true;
const iMDIO1                              = scripting.addPeripheral("MDIO");
iMDIO1.$name                              = "MyMDIO1";
iMDIO1.MDC.$assign                        = "ball.V24";
iMDIO1.MDIO.$assign                       = "ball.V26";
const iPRU_ICSSG0_MDIO1                   = scripting.addPeripheral("PRU_ICSSG0_MDIO");
iPRU_ICSSG0_MDIO1.$name                   = "MyPRU_ICSSG0_MDIO1";
iPRU_ICSSG0_MDIO1.MDC.$assign             = "ball.AA27";
iPRU_ICSSG0_MDIO1.MDIO.$assign            = "ball.Y26";
const iPRU_ICSSG0_RGMII1                  = scripting.addPeripheral("PRU_ICSSG0_RGMII");
iPRU_ICSSG0_RGMII1.$name                  = "MyPRU_ICSSG0_RGMII1";
iPRU_ICSSG0_RGMII1.$assign                = "PRU_ICSSG0_RGMII1";
iPRU_ICSSG0_RGMII1.RD0.$assign            = "ball.AF28";
iPRU_ICSSG0_RGMII1.RD1.$assign            = "ball.AE28";
iPRU_ICSSG0_RGMII1.RD2.$assign            = "ball.AE27";
iPRU_ICSSG0_RGMII1.RD3.$assign            = "ball.AD26";
iPRU_ICSSG0_RGMII1.RXC.$assign            = "ball.AE26";
iPRU_ICSSG0_RGMII1.RX_CTL.$assign         = "ball.AD25";
iPRU_ICSSG0_RGMII1.TD0.$assign            = "ball.AJ28";
iPRU_ICSSG0_RGMII1.TD1.$assign            = "ball.AH27";
iPRU_ICSSG0_RGMII1.TD2.$assign            = "ball.AH29";
iPRU_ICSSG0_RGMII1.TD3.$assign            = "ball.AG28";
iPRU_ICSSG0_RGMII1.TXC.$assign            = "ball.AH28";
iPRU_ICSSG0_RGMII1.TX_CTL.$assign         = "ball.AG27";
const iPRU_ICSSG0_RGMII2                  = scripting.addPeripheral("PRU_ICSSG0_RGMII");
iPRU_ICSSG0_RGMII2.$name                  = "MyPRU_ICSSG0_RGMII2";
iPRU_ICSSG0_RGMII2.$assign                = "PRU_ICSSG0_RGMII2";
iPRU_ICSSG0_RGMII2.RD0.$assign            = "ball.AE29";
iPRU_ICSSG0_RGMII2.RD1.$assign            = "ball.AD28";
iPRU_ICSSG0_RGMII2.RD2.$assign            = "ball.AD27";
iPRU_ICSSG0_RGMII2.RD3.$assign            = "ball.AC25";
iPRU_ICSSG0_RGMII2.RXC.$assign            = "ball.AC26";
iPRU_ICSSG0_RGMII2.RX_CTL.$assign         = "ball.AD29";
iPRU_ICSSG0_RGMII2.TD0.$assign            = "ball.AG26";
iPRU_ICSSG0_RGMII2.TD1.$assign            = "ball.AF27";
iPRU_ICSSG0_RGMII2.TD2.$assign            = "ball.AF26";
iPRU_ICSSG0_RGMII2.TD3.$assign            = "ball.AE25";
iPRU_ICSSG0_RGMII2.TXC.$assign            = "ball.AG29";
iPRU_ICSSG0_RGMII2.TX_CTL.$assign         = "ball.AF29";
const iPRU_ICSSG1_IEP1                    = scripting.addPeripheral("PRU_ICSSG1_IEP");
iPRU_ICSSG1_IEP1.$name                    = "MyPRU_ICSSG1_IEP1";
iPRU_ICSSG1_IEP1.EDC_LATCH_IN0.$used      = false;
iPRU_ICSSG1_IEP1.EDC_LATCH_IN1.$used      = false;
iPRU_ICSSG1_IEP1.EDC_SYNC_OUT0.$used      = false;
iPRU_ICSSG1_IEP1.EDC_SYNC_OUT1.$used      = false;
iPRU_ICSSG1_IEP1.EDIO_DATA_IN_OUT28.$used = false;
iPRU_ICSSG1_IEP1.EDIO_DATA_IN_OUT29.$used = false;
iPRU_ICSSG1_IEP1.EDIO_DATA_IN_OUT30.$used = false;
iPRU_ICSSG1_IEP1.EDIO_DATA_IN_OUT31.$used = false;
iPRU_ICSSG1_IEP1.EDIO_OUTVALID.$assign    = "ball.Y4";
const iPRU_ICSSG1_MDIO1                   = scripting.addPeripheral("PRU_ICSSG1_MDIO");
iPRU_ICSSG1_MDIO1.$name                   = "MyPRU_ICSSG1_MDIO1";
iPRU_ICSSG1_MDIO1.MDC.$assign             = "ball.AD18";
iPRU_ICSSG1_MDIO1.MDIO.$assign            = "ball.AD19";
const iPRU_ICSSG1_PRU1                    = scripting.addPeripheral("PRU_ICSSG1_PRU");
iPRU_ICSSG1_PRU1.$useCase                 = "PRU_ICSSG1_PRU_9";
iPRU_ICSSG1_PRU1.$name                    = "MyPRU_ICSSG1_PRU2";
iPRU_ICSSG1_PRU1.$assign                  = "PRU_ICSSG1_PRU0";
iPRU_ICSSG1_PRU1.GPO10.$assign            = "ball.AD21";
iPRU_ICSSG1_PRU1.GPO10.$used              = true;
const iPRU_ICSSG1_PWM1                    = scripting.addPeripheral("PRU_ICSSG1_PWM");
iPRU_ICSSG1_PWM1.$name                    = "MyPRU_ICSSG1_PWM3";
iPRU_ICSSG1_PWM1.$assign                  = "PRU_ICSSG1_PWM3";
iPRU_ICSSG1_PWM1.A0.$used                 = false;
iPRU_ICSSG1_PWM1.A1.$used                 = false;
iPRU_ICSSG1_PWM1.A2.$used                 = false;
iPRU_ICSSG1_PWM1.B0.$used                 = false;
iPRU_ICSSG1_PWM1.B1.$used                 = false;
iPRU_ICSSG1_PWM1.B2.$assign               = "ball.AD20";
iPRU_ICSSG1_PWM1.TZ_IN.$used              = false;
iPRU_ICSSG1_PWM1.TZ_OUT.$used             = false;
const iPRU_ICSSG1_RGMII1                  = scripting.addPeripheral("PRU_ICSSG1_RGMII");
iPRU_ICSSG1_RGMII1.$name                  = "MyPRU_ICSSG1_RGMII1";
iPRU_ICSSG1_RGMII1.$assign                = "PRU_ICSSG1_RGMII1";
iPRU_ICSSG1_RGMII1.RD0.$assign            = "ball.AC23";
iPRU_ICSSG1_RGMII1.RD1.$assign            = "ball.AG22";
iPRU_ICSSG1_RGMII1.RD2.$assign            = "ball.AF22";
iPRU_ICSSG1_RGMII1.RD3.$assign            = "ball.AJ23";
iPRU_ICSSG1_RGMII1.RXC.$assign            = "ball.AD22";
iPRU_ICSSG1_RGMII1.RX_CTL.$assign         = "ball.AH23";
iPRU_ICSSG1_RGMII1.TD0.$assign            = "ball.AF24";
iPRU_ICSSG1_RGMII1.TD1.$assign            = "ball.AJ24";
iPRU_ICSSG1_RGMII1.TD2.$assign            = "ball.AG24";
iPRU_ICSSG1_RGMII1.TD3.$assign            = "ball.AD24";
iPRU_ICSSG1_RGMII1.TXC.$assign            = "ball.AE24";
iPRU_ICSSG1_RGMII1.TX_CTL.$assign         = "ball.AC24";
const iPRU_ICSSG1_RGMII2                  = scripting.addPeripheral("PRU_ICSSG1_RGMII");
iPRU_ICSSG1_RGMII2.$name                  = "MyPRU_ICSSG1_RGMII2";
iPRU_ICSSG1_RGMII2.$assign                = "PRU_ICSSG1_RGMII2";
iPRU_ICSSG1_RGMII2.RD0.$assign            = "ball.AE22";
iPRU_ICSSG1_RGMII2.RD1.$assign            = "ball.AG23";
iPRU_ICSSG1_RGMII2.RD2.$assign            = "ball.AF23";
iPRU_ICSSG1_RGMII2.RD3.$assign            = "ball.AD23";
iPRU_ICSSG1_RGMII2.RXC.$assign            = "ball.AE23";
iPRU_ICSSG1_RGMII2.RX_CTL.$assign         = "ball.AH24";
iPRU_ICSSG1_RGMII2.TD0.$assign            = "ball.AJ25";
iPRU_ICSSG1_RGMII2.TD1.$assign            = "ball.AH25";
iPRU_ICSSG1_RGMII2.TD2.$assign            = "ball.AG25";
iPRU_ICSSG1_RGMII2.TD3.$assign            = "ball.AH26";
iPRU_ICSSG1_RGMII2.TXC.$assign            = "ball.AJ26";
iPRU_ICSSG1_RGMII2.TX_CTL.$assign         = "ball.AJ27";
const iPRU_ICSSG1_UART1                   = scripting.addPeripheral("PRU_ICSSG1_UART");
iPRU_ICSSG1_UART1.$name                   = "MyPRU_ICSSG1_UART";
iPRU_ICSSG1_UART1.CTSn.$used              = false;
iPRU_ICSSG1_UART1.RTSn.$used              = false;
iPRU_ICSSG1_UART1.RXD.$assign             = "ball.AF21";
iPRU_ICSSG1_UART1.TXD.$assign             = "ball.AB23";
const iSPI1                               = scripting.addPeripheral("SPI");
iSPI1.$name                               = "MySPI3";
iSPI1.$assign                             = "SPI3";
iSPI1.CLK.$assign                         = "ball.Y25";
iSPI1.CS0.$used                           = false;
iSPI1.CS1.pu_pd                           = "pu";
iSPI1.CS1.$assign                         = "ball.AB26";
iSPI1.CS2.pu_pd                           = "pu";
iSPI1.CS2.$assign                         = "ball.AB25";
iSPI1.CS3.$assign                         = "ball.Y24";
iSPI1.CS3.$used                           = false;
iSPI1.D0.$assign                          = "ball.AA26";
iSPI1.D1.$assign                          = "ball.AA29";
const iSPI2                               = scripting.addPeripheral("SPI");
iSPI2.$name                               = "MySPI6";
iSPI2.$assign                             = "SPI6";
iSPI2.CLK.$assign                         = "ball.AC22";
iSPI2.CS0.$used                           = false;
iSPI2.CS1.$assign                         = "ball.AG20";
iSPI2.CS2.$used                           = false;
iSPI2.CS3.$used                           = false;
iSPI2.D0.$assign                          = "ball.AJ22";
iSPI2.D1.$assign                          = "ball.AH22";
const iUART1                              = scripting.addPeripheral("UART");
iUART1.$name                              = "MyUART8";
iUART1.$assign                            = "USART8";
iUART1.CTSn.$used                         = false;
iUART1.DCDn.$used                         = false;
iUART1.DSRn.$used                         = false;
iUART1.DTRn.$used                         = false;
iUART1.RIn.$used                          = false;
iUART1.RTSn.$used                         = false;
iUART1.RXD.$assign                        = "ball.Y24";
iUART1.TXD.$assign                        = "ball.AA25";
const iUART2                              = scripting.addPeripheral("UART");
iUART2.$name                              = "MyUART4";
iUART2.$assign                            = "USART4";
iUART2.CTSn.$used                         = false;
iUART2.DCDn.$used                         = false;
iUART2.DSRn.$used                         = false;
iUART2.DTRn.$used                         = false;
iUART2.RIn.$used                          = false;
iUART2.RTSn.$used                         = false;
iUART2.RXD.$assign                        = "ball.W23";
iUART2.TXD.$assign                        = "ball.W28";
const iWKUP_GPIO1                         = scripting.addPeripheral("WKUP_GPIO");
iWKUP_GPIO1["11"].$assign                 = "ball.H27";
iWKUP_GPIO1["11"].$used                   = true;
iWKUP_GPIO1.$name                         = "MyWKUP_GPIO1";

/**
 * Pinmux solution for unlocked pins/peripherals. This ensures that minor changes to the automatic solver in a future
 * version of the tool will not impact the pinmux you originally saw.  These lines can be completely deleted in order to
 * re-solve from scratch.
 */
iEHRPWM1.$suggestSolution          = "EHRPWM0";
iGPIO1.$suggestSolution            = "GPIO0";
iMDIO1.$suggestSolution            = "MDIO0";
iPRU_ICSSG0_MDIO1.$suggestSolution = "PRU_ICSSG0_MDIO0";
iPRU_ICSSG1_IEP1.$suggestSolution  = "PRU_ICSSG1_IEP0";
iPRU_ICSSG1_MDIO1.$suggestSolution = "PRU_ICSSG1_MDIO0";
iPRU_ICSSG1_UART1.$suggestSolution = "PRU_ICSSG1_UART0";
iWKUP_GPIO1.$suggestSolution       = "WKUP_GPIO0";
