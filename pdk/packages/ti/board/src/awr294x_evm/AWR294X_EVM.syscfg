/**
 * @cliArgs --device "AWR294X" --package "Default" --part "Default"
 * @versions {"data":"2021040517","timestamp":"2021040517","tool":"1.8.0+1863","templates":null}
 */

/**
 * Import the modules used in this configuration.
 */
const BSS_UARTA_TX  = scripting.addModule("/ti/peripherals/BSS_UARTA_TX", {}, false);
const BSS_UARTA_TX1 = BSS_UARTA_TX.addInstance();
const DSS_UART      = scripting.addModule("/ti/peripherals/DSS_UART", {}, false);
const DSS_UART1     = DSS_UART.addInstance();
const ERROR         = scripting.addModule("/ti/peripherals/ERROR", {}, false);
const ERROR1        = ERROR.addInstance();
const JTAG          = scripting.addModule("/ti/peripherals/JTAG", {}, false);
const JTAG1         = JTAG.addInstance();
const MCU_CLKOUT    = scripting.addModule("/ti/peripherals/MCU_CLKOUT", {}, false);
const MCU_CLKOUT1   = MCU_CLKOUT.addInstance();
const MSS_EPWM      = scripting.addModule("/ti/peripherals/MSS_EPWM", {}, false);
const MSS_EPWM1     = MSS_EPWM.addInstance();
const MSS_EPWM2     = MSS_EPWM.addInstance();
const MSS_GPIO      = scripting.addModule("/ti/peripherals/MSS_GPIO", {}, false);
const MSS_GPIO1     = MSS_GPIO.addInstance();
const MSS_GPIO2     = MSS_GPIO.addInstance();
const MSS_GPIO3     = MSS_GPIO.addInstance();
const MSS_GPIO4     = MSS_GPIO.addInstance();
const MSS_GPIO5     = MSS_GPIO.addInstance();
const MSS_GPIO6     = MSS_GPIO.addInstance();
const MSS_GPIO7     = MSS_GPIO.addInstance();
const MSS_GPIO8     = MSS_GPIO.addInstance();
const MSS_GPIO9     = MSS_GPIO.addInstance();
const MSS_GPIO10    = MSS_GPIO.addInstance();
const MSS_GPIO11    = MSS_GPIO.addInstance();
const MSS_GPIO12    = MSS_GPIO.addInstance();
const MSS_I2C       = scripting.addModule("/ti/peripherals/MSS_I2C", {}, false);
const MSS_I2C1      = MSS_I2C.addInstance();
const MSS_MCAN      = scripting.addModule("/ti/peripherals/MSS_MCAN", {}, false);
const MSS_MCAN1     = MSS_MCAN.addInstance();
const MSS_MCAN2     = MSS_MCAN.addInstance();
const MSS_MDIO      = scripting.addModule("/ti/peripherals/MSS_MDIO", {}, false);
const MSS_MDIO1     = MSS_MDIO.addInstance();
const MSS_MIBSPI    = scripting.addModule("/ti/peripherals/MSS_MIBSPI", {}, false);
const MSS_MIBSPI1   = MSS_MIBSPI.addInstance();
const MSS_MIBSPI2   = MSS_MIBSPI.addInstance();
const MSS_QSPI      = scripting.addModule("/ti/peripherals/MSS_QSPI", {}, false);
const MSS_QSPI1     = MSS_QSPI.addInstance();
const MSS_RGMII     = scripting.addModule("/ti/peripherals/MSS_RGMII", {}, false);
const MSS_RGMII1    = MSS_RGMII.addInstance();
const MSS_RS232     = scripting.addModule("/ti/peripherals/MSS_RS232", {}, false);
const MSS_RS2321    = MSS_RS232.addInstance();
const MSS_UART      = scripting.addModule("/ti/peripherals/MSS_UART", {}, false);
const MSS_UART1     = MSS_UART.addInstance();
const MSS_UART2     = MSS_UART.addInstance();
const PMIC_CLKOUT   = scripting.addModule("/ti/peripherals/PMIC_CLKOUT", {}, false);
const PMIC_CLKOUT1  = PMIC_CLKOUT.addInstance();
const XREF_CLK0     = scripting.addModule("/ti/peripherals/XREF_CLK0", {}, false);
const XREF_CLK01    = XREF_CLK0.addInstance();
const XREF_CLK1     = scripting.addModule("/ti/peripherals/XREF_CLK1", {}, false);
const XREF_CLK11    = XREF_CLK1.addInstance();

/**
 * Write custom configuration values to the imported modules.
 */
BSS_UARTA_TX1.$name                 = "MyBSS_UARTA_TX0";
BSS_UARTA_TX1.peripheral.$assign    = "BSS_UARTA_TXA";
BSS_UARTA_TX1.peripheral.TX.$assign = "PAD_BL";

DSS_UART1.$name                 = "MyDSS_UART0";
DSS_UART1.peripheral.$assign    = "DSS_UARTA";
DSS_UART1.peripheral.TX.$assign = "PAD_DC";
DSS_UART1.peripheral.RX.$assign = "PAD_DD";

ERROR1.$name                    = "MyERROR0";
ERROR1.peripheral.$assign       = "ERROR0";
ERROR1.peripheral.RESET.$assign = "PAD_AS";
ERROR1.peripheral.OUT.$assign   = "PAD_AT";

JTAG1.$name                  = "MyJTAG0";
JTAG1.peripheral.$assign     = "JTAG0";
JTAG1.peripheral.TCK.$assign = "PAD_AU";
JTAG1.peripheral.TMS.$assign = "PAD_AV";
JTAG1.peripheral.TDI.$assign = "PAD_AW";
JTAG1.peripheral.TDO.$assign = "PAD_AX";

MCU_CLKOUT1.$name                     = "MyMCU_CLKOUT0";
MCU_CLKOUT1.peripheral.$assign        = "MCU_CLKOUT0";
MCU_CLKOUT1.peripheral.CLKOUT.$assign = "PAD_AY";

MSS_EPWM1.$name                   = "MyMSS_EPWM0";
MSS_EPWM1.peripheral["0"].$assign = "PAD_BP";
MSS_EPWM1.peripheral["1"].$assign = "PAD_BQ";
MSS_EPWM1.peripheral.$assign      = "MSS_EPWMA";
MSS_EPWM1.peripheral.SYNCI.$used  = false;
MSS_EPWM1.peripheral.SYNCO.$used  = false;

MSS_EPWM2.$name                   = "MyMSS_EPWM1";
MSS_EPWM2.peripheral["0"].$assign = "PAD_BT";
MSS_EPWM2.peripheral["1"].$used   = false;
MSS_EPWM2.peripheral.$assign      = "MSS_EPWMB";
MSS_EPWM2.peripheral.SYNCI.$used  = false;
MSS_EPWM2.peripheral.SYNCO.$used  = false;

MSS_GPIO1.$name                  = "MyMSS_GPIO0";
MSS_GPIO1.peripheral.$assign     = "MSS_GPIO0";
MSS_GPIO1.peripheral.PIN.$assign = "PAD_AB";

MSS_GPIO2.$name                  = "MyMSS_GPIO1";
MSS_GPIO2.peripheral.PIN.$assign = "PAD_AC";

MSS_GPIO3.$name                  = "MyMSS_GPIO2";
MSS_GPIO3.peripheral.PIN.$assign = "PAD_AZ";

MSS_GPIO4.$name                  = "MyMSS_GPIO3";
MSS_GPIO4.peripheral.PIN.$assign = "PAD_BJ";

MSS_GPIO5.$name                  = "MyMSS_GPIO4";
MSS_GPIO5.peripheral.PIN.$assign = "PAD_BK";

MSS_GPIO6.$name                  = "MyMSS_GPIO5";
MSS_GPIO6.peripheral.PIN.$assign = "PAD_BH";

MSS_GPIO7.$name                  = "MyMSS_GPIO6";
MSS_GPIO7.peripheral.PIN.$assign = "PAD_BI";

MSS_GPIO8.$name                  = "MyMSS_GPIO7";
MSS_GPIO8.peripheral.PIN.$assign = "PAD_BM";

MSS_GPIO9.$name                  = "MyMSS_GPIO8";
MSS_GPIO9.peripheral.PIN.$assign = "PAD_BX";

MSS_GPIO10.$name                  = "MyMSS_GPIO9";
MSS_GPIO10.peripheral.PIN.$assign = "PAD_BB";

MSS_GPIO11.$name                  = "MyMSS_GPIO10";
MSS_GPIO11.peripheral.PIN.$assign = "PAD_BG";

MSS_GPIO12.$name                  = "MyMSS_GPIO11";
MSS_GPIO12.peripheral.PIN.$assign = "PAD_BF";

MSS_I2C1.$name                  = "MyMSS_I2C0";
MSS_I2C1.peripheral.$assign     = "MSS_I2CA";
MSS_I2C1.peripheral.SDA.$assign = "PAD_BY";
MSS_I2C1.peripheral.SCL.$assign = "PAD_BZ";

MSS_MCAN1.$name                 = "MyMSS_MCAN0";
MSS_MCAN1.peripheral.$assign    = "MSS_MCANA";
MSS_MCAN1.peripheral.RX.$assign = "PAD_BO";
MSS_MCAN1.peripheral.TX.$assign = "PAD_BN";

MSS_MCAN2.$name                 = "MyMSS_MCAN1";
MSS_MCAN2.peripheral.$assign    = "MSS_MCANB";
MSS_MCAN2.peripheral.RX.$assign = "PAD_BS";
MSS_MCAN2.peripheral.TX.$assign = "PAD_BR";

MSS_MDIO1.$name                   = "MyMSS_MDIO0";
MSS_MDIO1.peripheral.$assign      = "MSS_MDIO0";
MSS_MDIO1.peripheral.DATA.$assign = "PAD_CM";
MSS_MDIO1.peripheral.CLK.$assign  = "PAD_CN";

MSS_MIBSPI1.$name                      = "MyMSS_MIBSPI0";
MSS_MIBSPI1.peripheral.$assign         = "MSS_MIBSPIA";
MSS_MIBSPI1.peripheral.HOSTIRQ.$assign = "PAD_CS";
MSS_MIBSPI1.peripheral.CS1.$used       = false;
MSS_MIBSPI1.peripheral.CS2.$used       = false;
MSS_MIBSPI1.peripheral.MOSI.$assign    = "PAD_CO";
MSS_MIBSPI1.peripheral.MISO.$assign    = "PAD_CP";
MSS_MIBSPI1.peripheral.CLK.$assign     = "PAD_CQ";
MSS_MIBSPI1.peripheral.CS0.$assign     = "PAD_CR";

MSS_MIBSPI2.$name                    = "MyMSS_MIBSPI1";
MSS_MIBSPI2.peripheral.$assign       = "MSS_MIBSPIB";
MSS_MIBSPI2.peripheral.HOSTIRQ.$used = false;
MSS_MIBSPI2.peripheral.CS1.$assign   = "PAD_AA";
MSS_MIBSPI2.peripheral.CS2.$assign   = "PAD_BC";
MSS_MIBSPI2.peripheral.MOSI.$assign  = "PAD_AH";
MSS_MIBSPI2.peripheral.MISO.$assign  = "PAD_AI";
MSS_MIBSPI2.peripheral.CLK.$assign   = "PAD_AJ";
MSS_MIBSPI2.peripheral.CS0.$assign   = "PAD_AK";

MSS_QSPI1.$name                   = "MyMSS_QSPI0";
MSS_QSPI1.peripheral["0"].$assign = "PAD_AL";
MSS_QSPI1.peripheral["1"].$assign = "PAD_AM";
MSS_QSPI1.peripheral["2"].$assign = "PAD_AN";
MSS_QSPI1.peripheral["3"].$assign = "PAD_AO";
MSS_QSPI1.peripheral.$assign      = "MSS_QSPI0";
MSS_QSPI1.peripheral.CLK.$assign  = "PAD_AP";
MSS_QSPI1.peripheral.CS.$assign   = "PAD_AQ";

MSS_RGMII1.$name                   = "MyMSS_RGMII0";
MSS_RGMII1.peripheral.$assign      = "MSS_RGMII0";
MSS_RGMII1.peripheral.TCTL.$assign = "PAD_CA";
MSS_RGMII1.peripheral.RCTL.$assign = "PAD_CB";
MSS_RGMII1.peripheral.TD3.$assign  = "PAD_CC";
MSS_RGMII1.peripheral.TD2.$assign  = "PAD_CD";
MSS_RGMII1.peripheral.TD1.$assign  = "PAD_CE";
MSS_RGMII1.peripheral.TD0.$assign  = "PAD_CF";
MSS_RGMII1.peripheral.TCLK.$assign = "PAD_CG";
MSS_RGMII1.peripheral.RCLK.$assign = "PAD_CH";
MSS_RGMII1.peripheral.RD3.$assign  = "PAD_CI";
MSS_RGMII1.peripheral.RD2.$assign  = "PAD_CJ";
MSS_RGMII1.peripheral.RD1.$assign  = "PAD_CK";
MSS_RGMII1.peripheral.RD0.$assign  = "PAD_CL";

MSS_RS2321.$name                 = "MyMSS_RS2320";
MSS_RS2321.peripheral.$assign    = "MSS_RS2320";
MSS_RS2321.peripheral.RX.$assign = "PAD_BD";
MSS_RS2321.peripheral.TX.$assign = "PAD_BE";

MSS_UART1.$name                 = "MyMSS_UART0";
MSS_UART1.peripheral.$assign    = "MSS_UARTA";
MSS_UART1.peripheral.RX.$assign = "PAD_DA";
MSS_UART1.peripheral.TX.$assign = "PAD_DB";

MSS_UART2.$name                 = "MyMSS_UART1";
MSS_UART2.peripheral.$assign    = "MSS_UARTB";
MSS_UART2.peripheral.RX.$used   = false;
MSS_UART2.peripheral.TX.$assign = "PAD_DE";

PMIC_CLKOUT1.$name                     = "MyPMIC_CLKOUT0";
PMIC_CLKOUT1.peripheral.CLKOUT.$assign = "PAD_BA";

XREF_CLK01.$name                   = "MyXREF_CLK00";
XREF_CLK01.peripheral.$assign      = "XREF_CLK00";
XREF_CLK01.peripheral.CLK0.$assign = "PAD_DF";

XREF_CLK11.$name                   = "MyXREF_CLK10";
XREF_CLK11.peripheral.$assign      = "XREF_CLK10";
XREF_CLK11.peripheral.CLK1.$assign = "PAD_DG";

/**
 * Pinmux solution for unlocked pins/peripherals. This ensures that minor changes to the automatic solver in a future
 * version of the tool will not impact the pinmux you originally saw.  These lines can be completely deleted in order to
 * re-solve from scratch.
 */
MSS_GPIO2.peripheral.$suggestSolution    = "MSS_GPIO0";
MSS_GPIO3.peripheral.$suggestSolution    = "MSS_GPIO0";
MSS_GPIO4.peripheral.$suggestSolution    = "MSS_GPIO0";
MSS_GPIO5.peripheral.$suggestSolution    = "MSS_GPIO0";
MSS_GPIO6.peripheral.$suggestSolution    = "MSS_GPIO0";
MSS_GPIO7.peripheral.$suggestSolution    = "MSS_GPIO0";
MSS_GPIO8.peripheral.$suggestSolution    = "MSS_GPIO0";
MSS_GPIO9.peripheral.$suggestSolution    = "MSS_GPIO0";
MSS_GPIO10.peripheral.$suggestSolution   = "MSS_GPIO0";
MSS_GPIO11.peripheral.$suggestSolution   = "MSS_GPIO0";
MSS_GPIO12.peripheral.$suggestSolution   = "MSS_GPIO0";
PMIC_CLKOUT1.peripheral.$suggestSolution = "PMIC_CLKOUT0";
