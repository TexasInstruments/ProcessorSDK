/**
 * @cliArgs --device "J742S2" --package "AND" --part "Default"
 * @versions {"tool":"1.20.999+133"}
 */

/**
 * These are the peripherals and settings in this configuration
 */
const iCSI1                 = scripting.addPeripheral("CSI");
iCSI1.$name                 = "MyCSI1";
iCSI1.$assign               = "CSI_RX_0";
iCSI1.RXCLKN.$assign        = "CSI0_RXCLKN";
iCSI1.RXCLKP.$assign        = "CSI0_RXCLKP";
iCSI1.RXN0.$assign          = "CSI0_RXN0";
iCSI1.RXN1.$assign          = "CSI0_RXN1";
iCSI1.RXN2.$assign          = "CSI0_RXN2";
iCSI1.RXN3.$assign          = "CSI0_RXN3";
iCSI1.RXP0.$assign          = "CSI0_RXP0";
iCSI1.RXP1.$assign          = "CSI0_RXP1";
iCSI1.RXP2.$assign          = "CSI0_RXP2";
iCSI1.RXP3.$assign          = "CSI0_RXP3";
iCSI1.RXRCALIB.$used        = false;
iCSI1.TXCLKN.$used          = false;
iCSI1.TXCLKP.$used          = false;
iCSI1.TXN0.$used            = false;
iCSI1.TXN1.$used            = false;
iCSI1.TXN2.$used            = false;
iCSI1.TXN3.$used            = false;
iCSI1.TXP0.$used            = false;
iCSI1.TXP1.$used            = false;
iCSI1.TXP2.$used            = false;
iCSI1.TXP3.$used            = false;
const iCSI2                 = scripting.addPeripheral("CSI");
iCSI2.$name                 = "MyCSI2";
iCSI2.$assign               = "CSI_RX_1";
iCSI2.RXCLKN.$assign        = "CSI1_RXCLKN";
iCSI2.RXCLKP.$assign        = "CSI1_RXCLKP";
iCSI2.RXN0.$assign          = "CSI1_RXN0";
iCSI2.RXN1.$assign          = "CSI1_RXN1";
iCSI2.RXN2.$assign          = "CSI1_RXN2";
iCSI2.RXN3.$assign          = "CSI1_RXN3";
iCSI2.RXP0.$assign          = "CSI1_RXP0";
iCSI2.RXP1.$assign          = "CSI1_RXP1";
iCSI2.RXP2.$assign          = "CSI1_RXP2";
iCSI2.RXP3.$assign          = "CSI1_RXP3";
iCSI2.RXRCALIB.$used        = false;
iCSI2.TXCLKN.$used          = false;
iCSI2.TXCLKP.$used          = false;
iCSI2.TXN0.$used            = false;
iCSI2.TXN1.$used            = false;
iCSI2.TXN2.$used            = false;
iCSI2.TXN3.$used            = false;
iCSI2.TXP0.$used            = false;
iCSI2.TXP1.$used            = false;
iCSI2.TXP2.$used            = false;
iCSI2.TXP3.$used            = false;
const iCSI3                 = scripting.addPeripheral("CSI");
iCSI3.$name                 = "MyCSI3";
iCSI3.$assign               = "CSI_RX_2";
iCSI3.RXCLKN.$assign        = "CSI2_RXCLKN";
iCSI3.RXCLKP.$assign        = "CSI2_RXCLKP";
iCSI3.RXN0.$assign          = "CSI2_RXN0";
iCSI3.RXN1.$assign          = "CSI2_RXN1";
iCSI3.RXN2.$assign          = "CSI2_RXN2";
iCSI3.RXN3.$assign          = "CSI2_RXN3";
iCSI3.RXP0.$assign          = "CSI2_RXP0";
iCSI3.RXP1.$assign          = "CSI2_RXP1";
iCSI3.RXP2.$assign          = "CSI2_RXP2";
iCSI3.RXP3.$assign          = "CSI2_RXP3";
iCSI3.RXRCALIB.$used        = false;
iCSI3.TXCLKN.$used          = false;
iCSI3.TXCLKP.$used          = false;
iCSI3.TXN0.$used            = false;
iCSI3.TXN1.$used            = false;
iCSI3.TXN2.$used            = false;
iCSI3.TXN3.$used            = false;
iCSI3.TXP0.$used            = false;
iCSI3.TXP1.$used            = false;
iCSI3.TXP2.$used            = false;
iCSI3.TXP3.$used            = false;
const iI2C1                 = scripting.addPeripheral("I2C");
iI2C1.$name                 = "MyI2C1";
iI2C1.$assign               = "I2C_0";
iI2C1.SCL.$assign           = "I2C0_SCL";
iI2C1.SDA.$assign           = "I2C0_SDA";
const iI2C2                 = scripting.addPeripheral("I2C");
iI2C2.$name                 = "MyI2C2";
iI2C2.$assign               = "I2C_1";
iI2C2.SCL.$assign           = "ECAP0_IN_APWM_OUT";
iI2C2.SDA.$assign           = "EXT_REFCLK1";
const iI2C3                 = scripting.addPeripheral("I2C");
iI2C3.$name                 = "MyI2C3";
iI2C3.$assign               = "I2C_4";
iI2C3.SCL.$assign           = "MCAN14_TX";
iI2C3.SDA.$assign           = "MCAN13_RX";
const iI2C4                 = scripting.addPeripheral("I2C");
iI2C4.$name                 = "MyI2C4";
iI2C4.$assign               = "I2C_5";
iI2C4.SCL.$assign           = "MCAN15_TX";
iI2C4.SDA.$assign           = "MCAN14_RX";
const iMCAN1                = scripting.addPeripheral("MCAN");
iMCAN1.$name                = "MyMCAN1";
iMCAN1.$assign              = "MCAN_3";
iMCAN1.RX.$assign           = "MCASP0_AXR4";
iMCAN1.TX.$assign           = "MCASP0_AXR3";
const iMCAN2                = scripting.addPeripheral("MCAN");
iMCAN2.$name                = "MyMCAN2";
iMCAN2.$assign              = "MCAN_4";
iMCAN2.RX.$assign           = "MCASP0_AXR6";
iMCAN2.TX.$assign           = "MCASP0_AXR5";
const iMCAN3                = scripting.addPeripheral("MCAN");
iMCAN3.$name                = "MyMCAN3";
iMCAN3.$assign              = "MCAN_5";
iMCAN3.RX.$assign           = "MCASP0_AFSX";
iMCAN3.TX.$assign           = "MCASP0_ACLKX";
const iMCAN4                = scripting.addPeripheral("MCAN");
iMCAN4.$name                = "MyMCAN4";
iMCAN4.$assign              = "MCAN_16";
iMCAN4.RX.$assign           = "MCAN16_RX";
iMCAN4.TX.$assign           = "MCAN16_TX";
const iMCU_ADC1             = scripting.addPeripheral("MCU_ADC");
iMCU_ADC1.$name             = "MyMCU_ADC1";
iMCU_ADC1.$assign           = "MCU_ADC_0";
iMCU_ADC1.REFP.$used        = false;
iMCU_ADC1.REFN.$used        = false;
iMCU_ADC1.AIN0.$assign      = "MCU_ADC0_AIN0";
iMCU_ADC1.AIN1.$assign      = "MCU_ADC0_AIN1";
iMCU_ADC1.AIN2.$assign      = "MCU_ADC0_AIN2";
iMCU_ADC1.AIN3.$assign      = "MCU_ADC0_AIN3";
iMCU_ADC1.AIN4.$assign      = "MCU_ADC0_AIN4";
iMCU_ADC1.AIN5.$assign      = "MCU_ADC0_AIN5";
iMCU_ADC1.AIN6.$assign      = "MCU_ADC0_AIN6";
iMCU_ADC1.AIN7.$assign      = "MCU_ADC0_AIN7";
const iMCU_ADC2             = scripting.addPeripheral("MCU_ADC");
iMCU_ADC2.$name             = "MyMCU_ADC2";
iMCU_ADC2.$assign           = "MCU_ADC_1";
iMCU_ADC2.REFP.$used        = false;
iMCU_ADC2.REFN.$used        = false;
iMCU_ADC2.AIN0.$assign      = "MCU_ADC1_AIN0";
iMCU_ADC2.AIN1.$assign      = "MCU_ADC1_AIN1";
iMCU_ADC2.AIN2.$assign      = "MCU_ADC1_AIN2";
iMCU_ADC2.AIN3.$assign      = "MCU_ADC1_AIN3";
iMCU_ADC2.AIN4.$assign      = "MCU_ADC1_AIN4";
iMCU_ADC2.AIN5.$assign      = "MCU_ADC1_AIN5";
iMCU_ADC2.AIN6.$assign      = "MCU_ADC1_AIN6";
iMCU_ADC2.AIN7.$assign      = "MCU_ADC1_AIN7";
const iMCU_I2C1             = scripting.addPeripheral("MCU_I2C");
iMCU_I2C1.$name             = "MyMCU_I2C1";
iMCU_I2C1.$assign           = "MCU_I2C_0";
iMCU_I2C1.SCL.$assign       = "MCU_I2C0_SCL";
iMCU_I2C1.SDA.$assign       = "MCU_I2C0_SDA";
const iMCU_MCAN1            = scripting.addPeripheral("MCU_MCAN");
iMCU_MCAN1.$name            = "MyMCU_MCAN1";
iMCU_MCAN1.$assign          = "MCU_MCAN_0";
iMCU_MCAN1.RX.$assign       = "MCU_MCAN0_RX";
iMCU_MCAN1.TX.$assign       = "MCU_MCAN0_TX";
const iMCU_MCAN2            = scripting.addPeripheral("MCU_MCAN");
iMCU_MCAN2.$name            = "MyMCU_MCAN2";
iMCU_MCAN2.$assign          = "MCU_MCAN_1";
iMCU_MCAN2.RX.$assign       = "WKUP_GPIO0_5";
iMCU_MCAN2.TX.$assign       = "WKUP_GPIO0_4";
const iMCU_MDIO1            = scripting.addPeripheral("MCU_MDIO");
iMCU_MDIO1.$name            = "MyMCU_MDIO1";
iMCU_MDIO1.$assign          = "MCU_MDIO_0";
iMCU_MDIO1.MDC.$assign      = "MCU_MDIO0_MDC";
iMCU_MDIO1.MDIO.$assign     = "MCU_MDIO0_MDIO";
const iMCU_OSPI1            = scripting.addPeripheral("MCU_OSPI");
iMCU_OSPI1.$name            = "MyMCU_OSPI1";
iMCU_OSPI1.$assign          = "MCU_OSPI_0";
iMCU_OSPI1.CLK.$assign      = "MCU_OSPI0_CLK";
iMCU_OSPI1.CSn0.$assign     = "MCU_OSPI0_CSn0";
iMCU_OSPI1.CSn1.$assign     = "MCU_OSPI0_CSn1";
iMCU_OSPI1.CSn2.$assign     = "MCU_OSPI0_CSn2";
iMCU_OSPI1.CSn3.$assign     = "MCU_OSPI0_CSn3";
iMCU_OSPI1.D0.$assign       = "MCU_OSPI0_D0";
iMCU_OSPI1.D1.$assign       = "MCU_OSPI0_D1";
iMCU_OSPI1.D2.$assign       = "MCU_OSPI0_D2";
iMCU_OSPI1.D3.$assign       = "MCU_OSPI0_D3";
iMCU_OSPI1.D4.$assign       = "MCU_OSPI0_D4";
iMCU_OSPI1.D5.$assign       = "MCU_OSPI0_D5";
iMCU_OSPI1.D6.$assign       = "MCU_OSPI0_D6";
iMCU_OSPI1.D7.$assign       = "MCU_OSPI0_D7";
iMCU_OSPI1.DQS.$assign      = "MCU_OSPI0_DQS";
iMCU_OSPI1.ECC_FAIL.$assign = "MCU_OSPI0_CSn3";
iMCU_OSPI1.ECC_FAIL.$used   = false;
iMCU_OSPI1.LBCLKO.$assign   = "MCU_OSPI0_LBCLKO";
iMCU_OSPI1.RESET_OUT0.$used = false;
iMCU_OSPI1.RESET_OUT1.$used = false;
const iMCU_OSPI2            = scripting.addPeripheral("MCU_OSPI");
iMCU_OSPI2.$name            = "MyMCU_OSPI2";
iMCU_OSPI2.CLK.$assign      = "MCU_OSPI1_CLK";
iMCU_OSPI2.CSn0.$assign     = "MCU_OSPI1_CSn0";
iMCU_OSPI2.CSn1.$assign     = "MCU_OSPI1_CSn1";
iMCU_OSPI2.CSn2.$used       = false;
iMCU_OSPI2.CSn3.$used       = false;
iMCU_OSPI2.D0.$assign       = "MCU_OSPI1_D0";
iMCU_OSPI2.D1.$assign       = "MCU_OSPI1_D1";
iMCU_OSPI2.D2.$assign       = "MCU_OSPI1_D2";
iMCU_OSPI2.D3.$assign       = "MCU_OSPI1_D3";
iMCU_OSPI2.D4.$used         = false;
iMCU_OSPI2.D5.$used         = false;
iMCU_OSPI2.D6.$used         = false;
iMCU_OSPI2.D7.$used         = false;
iMCU_OSPI2.DQS.$assign      = "MCU_OSPI1_DQS";
iMCU_OSPI2.ECC_FAIL.$used   = false;
iMCU_OSPI2.LBCLKO.$assign   = "MCU_OSPI1_LBCLKO";
iMCU_OSPI2.RESET_OUT0.$used = false;
iMCU_OSPI2.RESET_OUT1.$used = false;
const iMCU_UART1            = scripting.addPeripheral("MCU_UART");
iMCU_UART1.$name            = "MyMCU_UART1";
iMCU_UART1.$assign          = "MCU_USART_0";
iMCU_UART1.CTSn.$assign     = "WKUP_GPIO0_14";
iMCU_UART1.RTSn.$assign     = "WKUP_GPIO0_15";
iMCU_UART1.RXD.$assign      = "WKUP_GPIO0_13";
iMCU_UART1.TXD.$assign      = "WKUP_GPIO0_12";
const iMMCSD1               = scripting.addPeripheral("MMCSD");
iMMCSD1.$name               = "MyMMCSD1";
iMMCSD1.$assign             = "MMC_0";
iMMCSD1.CALPAD.$used        = false;
iMMCSD1.CLK.$assign         = "MMC0_CLK";
iMMCSD1.CMD.$assign         = "MMC0_CMD";
iMMCSD1.DAT0.$assign        = "MMC0_DAT0";
iMMCSD1.DAT1.$assign        = "MMC0_DAT1";
iMMCSD1.DAT2.$assign        = "MMC0_DAT2";
iMMCSD1.DAT3.$assign        = "MMC0_DAT3";
iMMCSD1.DAT4.$assign        = "MMC0_DAT4";
iMMCSD1.DAT5.$assign        = "MMC0_DAT5";
iMMCSD1.DAT6.$assign        = "MMC0_DAT6";
iMMCSD1.DAT7.$assign        = "MMC0_DAT7";
iMMCSD1.DS.$assign          = "MMC0_DS";
iMMCSD1.SDCD.$used          = false;
iMMCSD1.SDWP.$used          = false;
const iMMCSD2               = scripting.addPeripheral("MMCSD");
iMMCSD2.$name               = "MyMMCSD2";
iMMCSD2.$assign             = "MMC_1";
iMMCSD2.CALPAD.$used        = false;
iMMCSD2.CLK.$assign         = "MMC1_CLK";
iMMCSD2.CMD.$assign         = "MMC1_CMD";
iMMCSD2.DAT0.$assign        = "MMC1_DAT0";
iMMCSD2.DAT1.$assign        = "MMC1_DAT1";
iMMCSD2.DAT2.$assign        = "MMC1_DAT2";
iMMCSD2.DAT3.$assign        = "MMC1_DAT3";
iMMCSD2.DAT4.$used          = false;
iMMCSD2.DAT5.$used          = false;
iMMCSD2.DAT6.$used          = false;
iMMCSD2.DAT7.$used          = false;
iMMCSD2.DS.$used            = false;
iMMCSD2.SDCD.$used          = false;
iMMCSD2.SDWP.$used          = false;
const iSERDES1              = scripting.addPeripheral("SERDES");
iSERDES1.$name              = "MySERDES1";
iSERDES1.$assign            = "SERDES_0";
iSERDES1.REFCLK_N.$used     = false;
iSERDES1.REFCLK_P.$used     = false;
iSERDES1.REXT.$used         = false;
const iSERDES2              = scripting.addPeripheral("SERDES");
iSERDES2.$name              = "MySERDES2";
iSERDES2.$assign            = "SERDES_1";
iSERDES2.REFCLK_N.$used     = false;
iSERDES2.REFCLK_P.$used     = false;
iSERDES2.REXT.$used         = false;
const iSERDES3              = scripting.addPeripheral("SERDES");
iSERDES3.$name              = "MySERDES3";
iSERDES3.$assign            = "SERDES_4";
iSERDES3.REFCLK_N.$used     = false;
iSERDES3.REFCLK_P.$used     = false;
iSERDES3.REXT.$used         = false;
const iUART1                = scripting.addPeripheral("UART");
iUART1.$name                = "MyUART1";
iUART1.$assign              = "USART_2";
iUART1.CTSn.$used           = false;
iUART1.DCDn.$used           = false;
iUART1.DSRn.$used           = false;
iUART1.DTRn.$used           = false;
iUART1.RIn.$used            = false;
iUART1.RTSn.$used           = false;
iUART1.RXD.$assign          = "SPI0_D0";
iUART1.TXD.$assign          = "SPI0_D1";
const iUART2                = scripting.addPeripheral("UART");
iUART2.$name                = "MyUART2";
iUART2.$assign              = "USART_3";
iUART2.CTSn.$used           = false;
iUART2.DCDn.$used           = false;
iUART2.DSRn.$used           = false;
iUART2.DTRn.$used           = false;
iUART2.RIn.$used            = false;
iUART2.RTSn.$used           = false;
iUART2.RXD.$assign          = "MCAN2_TX";
iUART2.TXD.$assign          = "MCAN2_RX";
const iUART3                = scripting.addPeripheral("UART");
iUART3.$name                = "MyUART3";
iUART3.CTSn.$used           = false;
iUART3.DCDn.$used           = false;
iUART3.DSRn.$used           = false;
iUART3.DTRn.$used           = false;
iUART3.RIn.$used            = false;
iUART3.RTSn.$used           = false;
iUART3.RXD.$assign          = "MCAN12_RX";
iUART3.TXD.$assign          = "MCAN12_TX";
const iUART4                = scripting.addPeripheral("UART");
iUART4.$name                = "MyUART4";
iUART4.$assign              = "USART_6";
iUART4.CTSn.$used           = false;
iUART4.DCDn.$used           = false;
iUART4.DSRn.$used           = false;
iUART4.DTRn.$used           = false;
iUART4.RIn.$used            = false;
iUART4.RTSn.$used           = false;
iUART4.RXD.$assign          = "GPIO0_12";
iUART4.TXD.$assign          = "MCAN1_TX";
const iUART5                = scripting.addPeripheral("UART");
iUART5.$name                = "MyUART5";
iUART5.$assign              = "USART_8";
iUART5.CTSn.$assign         = "MCASP0_AXR0";
iUART5.DCDn.$used           = false;
iUART5.DSRn.$used           = false;
iUART5.DTRn.$used           = false;
iUART5.RIn.$used            = false;
iUART5.RTSn.$assign         = "MCASP0_AXR1";
iUART5.RXD.$assign          = "SPI0_CS1";
iUART5.TXD.$assign          = "SPI0_CLK";
const iUART6                = scripting.addPeripheral("UART");
iUART6.$name                = "MyUART6";
iUART6.$assign              = "USART_9";
iUART6.CTSn.$used           = false;
iUART6.DCDn.$used           = false;
iUART6.DSRn.$used           = false;
iUART6.DTRn.$used           = false;
iUART6.RIn.$used            = false;
iUART6.RTSn.$used           = false;
iUART6.RXD.$assign          = "MCASP1_AXR1";
iUART6.TXD.$assign          = "MCASP1_AXR2";
const iUFS1                 = scripting.addPeripheral("UFS");
iUFS1.$name                 = "MyUFS1";
iUFS1.$assign               = "UFS_0";
iUFS1.TX_DP0.$assign        = "UFS0_TX_DP0";
iUFS1.TX_DN0.$assign        = "UFS0_TX_DN0";
iUFS1.RX_DP0.$assign        = "UFS0_RX_DP0";
iUFS1.RX_DN0.$assign        = "UFS0_RX_DN0";
iUFS1.TX_DP1.$assign        = "UFS0_TX_DP1";
iUFS1.TX_DN1.$assign        = "UFS0_TX_DN1";
iUFS1.RX_DP1.$assign        = "UFS0_RX_DP1";
iUFS1.RX_DN1.$assign        = "UFS0_RX_DN1";
iUFS1.RSTn.$assign          = "UFS0_RSTn";
iUFS1.REF_CLK.$assign       = "UFS0_REF_CLK";
const iWKUP_I2C1            = scripting.addPeripheral("WKUP_I2C");
iWKUP_I2C1.$name            = "MyWKUP_I2C1";
iWKUP_I2C1.$assign          = "WKUP_I2C_0";
iWKUP_I2C1.SCL.$assign      = "WKUP_I2C0_SCL";
iWKUP_I2C1.SDA.$assign      = "WKUP_I2C0_SDA";
const iWKUP_UART1           = scripting.addPeripheral("WKUP_UART");
iWKUP_UART1.$name           = "MyWKUP_UART1";
iWKUP_UART1.$assign         = "WKUP_USART_0";
iWKUP_UART1.CTSn.$used      = false;
iWKUP_UART1.RTSn.$used      = false;
iWKUP_UART1.RXD.$assign     = "WKUP_UART0_RXD";
iWKUP_UART1.TXD.$assign     = "WKUP_UART0_TXD";

/**
 * Pinmux solution for unlocked pins/peripherals. This ensures that minor changes to the automatic solver in a future
 * version of the tool will not impact the pinmux you originally saw.  These lines can be completely deleted in order to
 * re-solve from scratch.
 */
iMCU_OSPI2.$suggestSolution = "MCU_OSPI_1";
iUART3.$suggestSolution     = "USART_5";
