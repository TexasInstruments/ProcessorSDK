
SECTIONS
{
    .sbl_mcu_4_0_resetvector 	: {} palign(8) 		> MSMC3_MCU4_CPU0
    .text 	                    : {} palign(8) 		> MSMC3_MCU4_CPU0
    .rodata 	                : {} palign(8) 		> MSMC3_MCU4_CPU0
}

