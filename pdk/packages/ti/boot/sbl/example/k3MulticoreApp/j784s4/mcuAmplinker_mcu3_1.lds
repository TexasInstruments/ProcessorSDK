
SECTIONS
{
    .sbl_mcu_3_1_resetvector 	: {} palign(8) 		> MSMC3_MCU3_CPU1
    .text 	                    : {} palign(8) 		> MSMC3_MCU3_CPU1
    .rodata 	                : {} palign(8) 		> MSMC3_MCU3_CPU1
}

