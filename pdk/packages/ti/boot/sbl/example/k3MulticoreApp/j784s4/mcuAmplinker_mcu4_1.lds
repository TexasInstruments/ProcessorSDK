
SECTIONS
{
    .sbl_mcu_4_1_resetvector 	: {} palign(8) 		> MSMC3_MCU4_CPU1
    .text 	                    : {} palign(8) 		> MSMC3_MCU4_CPU1
    .rodata 	                : {} palign(8) 		> MSMC3_MCU4_CPU1
}

