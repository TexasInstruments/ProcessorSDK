
SECTIONS
{
    .sbl_mcu_1_1_resetvector 	: {} palign(8) 		> MSMC3_MCU1_CPU1
    .text 	                    : {} palign(8) 		> MSMC3_MCU1_CPU1
    .rodata 	                : {} palign(8) 		> MSMC3_MCU1_CPU1
}

