
SECTIONS
{
    .sbl_mcu_2_0_resetvector 	: {} palign(8) 		> MSMC3_MCU2_CPU0
    .text 	                    : {} palign(8) 		> MSMC3_MCU2_CPU0
    .rodata 	                : {} palign(8) 		> MSMC3_MCU2_CPU0
}

