
SECTIONS
{
    .sbl_mcu_3_0_resetvector 	: {} palign(8) 		> MSMC3_MCU3_CPU0
    .text 	                    : {} palign(8) 		> MSMC3_MCU3_CPU0
    .rodata 	                : {} palign(8) 		> MSMC3_MCU3_CPU0
}

