/**
 * @cliArgs --device "J784S4_TDA4AP_TDA4VP_TDA4AH_TDA4VH_AM69x" --package "ALY" --part "Default" --product "K3-Respart-Tool@1.0"
 * @versions {"tool":"1.19.0+3426"}
 */

/**
 * Import the modules used in this configuration.
 */
const A72_2            = scripting.addModule("/modules/j784s4/A72_2");
const A72_3            = scripting.addModule("/modules/j784s4/A72_3");
const C7X_0_1          = scripting.addModule("/modules/j784s4/C7X_0_1");
const C7X_1_1          = scripting.addModule("/modules/j784s4/C7X_1_1");
const C7X_2_1          = scripting.addModule("/modules/j784s4/C7X_2_1");
const C7X_3_1          = scripting.addModule("/modules/j784s4/C7X_3_1");
const MAIN_0_R5_0      = scripting.addModule("/modules/j784s4/MAIN_0_R5_0");
const MAIN_0_R5_2      = scripting.addModule("/modules/j784s4/MAIN_0_R5_2");
const MAIN_1_R5_0      = scripting.addModule("/modules/j784s4/MAIN_1_R5_0");
const MAIN_1_R5_2      = scripting.addModule("/modules/j784s4/MAIN_1_R5_2");
const MAIN_2_R5_0      = scripting.addModule("/modules/j784s4/MAIN_2_R5_0");
const MAIN_2_R5_2      = scripting.addModule("/modules/j784s4/MAIN_2_R5_2");
const MCU_0_R5_0       = scripting.addModule("/modules/j784s4/MCU_0_R5_0");
const MCU_0_R5_2       = scripting.addModule("/modules/j784s4/MCU_0_R5_2");
const resourceSharing  = scripting.addModule("/modules/resourceSharing", {}, false);
const resourceSharing1 = resourceSharing.addInstance();
const resourceSharing2 = resourceSharing.addInstance();
const resourceSharing3 = resourceSharing.addInstance();
const resourceSharing4 = resourceSharing.addInstance();

/**
 * Write custom configuration values to the imported modules.
 */
A72_2.allocOrder                                                 = 1;
A72_2.Main_NAVSS_UDMA_Normal_capacity_Tx_channels_blockCount     = 6;
A72_2.Main_NAVSS_UDMA_Rx_free_flows_count                        = 16;
A72_2.Main_NAVSS_Ring_accelerator_ring_monitors_count            = 3;
A72_2.Main_NAVSS_Non_secure_proxies_count                        = 4;
A72_2.Main_NAVSS_Ring_accelerator_virt_id_range_count            = 5;
A72_2.MCU_NAVSS_UDMA_Rx_free_flows_count                         = 8;
A72_2.MCU_NAVSS_Ring_accelerator_Free_rings_count                = 20;
A72_2.MCU_NAVSS_Ring_accelerator_ring_monitors_count             = 3;
A72_2.MCU_NAVSS_Non_secure_proxies_count                         = 2;
A72_2.Main_GPIO_Interrupt_router_count                           = 12;
A72_2.Wakeup_GPIO_Interrupt_router_count                         = 6;
A72_2.Main_NAVSS_UDMA_Interrupt_aggregator_Global_events_count   = 1024;
A72_2.MCU_NAVSS_Interrupt_aggregator_Global_events_count         = 128;
A72_2.MCU_NAVSS_UDMA_Normal_capacity_Rx_channels_count           = 8;
A72_2.MCU_NAVSS_UDMA_Normal_capacity_Tx_channels_count           = 8;
A72_2.MCU_NAVSS_UDMA_Normal_capacity_Tx_channels_blockCount      = 3;
A72_2.MCU_NAVSS_Interrupt_aggregator_Virtual_interrupts_count    = 32;
A72_2.Main_NAVSS_Interrupt_router_count                          = 80;
A72_2.Main_NAVSS_UDMA_Ultra_High_capacity_Tx_channels_blockCount = 1;
A72_2.Main_NAVSS_UDMA_High_capacity_Tx_channels_blockCount       = 1;
A72_2.Main_NAVSS_Interrupt_aggregator_Virtual_interrupts_count   = 56;
A72_2.Main_NAVSS_UDMA_Normal_capacity_Rx_channels_count          = 25;
A72_2.Main_NAVSS_UDMA_Normal_capacity_Tx_channels_count          = 25;
A72_2.Main_NAVSS_Ring_accelerator_Free_rings_count               = 128;

A72_3.allocOrder                                               = 2;
A72_3.Main_NAVSS_UDMA_Rx_free_flows_count                      = 16;
A72_3.Main_NAVSS_Ring_accelerator_ring_monitors_count          = 2;
A72_3.Main_NAVSS_Non_secure_proxies_count                      = 4;
A72_3.Main_NAVSS_Ring_accelerator_virt_id_range_start          = 5;
A72_3.Main_NAVSS_Ring_accelerator_virt_id_range_count          = 1;
A72_3.MCU_NAVSS_UDMA_Rx_free_flows_count                       = 4;
A72_3.MCU_NAVSS_Ring_accelerator_Free_rings_count              = 8;
A72_3.MCU_NAVSS_Ring_accelerator_ring_monitors_count           = 2;
A72_3.MCU_NAVSS_Non_secure_proxies_count                       = 4;
A72_3.Main_GPIO_Interrupt_router_count                         = 12;
A72_3.Wakeup_GPIO_Interrupt_router_count                       = 6;
A72_3.Main_NAVSS_UDMA_Interrupt_aggregator_Global_events_count = 512;
A72_3.MCU_NAVSS_UDMA_Normal_capacity_Rx_channels_count         = 4;
A72_3.MCU_NAVSS_UDMA_Normal_capacity_Tx_channels_count         = 4;
A72_3.Main_NAVSS_Interrupt_router_count                        = 14;
A72_3.Main_NAVSS_Interrupt_aggregator_Virtual_interrupts_count = 24;
A72_3.Main_NAVSS_UDMA_Normal_capacity_Rx_channels_count        = 1;
A72_3.Main_NAVSS_UDMA_Normal_capacity_Tx_channels_count        = 1;
A72_3.Main_NAVSS_Ring_accelerator_Free_rings_count             = 10;

C7X_0_1.allocOrder                                               = 3;
C7X_0_1.Main_NAVSS_UDMA_Extended_Tx_channels_count               = 8;
C7X_0_1.Main_NAVSS_UDMA_Normal_capacity_Rx_channels_count        = 2;
C7X_0_1.Main_NAVSS_UDMA_Normal_capacity_Tx_channels_count        = 2;
C7X_0_1.Main_NAVSS_UDMA_Normal_capacity_Tx_channels_blockCount   = 1;
C7X_0_1.Main_NAVSS_Ring_accelerator_ring_monitors_count          = 3;
C7X_0_1.Main_NAVSS_Non_secure_proxies_count                      = 4;
C7X_0_1.MCU_NAVSS_UDMA_Normal_capacity_Rx_channels_count         = 1;
C7X_0_1.MCU_NAVSS_UDMA_Normal_capacity_Tx_channels_count         = 1;
C7X_0_1.MCU_NAVSS_UDMA_Normal_capacity_Tx_channels_blockCount    = 1;
C7X_0_1.MCU_NAVSS_Ring_accelerator_Free_rings_count              = 8;
C7X_0_1.MCU_NAVSS_Non_secure_proxies_count                       = 4;
C7X_0_1.Main_NAVSS_Interrupt_router_count                        = 21;
C7X_0_1.Main_NAVSS_Interrupt_aggregator_Virtual_interrupts_count = 12;
C7X_0_1.Main_NAVSS_UDMA_Interrupt_aggregator_Global_events_count = 256;
C7X_0_1.MCU_NAVSS_Ring_accelerator_ring_monitors_count           = 2;
C7X_0_1.Main_NAVSS_Ring_accelerator_Free_rings_count             = 10;

C7X_1_1.allocOrder                                               = 4;
C7X_1_1.Main_NAVSS_UDMA_Extended_Tx_channels_count               = 8;
C7X_1_1.Main_NAVSS_UDMA_Normal_capacity_Rx_channels_count        = 2;
C7X_1_1.Main_NAVSS_UDMA_Normal_capacity_Tx_channels_count        = 2;
C7X_1_1.Main_NAVSS_UDMA_Normal_capacity_Tx_channels_blockCount   = 1;
C7X_1_1.Main_NAVSS_Ring_accelerator_ring_monitors_count          = 3;
C7X_1_1.Main_NAVSS_Non_secure_proxies_count                      = 4;
C7X_1_1.MCU_NAVSS_UDMA_Normal_capacity_Rx_channels_count         = 1;
C7X_1_1.MCU_NAVSS_UDMA_Normal_capacity_Tx_channels_count         = 1;
C7X_1_1.MCU_NAVSS_UDMA_Normal_capacity_Tx_channels_blockCount    = 1;
C7X_1_1.MCU_NAVSS_Ring_accelerator_Free_rings_count              = 8;
C7X_1_1.MCU_NAVSS_Non_secure_proxies_count                       = 4;
C7X_1_1.Main_NAVSS_Interrupt_router_count                        = 21;
C7X_1_1.Main_NAVSS_Interrupt_aggregator_Virtual_interrupts_count = 12;
C7X_1_1.Main_NAVSS_UDMA_Interrupt_aggregator_Global_events_count = 256;
C7X_1_1.MCU_NAVSS_Ring_accelerator_ring_monitors_count           = 2;
C7X_1_1.Main_NAVSS_Ring_accelerator_Free_rings_count             = 20;

C7X_2_1.allocOrder                                               = 5;
C7X_2_1.Main_NAVSS_UDMA_Normal_capacity_Rx_channels_count        = 2;
C7X_2_1.Main_NAVSS_UDMA_Normal_capacity_Tx_channels_blockCount   = 1;
C7X_2_1.Main_NAVSS_UDMA_Normal_capacity_Tx_channels_count        = 2;
C7X_2_1.Main_NAVSS_Ring_accelerator_ring_monitors_count          = 1;
C7X_2_1.MCU_NAVSS_Ring_accelerator_Free_rings_count              = 8;
C7X_2_1.MCU_NAVSS_Non_secure_proxies_count                       = 4;
C7X_2_1.MCU_NAVSS_UDMA_Normal_capacity_Rx_channels_count         = 1;
C7X_2_1.MCU_NAVSS_UDMA_Normal_capacity_Tx_channels_count         = 1;
C7X_2_1.MCU_NAVSS_UDMA_Normal_capacity_Tx_channels_blockCount    = 1;
C7X_2_1.Main_NAVSS_UDMA_Interrupt_aggregator_Global_events_count = 256;
C7X_2_1.MCU_NAVSS_Ring_accelerator_ring_monitors_count           = 2;
C7X_2_1.Main_NAVSS_UDMA_Extended_Tx_channels_count               = 6;
C7X_2_1.Main_NAVSS_Non_secure_proxies_count                      = 4;
C7X_2_1.Main_NAVSS_Interrupt_router_count                        = 12;
C7X_2_1.Main_NAVSS_Interrupt_aggregator_Virtual_interrupts_count = 10;
C7X_2_1.Main_NAVSS_Ring_accelerator_Free_rings_count             = 16;

C7X_3_1.allocOrder                                               = 6;
C7X_3_1.Main_NAVSS_UDMA_Extended_Tx_channels_count               = 4;
C7X_3_1.Main_NAVSS_UDMA_Normal_capacity_Rx_channels_count        = 2;
C7X_3_1.Main_NAVSS_UDMA_Normal_capacity_Tx_channels_count        = 2;
C7X_3_1.Main_NAVSS_UDMA_Normal_capacity_Tx_channels_blockCount   = 1;
C7X_3_1.Main_NAVSS_Ring_accelerator_ring_monitors_count          = 1;
C7X_3_1.MCU_NAVSS_Ring_accelerator_Free_rings_count              = 8;
C7X_3_1.MCU_NAVSS_UDMA_Normal_capacity_Rx_channels_count         = 1;
C7X_3_1.MCU_NAVSS_UDMA_Normal_capacity_Tx_channels_count         = 1;
C7X_3_1.MCU_NAVSS_UDMA_Normal_capacity_Tx_channels_blockCount    = 1;
C7X_3_1.Main_NAVSS_UDMA_Interrupt_aggregator_Global_events_count = 256;
C7X_3_1.MCU_NAVSS_Ring_accelerator_ring_monitors_count           = 2;
C7X_3_1.Main_NAVSS_Non_secure_proxies_count                      = 4;
C7X_3_1.MCU_NAVSS_Non_secure_proxies_count                       = 4;
C7X_3_1.Main_NAVSS_Interrupt_router_count                        = 12;
C7X_3_1.Main_NAVSS_Interrupt_aggregator_Virtual_interrupts_count = 10;
C7X_3_1.Main_NAVSS_Ring_accelerator_Free_rings_count             = 13;

MAIN_0_R5_0.allocOrder                                                 = 7;
MAIN_0_R5_0.Main_NAVSS_UDMA_Normal_capacity_Rx_channels_count          = 12;
MAIN_0_R5_0.Main_NAVSS_UDMA_Normal_capacity_Tx_channels_count          = 12;
MAIN_0_R5_0.Main_NAVSS_UDMA_Extended_Tx_channels_count                 = 2;
MAIN_0_R5_0.Main_NAVSS_Ring_accelerator_ring_monitors_count            = 6;
MAIN_0_R5_0.Main_NAVSS_Non_secure_proxies_count                        = 12;
MAIN_0_R5_0.MCU_NAVSS_UDMA_Normal_capacity_Rx_channels_count           = 2;
MAIN_0_R5_0.MCU_NAVSS_UDMA_Normal_capacity_Tx_channels_count           = 2;
MAIN_0_R5_0.MCU_NAVSS_UDMA_Normal_capacity_Tx_channels_blockCount      = 1;
MAIN_0_R5_0.MCU_NAVSS_UDMA_Rx_free_flows_count                         = 8;
MAIN_0_R5_0.MCU_NAVSS_Ring_accelerator_Free_rings_count                = 16;
MAIN_0_R5_0.MCU_NAVSS_Ring_accelerator_ring_monitors_count             = 3;
MAIN_0_R5_0.MCU_NAVSS_Non_secure_proxies_count                         = 16;
MAIN_0_R5_0.Main_NAVSS_Interrupt_router_count                          = 28;
MAIN_0_R5_0.Main_GPIO_Interrupt_router_count                           = 4;
MAIN_0_R5_0.Wakeup_GPIO_Interrupt_router_count                         = 2;
MAIN_0_R5_0.Main_NAVSS_Interrupt_aggregator_Virtual_interrupts_count   = 28;
MAIN_0_R5_0.Main_NAVSS_UDMA_Interrupt_aggregator_Global_events_count   = 512;
MAIN_0_R5_0.Main_NAVSS_UDMA_Normal_capacity_Tx_channels_blockCount     = 4;
MAIN_0_R5_0.Main_NAVSS_UDMA_Ultra_High_capacity_Tx_channels_blockCount = 1;
MAIN_0_R5_0.Main_NAVSS_UDMA_High_capacity_Tx_channels_blockCount       = 1;
MAIN_0_R5_0.Main_NAVSS_UDMA_Extended_Tx_channels_hwa_start             = 117;
MAIN_0_R5_0.Main_NAVSS_UDMA_Extended_Tx_channels_hwa_count             = 96;
MAIN_0_R5_0.Main_NAVSS_Ring_accelerator_Free_rings_count               = 128;
MAIN_0_R5_0.Main_NAVSS_Block_Copy_DMA_Split_TR_Rx_channels_count       = 32;
MAIN_0_R5_0.Main_NAVSS_Block_Copy_DMA_Split_TR_Tx_channels_count       = 16;

MAIN_0_R5_2.allocOrder                                               = 8;
MAIN_0_R5_2.Main_NAVSS_UDMA_Normal_capacity_Tx_channels_blockCount   = 1;
MAIN_0_R5_2.Main_NAVSS_UDMA_Normal_capacity_Rx_channels_count        = 1;
MAIN_0_R5_2.Main_NAVSS_UDMA_Normal_capacity_Tx_channels_count        = 4;
MAIN_0_R5_2.Main_NAVSS_Ring_accelerator_ring_monitors_count          = 3;
MAIN_0_R5_2.Main_NAVSS_Non_secure_proxies_count                      = 4;
MAIN_0_R5_2.MCU_NAVSS_UDMA_Normal_capacity_Tx_channels_blockCount    = 1;
MAIN_0_R5_2.MCU_NAVSS_UDMA_Rx_free_flows_count                       = 4;
MAIN_0_R5_2.MCU_NAVSS_UDMA_Normal_capacity_Rx_channels_count         = 1;
MAIN_0_R5_2.MCU_NAVSS_UDMA_Normal_capacity_Tx_channels_count         = 1;
MAIN_0_R5_2.MCU_NAVSS_Ring_accelerator_Free_rings_count              = 8;
MAIN_0_R5_2.MCU_NAVSS_Non_secure_proxies_count                       = 4;
MAIN_0_R5_2.Main_NAVSS_Interrupt_router_count                        = 28;
MAIN_0_R5_2.Main_GPIO_Interrupt_router_count                         = 4;
MAIN_0_R5_2.Wakeup_GPIO_Interrupt_router_count                       = 2;
MAIN_0_R5_2.Main_NAVSS_Interrupt_aggregator_Virtual_interrupts_count = 8;
MAIN_0_R5_2.Main_NAVSS_UDMA_Interrupt_aggregator_Global_events_count = 256;
MAIN_0_R5_2.MCU_NAVSS_Ring_accelerator_ring_monitors_count           = 2;
MAIN_0_R5_2.Main_NAVSS_UDMA_Extended_Tx_channels_count               = 2;
MAIN_0_R5_2.Main_NAVSS_UDMA_Extended_Tx_channels_hwa_start           = 309;
MAIN_0_R5_2.Main_NAVSS_UDMA_Extended_Tx_channels_hwa_count           = 32;
MAIN_0_R5_2.Main_NAVSS_Ring_accelerator_Free_rings_count             = 46;

MAIN_1_R5_0.allocOrder                                               = 9;
MAIN_1_R5_0.Main_NAVSS_UDMA_Normal_capacity_Tx_channels_count        = 2;
MAIN_1_R5_0.Main_NAVSS_UDMA_Normal_capacity_Tx_channels_blockCount   = 1;
MAIN_1_R5_0.Main_NAVSS_UDMA_Normal_capacity_Rx_channels_count        = 2;
MAIN_1_R5_0.Main_NAVSS_Ring_accelerator_ring_monitors_count          = 3;
MAIN_1_R5_0.Main_NAVSS_Non_secure_proxies_count                      = 4;
MAIN_1_R5_0.MCU_NAVSS_UDMA_Normal_capacity_Rx_channels_count         = 1;
MAIN_1_R5_0.MCU_NAVSS_UDMA_Normal_capacity_Tx_channels_count         = 1;
MAIN_1_R5_0.MCU_NAVSS_UDMA_Normal_capacity_Tx_channels_blockCount    = 1;
MAIN_1_R5_0.MCU_NAVSS_UDMA_Rx_free_flows_count                       = 4;
MAIN_1_R5_0.MCU_NAVSS_Ring_accelerator_Free_rings_count              = 8;
MAIN_1_R5_0.MCU_NAVSS_Non_secure_proxies_count                       = 4;
MAIN_1_R5_0.Main_NAVSS_Interrupt_router_count                        = 28;
MAIN_1_R5_0.Main_GPIO_Interrupt_router_count                         = 4;
MAIN_1_R5_0.Main_NAVSS_Interrupt_aggregator_Virtual_interrupts_count = 12;
MAIN_1_R5_0.Main_NAVSS_UDMA_Interrupt_aggregator_Global_events_count = 256;
MAIN_1_R5_0.MCU_NAVSS_Ring_accelerator_ring_monitors_count           = 2;
MAIN_1_R5_0.Main_NAVSS_Ring_accelerator_Free_rings_count             = 10;

MAIN_1_R5_2.allocOrder                                               = 10;
MAIN_1_R5_2.Main_NAVSS_UDMA_Normal_capacity_Rx_channels_count        = 2;
MAIN_1_R5_2.Main_NAVSS_UDMA_Normal_capacity_Tx_channels_count        = 2;
MAIN_1_R5_2.Main_NAVSS_UDMA_Normal_capacity_Tx_channels_blockCount   = 1;
MAIN_1_R5_2.Main_NAVSS_Ring_accelerator_ring_monitors_count          = 3;
MAIN_1_R5_2.Main_NAVSS_Non_secure_proxies_count                      = 4;
MAIN_1_R5_2.MCU_NAVSS_UDMA_Normal_capacity_Rx_channels_count         = 1;
MAIN_1_R5_2.MCU_NAVSS_UDMA_Normal_capacity_Tx_channels_count         = 1;
MAIN_1_R5_2.MCU_NAVSS_UDMA_Normal_capacity_Tx_channels_blockCount    = 1;
MAIN_1_R5_2.MCU_NAVSS_UDMA_Rx_free_flows_count                       = 4;
MAIN_1_R5_2.MCU_NAVSS_Ring_accelerator_Free_rings_count              = 8;
MAIN_1_R5_2.MCU_NAVSS_Non_secure_proxies_count                       = 4;
MAIN_1_R5_2.Main_NAVSS_Interrupt_router_count                        = 28;
MAIN_1_R5_2.Main_GPIO_Interrupt_router_count                         = 4;
MAIN_1_R5_2.Main_NAVSS_UDMA_Interrupt_aggregator_Global_events_count = 256;
MAIN_1_R5_2.Main_NAVSS_Interrupt_aggregator_Virtual_interrupts_count = 8;
MAIN_1_R5_2.MCU_NAVSS_Ring_accelerator_ring_monitors_count           = 2;
MAIN_1_R5_2.Main_NAVSS_Ring_accelerator_Free_rings_count             = 20;

MAIN_2_R5_0.allocOrder                                               = 11;
MAIN_2_R5_0.Main_NAVSS_Ring_accelerator_ring_monitors_count          = 1;
MAIN_2_R5_0.Main_NAVSS_Non_secure_proxies_count                      = 4;
MAIN_2_R5_0.MCU_NAVSS_Ring_accelerator_Free_rings_count              = 8;
MAIN_2_R5_0.Main_GPIO_Interrupt_router_count                         = 4;
MAIN_2_R5_0.Main_NAVSS_UDMA_Interrupt_aggregator_Global_events_count = 256;
MAIN_2_R5_0.Main_NAVSS_Interrupt_router_count                        = 28;
MAIN_2_R5_0.MCU_NAVSS_Ring_accelerator_ring_monitors_count           = 2;
MAIN_2_R5_0.MCU_NAVSS_Non_secure_proxies_count                       = 3;
MAIN_2_R5_0.MCU_NAVSS_UDMA_Rx_free_flows_count                       = 2;
MAIN_2_R5_0.MCU_NAVSS_UDMA_Normal_capacity_Rx_channels_count         = 1;
MAIN_2_R5_0.MCU_NAVSS_UDMA_Normal_capacity_Tx_channels_count         = 1;
MAIN_2_R5_0.MCU_NAVSS_UDMA_Normal_capacity_Tx_channels_blockCount    = 1;
MAIN_2_R5_0.Main_NAVSS_Interrupt_aggregator_Virtual_interrupts_count = 10;
MAIN_2_R5_0.Main_NAVSS_UDMA_Normal_capacity_Rx_channels_count        = 2;
MAIN_2_R5_0.Main_NAVSS_UDMA_Normal_capacity_Tx_channels_count        = 2;
MAIN_2_R5_0.Main_NAVSS_UDMA_Extended_Tx_channels_hwa_start           = 213;
MAIN_2_R5_0.Main_NAVSS_UDMA_Extended_Tx_channels_hwa_count           = 96;
MAIN_2_R5_0.Main_NAVSS_Ring_accelerator_Free_rings_count             = 64;
MAIN_2_R5_0.Main_NAVSS_UDMA_Normal_capacity_Tx_channels_blockCount   = 3;

MAIN_2_R5_2.allocOrder                                               = 12;
MAIN_2_R5_2.Main_NAVSS_UDMA_Normal_capacity_Tx_channels_blockCount   = 1;
MAIN_2_R5_2.Main_NAVSS_Ring_accelerator_ring_monitors_count          = 1;
MAIN_2_R5_2.Main_NAVSS_Non_secure_proxies_count                      = 4;
MAIN_2_R5_2.MCU_NAVSS_Ring_accelerator_Free_rings_count              = 4;
MAIN_2_R5_2.Main_GPIO_Interrupt_router_count                         = 4;
MAIN_2_R5_2.Main_NAVSS_UDMA_Interrupt_aggregator_Global_events_count = 256;
MAIN_2_R5_2.Main_NAVSS_Interrupt_router_count                        = 28;
MAIN_2_R5_2.MCU_NAVSS_Ring_accelerator_ring_monitors_count           = 2;
MAIN_2_R5_2.MCU_NAVSS_Non_secure_proxies_count                       = 2;
MAIN_2_R5_2.MCU_NAVSS_UDMA_Rx_free_flows_count                       = 2;
MAIN_2_R5_2.MCU_NAVSS_UDMA_Normal_capacity_Rx_channels_count         = 1;
MAIN_2_R5_2.MCU_NAVSS_UDMA_Normal_capacity_Tx_channels_count         = 1;
MAIN_2_R5_2.MCU_NAVSS_UDMA_Normal_capacity_Tx_channels_blockCount    = 1;
MAIN_2_R5_2.Main_NAVSS_Interrupt_aggregator_Virtual_interrupts_count = 10;
MAIN_2_R5_2.Main_NAVSS_UDMA_Normal_capacity_Rx_channels_count        = 2;
MAIN_2_R5_2.Main_NAVSS_UDMA_Normal_capacity_Tx_channels_count        = 2;
MAIN_2_R5_2.Main_NAVSS_Ring_accelerator_Free_rings_count             = 10;

MCU_0_R5_0.allocOrder                                               = 13;
MCU_0_R5_0.Main_NAVSS_Ring_accelerator_ring_monitors_count          = 1;
MCU_0_R5_0.Main_NAVSS_Non_secure_proxies_count                      = 4;
MCU_0_R5_0.MCU_NAVSS_UDMA_Normal_capacity_Tx_channels_count         = 3;
MCU_0_R5_0.MCU_NAVSS_UDMA_Normal_capacity_Tx_channels_blockCount    = 2;
MCU_0_R5_0.MCU_NAVSS_UDMA_Normal_capacity_Rx_channels_count         = 3;
MCU_0_R5_0.MCU_NAVSS_UDMA_Rx_free_flows_count                       = 8;
MCU_0_R5_0.MCU_NAVSS_Ring_accelerator_Free_rings_count              = 32;
MCU_0_R5_0.MCU_NAVSS_Ring_accelerator_ring_monitors_count           = 3;
MCU_0_R5_0.MCU_NAVSS_Non_secure_proxies_count                       = 4;
MCU_0_R5_0.MCU_NAVSS_UDMA_High_capacity_Tx_channels_count           = 2;
MCU_0_R5_0.MCU_NAVSS_UDMA_High_capacity_Rx_channels_count           = 2;
MCU_0_R5_0.Main_NAVSS_Interrupt_router_count                        = 4;
MCU_0_R5_0.MCU_NAVSS_Interrupt_router_count                         = 12;
MCU_0_R5_0.Wakeup_GPIO_Interrupt_router_count                       = 8;
MCU_0_R5_0.Main_2_MCU_Level_Interrupt_router_count                  = 32;
MCU_0_R5_0.Main_2_MCU_Pulse_Interrupt_router_count                  = 24;
MCU_0_R5_0.Main_NAVSS_UDMA_Interrupt_aggregator_Global_events_count = 32;
MCU_0_R5_0.MCU_NAVSS_Interrupt_aggregator_Global_events_count       = 256;
MCU_0_R5_0.MCU_NAVSS_Interrupt_aggregator_Virtual_interrupts_count  = 64;
MCU_0_R5_0.Main_GPIO_Interrupt_router_count                         = 4;
MCU_0_R5_0.Main_NAVSS_Ring_accelerator_Free_rings_count             = 4;
MCU_0_R5_0.Main_NAVSS_UDMA_Normal_capacity_Tx_channels_blockCount   = 1;

MCU_0_R5_2.allocOrder                                               = 14;
MCU_0_R5_2.Main_NAVSS_Ring_accelerator_ring_monitors_count          = 1;
MCU_0_R5_2.Main_NAVSS_Non_secure_proxies_count                      = 4;
MCU_0_R5_2.MCU_NAVSS_Ring_accelerator_Free_rings_count              = 12;
MCU_0_R5_2.MCU_NAVSS_Ring_accelerator_ring_monitors_count           = 3;
MCU_0_R5_2.MCU_NAVSS_Non_secure_proxies_count                       = 4;
MCU_0_R5_2.MCU_NAVSS_UDMA_Normal_capacity_Rx_channels_count         = 2;
MCU_0_R5_2.MCU_NAVSS_UDMA_Normal_capacity_Tx_channels_count         = 2;
MCU_0_R5_2.Main_NAVSS_Interrupt_router_count                        = 4;
MCU_0_R5_2.Wakeup_GPIO_Interrupt_router_count                       = 8;
MCU_0_R5_2.MCU_NAVSS_Interrupt_router_count                         = 20;
MCU_0_R5_2.Main_2_MCU_Level_Interrupt_router_count                  = 24;
MCU_0_R5_2.Main_2_MCU_Pulse_Interrupt_router_count                  = 16;
MCU_0_R5_2.MCU_NAVSS_Interrupt_aggregator_Global_events_count       = 64;
MCU_0_R5_2.Main_NAVSS_UDMA_Interrupt_aggregator_Global_events_count = 32;
MCU_0_R5_2.MCU_NAVSS_Interrupt_aggregator_Virtual_interrupts_count  = 4;
MCU_0_R5_2.Main_GPIO_Interrupt_router_count                         = 4;
MCU_0_R5_2.MCU_NAVSS_UDMA_Rx_free_flows_count                       = 4;
MCU_0_R5_2.Main_NAVSS_Ring_accelerator_Free_rings_count             = 4;
MCU_0_R5_2.Main_NAVSS_UDMA_Normal_capacity_Tx_channels_blockCount   = 1;

resourceSharing1.$name              = "MAIN_NAVSS_BCDMA_RX";
resourceSharing1.resourceName       = "Main NAVSS Block Copy DMA Split TR Rx channels";
resourceSharing1.sharedFromHostName = "MAIN_0_R5_0";
resourceSharing1.sharedToHostName   = "A72_2";

resourceSharing2.$name              = "MAIN_NAVSS_BCDMA_TX";
resourceSharing2.resourceName       = "Main NAVSS Block Copy DMA Split TR Tx channels";
resourceSharing2.sharedFromHostName = "MAIN_0_R5_0";
resourceSharing2.sharedToHostName   = "A72_2";

resourceSharing3.$name              = "MAIN_NAVSS_BCDMA_RX_RING";
resourceSharing3.resourceName       = "Main NAVSS Block Copy DMA Rings for Split TR RX channels";
resourceSharing3.sharedFromHostName = "MAIN_0_R5_0";
resourceSharing3.sharedToHostName   = "A72_2";

resourceSharing4.$name              = "MAIN_NAVSS_BCDMA_TX_RING";
resourceSharing4.resourceName       = "Main NAVSS Block Copy DMA Rings for Split TR TX channels";
resourceSharing4.sharedFromHostName = "MAIN_0_R5_0";
resourceSharing4.sharedToHostName   = "A72_2";
