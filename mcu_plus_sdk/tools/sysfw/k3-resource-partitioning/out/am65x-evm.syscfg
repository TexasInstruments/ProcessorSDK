/**
 * @cliArgs --device "AM65xx_SR1.0" --package "ACD" --part "Default" --product "K3-Respart-Tool@1.0"
 * @versions {"data":"20190916","timestamp":"2021031521","tool":"1.8.0+1863","templates":null}
 */

/**
 * Import the modules used in this configuration.
 */
const A53_2           = scripting.addModule("/modules/am65x/A53_2");
const A53_3           = scripting.addModule("/modules/am65x/A53_3");
const R5_0            = scripting.addModule("/modules/am65x/R5_0");
const R5_2            = scripting.addModule("/modules/am65x/R5_2");
const firewallConfig  = scripting.addModule("/modules/firewallConfig", {}, false);
const firewallConfig1 = firewallConfig.addInstance();
const qosConfig       = scripting.addModule("/modules/qosConfig", {}, false);
const qosConfig1      = qosConfig.addInstance();
const qosConfig2      = qosConfig.addInstance();

/**
 * Write custom configuration values to the imported modules.
 */
A53_2.Compare_event_Interrupt_router_count                          = 12;
A53_2.Main_GPIO_Interrupt_Router_count                              = 20;
A53_2.Main_NAVSS_Interrupt_Router_count                             = 64;
A53_2.Main_NAVSS_Non_secure_proxies_count                           = 12;
A53_2.Main_NAVSS_Ring_accelerator_Free_rings_count                  = 100;
A53_2.Main_NAVSS_Ring_accelerator_virt_id_range_start               = 2;
A53_2.Main_NAVSS_Ring_accelerator_virt_id_range_count               = 1;
A53_2.Main_NAVSS_Ring_monitors_count                                = 8;
A53_2.Main_NAVSS_UDMA_Rx_Free_flows_count                           = 64;
A53_2.Main_NAVSS_UDMA_High_capacity_Rx_channels_count               = 2;
A53_2.Main_NAVSS_UDMA_extended_Tx_channels_count                    = 4;
A53_2.Main_NAVSS_UDMA_High_capacity_Tx_channels_count               = 3;
A53_2.Main_NAVSS_UDMA_Interrupt_aggregator_Virtual_interrupts_count = 80;
A53_2.Main_NAVSS_UDMA_Interrupt_aggregator_Global_events_count      = 1024;
A53_2.MCU_NAVSS_Non_secure_proxies_count                            = 12;
A53_2.MCU_NAVSS_Ring_accelerator_Free_rings_count                   = 32;
A53_2.MCU_NAVSS_Ring_monitors_count                                 = 8;
A53_2.MCU_NAVSS_UDMA_Rx_free_flows_count                            = 16;
A53_2.MCU_NAVSS_Interrupt_aggregator_Virtual_interrupts_count       = 80;
A53_2.MCU_NAVSS_Interrupt_aggregator_Global_events_count            = 512;
A53_2.Wakeup_GPIO_Interrupt_router_count                            = 4;
A53_2.allocOrder                                                    = 1;
A53_2.Main_NAVSS_UDMA_Normal_capacity_Rx_channels_count             = 52;
A53_2.Main_NAVSS_UDMA_Normal_capacity_Tx_channels_count             = 38;
A53_2.Main_NAVSS_UDMA_Normal_capacity_Tx_channels_blockCount        = 12;
A53_2.MCU_NAVSS_UDMA_Normal_capacity_Rx_channels_count              = 12;
A53_2.MCU_NAVSS_UDMA_Normal_capacity_Tx_channels_count              = 12;
A53_2.MCU_NAVSS_UDMA_Normal_capacity_Tx_channels_blockCount         = 2;

A53_3.Compare_event_Interrupt_router_count                          = 4;
A53_3.Main_NAVSS_Interrupt_Router_count                             = 40;
A53_3.Main_NAVSS_Non_secure_proxies_count                           = 4;
A53_3.Main_NAVSS_Ring_accelerator_Free_rings_count                  = 50;
A53_3.Main_NAVSS_Ring_accelerator_virt_id_range_start               = 3;
A53_3.Main_NAVSS_Ring_accelerator_virt_id_range_count               = 1;
A53_3.Main_NAVSS_UDMA_Rx_Free_flows_count                           = 8;
A53_3.Main_NAVSS_UDMA_extended_Tx_channels_count                    = 4;
A53_3.Main_NAVSS_UDMA_Interrupt_aggregator_Virtual_interrupts_count = 30;
A53_3.Main_NAVSS_UDMA_Interrupt_aggregator_Global_events_count      = 512;
A53_3.MCU_NAVSS_Non_secure_proxies_count                            = 4;
A53_3.MCU_NAVSS_Ring_accelerator_Free_rings_count                   = 8;
A53_3.MCU_NAVSS_UDMA_Rx_free_flows_count                            = 4;
A53_3.MCU_NAVSS_UDMA_Normal_capacity_Rx_channels_count              = 4;
A53_3.MCU_NAVSS_UDMA_Normal_capacity_Tx_channels_count              = 4;
A53_3.MCU_NAVSS_Interrupt_aggregator_Virtual_interrupts_count       = 30;
A53_3.MCU_NAVSS_Interrupt_aggregator_Global_events_count            = 128;
A53_3.Wakeup_GPIO_Interrupt_router_count                            = 4;
A53_3.allocOrder                                                    = 2;
A53_3.Main_GPIO_Interrupt_Router_count                              = 4;
A53_3.Main_NAVSS_UDMA_Normal_capacity_Rx_channels_count             = 8;
A53_3.Main_NAVSS_UDMA_Normal_capacity_Tx_channels_count             = 8;

R5_0.Compare_event_Interrupt_router_count                          = 8;
R5_0.Main_2_MCU_Level_Interrupt_Router_count                       = 32;
R5_0.Main_2_MCU_Pulse_Interrupt_Router_count                       = 24;
R5_0.Main_NAVSS_Interrupt_Router_count                             = 4;
R5_0.Main_NAVSS_Non_secure_proxies_count                           = 16;
R5_0.Main_NAVSS_Ring_monitors_count                                = 8;
R5_0.Main_NAVSS_UDMA_Rx_Free_flows_count                           = 64;
R5_0.Main_NAVSS_UDMA_High_capacity_Rx_channels_count               = 2;
R5_0.Main_NAVSS_UDMA_extended_Tx_channels_count                    = 12;
R5_0.Main_NAVSS_UDMA_High_capacity_Tx_channels_count               = 2;
R5_0.Main_NAVSS_UDMA_Interrupt_aggregator_Virtual_interrupts_count = 50;
R5_0.Main_NAVSS_UDMA_Interrupt_aggregator_Global_events_count      = 512;
R5_0.MCU_NAVSS_Interrupt_router_count                              = 28;
R5_0.MCU_NAVSS_Non_secure_proxies_count                            = 24;
R5_0.MCU_NAVSS_Ring_accelerator_Free_rings_count                   = 60;
R5_0.MCU_NAVSS_Ring_monitors_count                                 = 8;
R5_0.MCU_NAVSS_UDMA_Rx_free_flows_count                            = 16;
R5_0.MCU_NAVSS_UDMA_High_capacity_Rx_channels_count                = 2;
R5_0.MCU_NAVSS_UDMA_High_capacity_Tx_channels_count                = 2;
R5_0.MCU_NAVSS_Interrupt_aggregator_Virtual_interrupts_count       = 50;
R5_0.MCU_NAVSS_Interrupt_aggregator_Global_events_count            = 256;
R5_0.Wakeup_GPIO_Interrupt_router_count                            = 4;
R5_0.allocOrder                                                    = 3;
R5_0.Main_NAVSS_UDMA_Normal_capacity_Tx_channels_blockCount        = 4;
R5_0.MCU_NAVSS_UDMA_Normal_capacity_Rx_channels_count              = 10;
R5_0.MCU_NAVSS_UDMA_Normal_capacity_Tx_channels_count              = 10;
R5_0.MCU_NAVSS_UDMA_Normal_capacity_Tx_channels_blockCount         = 4;
R5_0.Main_NAVSS_Ring_accelerator_Free_rings_count                  = 256;
R5_0.Main_GPIO_Interrupt_Router_count                              = 4;
R5_0.Main_NAVSS_UDMA_Normal_capacity_Rx_channels_count             = 32;
R5_0.Main_NAVSS_UDMA_Normal_capacity_Tx_channels_count             = 32;
R5_0.Timesync_Interrupt_router_count                               = 16;
R5_0.shareResource                                                 = "R5_1";

R5_2.Compare_event_Interrupt_router_count                          = 8;
R5_2.Main_2_MCU_Level_Interrupt_Router_count                       = 32;
R5_2.Main_2_MCU_Pulse_Interrupt_Router_count                       = 24;
R5_2.Main_NAVSS_Interrupt_Router_count                             = 4;
R5_2.Main_NAVSS_Non_secure_proxies_count                           = 16;
R5_2.Main_NAVSS_Ring_monitors_count                                = 8;
R5_2.Main_NAVSS_UDMA_Rx_Free_flows_count                           = 8;
R5_2.Main_NAVSS_UDMA_High_capacity_Rx_channels_count               = 2;
R5_2.Main_NAVSS_UDMA_extended_Tx_channels_count                    = 12;
R5_2.Main_NAVSS_UDMA_High_capacity_Tx_channels_count               = 2;
R5_2.Main_NAVSS_UDMA_Interrupt_aggregator_Virtual_interrupts_count = 50;
R5_2.Main_NAVSS_UDMA_Interrupt_aggregator_Global_events_count      = 512;
R5_2.MCU_NAVSS_Interrupt_router_count                              = 28;
R5_2.MCU_NAVSS_Non_secure_proxies_count                            = 24;
R5_2.MCU_NAVSS_Ring_accelerator_Free_rings_count                   = 60;
R5_2.MCU_NAVSS_Ring_monitors_count                                 = 8;
R5_2.MCU_NAVSS_UDMA_Rx_free_flows_count                            = 8;
R5_2.MCU_NAVSS_Interrupt_aggregator_Virtual_interrupts_count       = 50;
R5_2.MCU_NAVSS_Interrupt_aggregator_Global_events_count            = 256;
R5_2.Wakeup_GPIO_Interrupt_router_count                            = 4;
R5_2.allocOrder                                                    = 4;
R5_2.Main_NAVSS_UDMA_Normal_capacity_Rx_channels_count             = 14;
R5_2.Main_NAVSS_UDMA_Normal_capacity_Tx_channels_count             = 14;
R5_2.Main_NAVSS_UDMA_Normal_capacity_Tx_channels_blockCount        = 2;
R5_2.MCU_NAVSS_UDMA_Normal_capacity_Rx_channels_count              = 12;
R5_2.MCU_NAVSS_UDMA_Normal_capacity_Tx_channels_count              = 12;
R5_2.MCU_NAVSS_UDMA_Normal_capacity_Tx_channels_blockCount         = 2;
R5_2.Main_NAVSS_Ring_accelerator_Free_rings_count                  = 32;
R5_2.Main_GPIO_Interrupt_Router_count                              = 4;
R5_2.Timesync_Interrupt_router_count                               = 16;

firewallConfig1.$name                                  = "modules_firewallConfig0";
firewallConfig1.device                                 = "PVU";
firewallConfig1.regions[0].$name                       = "modules_firewallRegion0";
firewallConfig1.regions[0].perms[0].$name              = "modules_firewallPermissions0";
firewallConfig1.regions[0].perms[0].s_user_rd          = false;
firewallConfig1.regions[0].perms[0].s_user_cache       = false;
firewallConfig1.regions[0].perms[0].s_user_debug       = false;
firewallConfig1.regions[0].perms[0].s_supervisor_rd    = false;
firewallConfig1.regions[0].perms[0].s_supervisor_wr    = false;
firewallConfig1.regions[0].perms[0].s_supervisor_cache = false;
firewallConfig1.regions[0].perms[0].s_supervisor_debug = false;
firewallConfig1.regions[0].perms[0].s_user_wr          = false;
firewallConfig1.regions[0].perms[0].ns_user_deb        = false;
firewallConfig1.regions[0].perms[0].ns_user_cache      = false;
firewallConfig1.regions[0].perms[0].ns_user_wr         = false;
firewallConfig1.regions[0].perms[0].ns_user_rd         = false;
firewallConfig1.regions[0].perms[0].hostName           = "A53_2";

qosConfig1.deviceName = "EMMC2SD3SS_GS80_MAIN_0";
qosConfig1.chan       = ["0"];
qosConfig1.atype      = 1;
qosConfig1.virtId     = 3;
qosConfig1.$name      = "EMMC_MMC0";

qosConfig2.deviceName = "EMMC4SD3SS_GS80_MAIN_0";
qosConfig2.atype      = 1;
qosConfig2.virtId     = 2;
qosConfig2.$name      = "SD_MMC1";
