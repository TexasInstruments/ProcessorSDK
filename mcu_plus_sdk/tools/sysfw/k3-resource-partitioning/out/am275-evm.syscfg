/**
 * @cliArgs --device "AM275x" --part "AM2754" --package "ANJ" --product "K3-Respart-Tool@1.0"
 * @versions {"tool":"1.21.2+3837"}
 */

/**
 * Import the modules used in this configuration.
 */
const C7X_0_0           = scripting.addModule("/modules/am275/C7X_0_0");
const C7X_1_0           = scripting.addModule("/modules/am275/C7X_1_0");
const MAIN_0_R5_1       = scripting.addModule("/modules/am275/MAIN_0_R5_1");
const MAIN_0_R5_3       = scripting.addModule("/modules/am275/MAIN_0_R5_3");
const MAIN_1_R5_1       = scripting.addModule("/modules/am275/MAIN_1_R5_1");
const MAIN_1_R5_3       = scripting.addModule("/modules/am275/MAIN_1_R5_3");
const WKUP_0_R5_1       = scripting.addModule("/modules/am275/WKUP_0_R5_1");
const resourceSharing   = scripting.addModule("/modules/resourceSharing", {}, false);
const resourceSharing1  = resourceSharing.addInstance();
const resourceSharing2  = resourceSharing.addInstance();
const resourceSharing3  = resourceSharing.addInstance();
const resourceSharing4  = resourceSharing.addInstance();
const resourceSharing5  = resourceSharing.addInstance();
const resourceSharing6  = resourceSharing.addInstance();
const resourceSharing7  = resourceSharing.addInstance();
const resourceSharing8  = resourceSharing.addInstance();
const resourceSharing9  = resourceSharing.addInstance();
const resourceSharing10 = resourceSharing.addInstance();
const resourceSharing11 = resourceSharing.addInstance();
const resourceSharing12 = resourceSharing.addInstance();
const resourceSharing13 = resourceSharing.addInstance();

/**
 * Write custom configuration values to the imported modules.
 */
C7X_0_0.DMASS0_Interrupt_aggregator_Global_events_count      = 128;
C7X_0_0.DMASS0_Interrupt_aggregator_Virtual_interrupts_count = 16;
C7X_0_0.allocOrder                                           = 5;
C7X_0_0.Block_Copy_DMA_Split_TR_Tx_channel_count             = 5;
C7X_0_0.Block_Copy_DMA_Split_TR_Rx_channel_count             = 5;
C7X_0_0.DMASS_Packet_DMA_Free_Rx_channel_count               = 5;
C7X_0_0.DMASS_Packet_DMA_Free_Tx_channel_count               = 5;
C7X_0_0.Block_Copy_DMA_Block_copy_channel_count              = 5;
C7X_0_0.MCU_GPIO_Interrupt_Router_count                      = 4;
C7X_0_0.MAIN_GPIO_Interrupt_Router_count                     = 8;

C7X_1_0.DMASS0_Interrupt_aggregator_Global_events_count      = 128;
C7X_1_0.DMASS0_Interrupt_aggregator_Virtual_interrupts_count = 16;
C7X_1_0.allocOrder                                           = 6;

MAIN_0_R5_1.MCU_GPIO_Interrupt_Router_count                      = 4;
MAIN_0_R5_1.DMASS0_Interrupt_aggregator_Virtual_interrupts_count = 14;
MAIN_0_R5_1.allocOrder                                           = 1;
MAIN_0_R5_1.DMASS0_Interrupt_aggregator_Global_events_count      = 256;
MAIN_0_R5_1.Block_Copy_DMA_Split_TR_Tx_channel_count             = 5;
MAIN_0_R5_1.Block_Copy_DMA_Split_TR_Rx_channel_count             = 5;
MAIN_0_R5_1.DMASS_Packet_DMA_Free_Rx_channel_count               = 5;
MAIN_0_R5_1.DMASS_Packet_DMA_Free_Tx_channel_count               = 5;
MAIN_0_R5_1.Block_Copy_DMA_Block_copy_channel_count              = 5;
MAIN_0_R5_1.MAIN_GPIO_Interrupt_Router_count                     = 8;

MAIN_0_R5_3.allocOrder                                           = 2;
MAIN_0_R5_3.DMASS0_Interrupt_aggregator_Global_events_count      = 192;
MAIN_0_R5_3.MCU_GPIO_Interrupt_Router_count                      = 4;
MAIN_0_R5_3.MAIN_GPIO_Interrupt_Router_count                     = 8;
MAIN_0_R5_3.DMASS0_Interrupt_aggregator_Virtual_interrupts_count = 14;

MAIN_1_R5_1.allocOrder                                           = 3;
MAIN_1_R5_1.DMASS0_Interrupt_aggregator_Virtual_interrupts_count = 14;
MAIN_1_R5_1.DMASS0_Interrupt_aggregator_Global_events_count      = 256;
MAIN_1_R5_1.MCU_GPIO_Interrupt_Router_count                      = 4;
MAIN_1_R5_1.MAIN_GPIO_Interrupt_Router_count                     = 8;

MAIN_1_R5_3.allocOrder                                           = 4;
MAIN_1_R5_3.DMASS0_Interrupt_aggregator_Global_events_count      = 192;
MAIN_1_R5_3.MCU_GPIO_Interrupt_Router_count                      = 4;
MAIN_1_R5_3.MAIN_GPIO_Interrupt_Router_count                     = 8;
MAIN_1_R5_3.DMASS0_Interrupt_aggregator_Virtual_interrupts_count = 14;

WKUP_0_R5_1.DMASS0_Interrupt_aggregator_Global_events_count      = 256;
WKUP_0_R5_1.shareResource                                        = "WKUP_0_R5_0";
WKUP_0_R5_1.allocOrder                                           = 7;
WKUP_0_R5_1.DMASS0_Interrupt_aggregator_Virtual_interrupts_count = 35;
WKUP_0_R5_1.Block_Copy_DMA_Block_copy_channel_count              = 2;
WKUP_0_R5_1.DMASS_Packet_DMA_Free_Tx_channel_count               = 2;
WKUP_0_R5_1.DMASS_Packet_DMA_Free_Rx_channel_count               = 2;
WKUP_0_R5_1.MCU_GPIO_Interrupt_Router_count                      = 4;
WKUP_0_R5_1.MAIN_GPIO_Interrupt_Router_count                     = 8;

resourceSharing1.resourceName       = "Block Copy DMA Split TR Tx channel";
resourceSharing1.sharedFromHostName = "C7X_0_0";
resourceSharing1.sharedToHostName   = "C7X_1_0";
resourceSharing1.$name              = "C7X_0_0_C7X_1_0_BCDMA_TX";

resourceSharing2.sharedFromHostName = "C7X_0_0";
resourceSharing2.sharedToHostName   = "C7X_1_0";
resourceSharing2.$name              = "C7X_0_0_C7X_1_0_BCDMA_RX";
resourceSharing2.resourceName       = "Block Copy DMA Split TR Rx channel";

resourceSharing3.sharedFromHostName = "C7X_0_0";
resourceSharing3.sharedToHostName   = "C7X_1_0";
resourceSharing3.$name              = "C7X_0_0_C7X_1_0_PKTDMA_TX";
resourceSharing3.resourceName       = "DMASS Packet DMA Free Tx channel";

resourceSharing4.sharedFromHostName = "C7X_0_0";
resourceSharing4.sharedToHostName   = "C7X_1_0";
resourceSharing4.$name              = "C7X_0_0_C7X_1_0_PKTDMA_RX";
resourceSharing4.resourceName       = "DMASS Packet DMA Free Rx channel";

resourceSharing5.sharedFromHostName = "C7X_0_0";
resourceSharing5.sharedToHostName   = "C7X_1_0";
resourceSharing5.$name              = "C7X_0_0_C7X_1_0_BCDMA_TX_RINGS";
resourceSharing5.resourceName       = "Block Copy DMA Rings for Split TR Rx channel";

resourceSharing6.sharedFromHostName = "C7X_0_0";
resourceSharing6.sharedToHostName   = "C7X_1_0";
resourceSharing6.$name              = "C7X_0_0_C7X_1_0_BCDMA_RX_RINGS";
resourceSharing6.resourceName       = "Block Copy DMA Rings for Split TR Tx channel";

resourceSharing7.sharedFromHostName = "C7X_0_0";
resourceSharing7.sharedToHostName   = "C7X_1_0";
resourceSharing7.$name              = "C7X_0_0_C7X_1_0_BCDMA";
resourceSharing7.resourceName       = "Block Copy DMA Block copy channel";

resourceSharing8.sharedFromHostName = "C7X_0_0";
resourceSharing8.sharedToHostName   = "C7X_1_0";
resourceSharing8.$name              = "C7X_0_0_C7X_1_0_BCDMA_RINGS";
resourceSharing8.resourceName       = "Block Copy DMA Rings for Block copy channel";

resourceSharing9.resourceName       = "MCU GPIO Interrupt Router";
resourceSharing9.sharedFromHostName = "C7X_0_0";
resourceSharing9.sharedToHostName   = "C7X_1_0";
resourceSharing9.$name              = "C7X_0_0_C7X_1_0_MCU_GPIO_MUX";

resourceSharing10.sharedFromHostName = "C7X_0_0";
resourceSharing10.sharedToHostName   = "C7X_1_0";
resourceSharing10.$name              = "C7X_0_0_C7X_1_0_MAIN_GPIO_MUX";
resourceSharing10.resourceName       = "MAIN GPIO Interrupt Router";

resourceSharing11.sharedFromHostName = "C7X_0_0";
resourceSharing11.sharedToHostName   = "C7X_1_0";
resourceSharing11.$name              = "C7X_0_0_C7X_1_0_PKTDMA_RX_RINGS";
resourceSharing11.resourceName       = "DMASS Packet DMA Free rings for Rx channel";

resourceSharing12.sharedFromHostName = "C7X_0_0";
resourceSharing12.sharedToHostName   = "C7X_1_0";
resourceSharing12.$name              = "C7X_0_0_C7X_1_0_PKTDMA_TX_RINGS";
resourceSharing12.resourceName       = "DMASS Packet DMA Free rings for Tx channel";

resourceSharing13.sharedFromHostName = "C7X_0_0";
resourceSharing13.sharedToHostName   = "C7X_1_0";
resourceSharing13.$name              = "C7X_0_0_C7X_1_0_PKTDMA_FLOW_RX";
resourceSharing13.resourceName       = "DMASS Packet DMA Free flows for Rx channel";
