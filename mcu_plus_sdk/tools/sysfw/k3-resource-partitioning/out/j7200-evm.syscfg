/**
 * @cliArgs --device "J7200_DRA821_SR1.0_alpha" --package "ALM" --part "Default" --product "K3-Respart-Tool@1.0"
 * @versions {"data":"20201003","timestamp":"2021010520","tool":"1.7.0+1746","templates":null}
 */

/**
 * Import the modules used in this configuration.
 */
const A72_2       = scripting.addModule("/modules/j7200/A72_2");
const A72_3       = scripting.addModule("/modules/j7200/A72_3");
const MAIN_0_R5_0 = scripting.addModule("/modules/j7200/MAIN_0_R5_0");
const MAIN_0_R5_2 = scripting.addModule("/modules/j7200/MAIN_0_R5_2");
const MCU_0_R5_0  = scripting.addModule("/modules/j7200/MCU_0_R5_0");
const MCU_0_R5_2  = scripting.addModule("/modules/j7200/MCU_0_R5_2");

/**
 * Write custom configuration values to the imported modules.
 */
A72_2.Main_NAVSS_Interrupt_router_count                             = 128;
A72_2.Main_NAVSS_Non_secure_proxies_count                           = 4;
A72_2.Main_NAVSS_Ring_accelerator_ring_monitors_count               = 3;
A72_2.Main_NAVSS_UDMA_Rx_free_flows_count                           = 8;
A72_2.Main_NAVSS_UDMA_Interrupt_aggregator_Global_events_count      = 1024;
A72_2.MCU_NAVSS_Non_secure_proxies_count                            = 8;
A72_2.MCU_NAVSS_Ring_accelerator_ring_monitors_count                = 3;
A72_2.MCU_NAVSS_UDMA_Rx_free_flows_count                            = 8;
A72_2.MCU_NAVSS_Interrupt_aggregator_Virtual_interrupts_count       = 32;
A72_2.MCU_NAVSS_Interrupt_aggregator_Global_events_count            = 128;
A72_2.allocOrder                                                    = 1;
A72_2.Main_NAVSS_Ring_accelerator_virt_id_range_start               = 2;
A72_2.Main_NAVSS_Ring_accelerator_virt_id_range_count               = 1;
A72_2.Main_GPIO_Interrupt_router_count                              = 16;
A72_2.Wakeup_GPIO_Interrupt_router_count                            = 8;
A72_2.Main_NAVSS_UDMA_Interrupt_aggregator_Virtual_interrupts_count = 86;
A72_2.Main_NAVSS_UDMA_Normal_capacity_Rx_channels_count             = 20;
A72_2.Main_NAVSS_UDMA_Normal_capacity_Tx_channels_count             = 20;
A72_2.Main_NAVSS_UDMA_Normal_capacity_Tx_channels_blockCount        = 4;
A72_2.MCU_NAVSS_UDMA_Normal_capacity_Tx_channels_blockCount         = 3;
A72_2.MCU_NAVSS_UDMA_Normal_capacity_Rx_channels_count              = 9;
A72_2.MCU_NAVSS_UDMA_Normal_capacity_Tx_channels_count              = 9;
A72_2.Main_NAVSS_Ring_accelerator_Free_rings_count                  = 200;
A72_2.MCU_NAVSS_Ring_accelerator_Free_rings_count                   = 32;
A72_2.Main_NAVSS_UDMA_High_capacity_Rx_channels_count               = 1;
A72_2.Main_NAVSS_UDMA_High_capacity_Tx_channels_count               = 1;
A72_2.MCU_NAVSS_UDMA_High_capacity_Tx_channels_count                = 1;
A72_2.MCU_NAVSS_UDMA_High_capacity_Rx_channels_count                = 1;

A72_3.Main_NAVSS_Interrupt_router_count                             = 54;
A72_3.Main_NAVSS_Non_secure_proxies_count                           = 4;
A72_3.Main_NAVSS_Ring_accelerator_Free_rings_count                  = 40;
A72_3.Main_NAVSS_Ring_accelerator_ring_monitors_count               = 2;
A72_3.Main_NAVSS_UDMA_Rx_free_flows_count                           = 8;
A72_3.Main_NAVSS_UDMA_Interrupt_aggregator_Virtual_interrupts_count = 32;
A72_3.Main_NAVSS_UDMA_Interrupt_aggregator_Global_events_count      = 512;
A72_3.MCU_NAVSS_Non_secure_proxies_count                            = 4;
A72_3.MCU_NAVSS_Ring_accelerator_ring_monitors_count                = 2;
A72_3.MCU_NAVSS_UDMA_Rx_free_flows_count                            = 4;
A72_3.MCU_NAVSS_Interrupt_aggregator_Virtual_interrupts_count       = 16;
A72_3.MCU_NAVSS_Interrupt_aggregator_Global_events_count            = 128;
A72_3.allocOrder                                                    = 2;
A72_3.Main_NAVSS_Ring_accelerator_virt_id_range_start               = 3;
A72_3.Main_NAVSS_Ring_accelerator_virt_id_range_count               = 1;
A72_3.Main_GPIO_Interrupt_router_count                              = 16;
A72_3.Wakeup_GPIO_Interrupt_router_count                            = 8;
A72_3.Main_NAVSS_UDMA_Normal_capacity_Rx_channels_count             = 4;
A72_3.Main_NAVSS_UDMA_Normal_capacity_Tx_channels_count             = 4;
A72_3.Main_NAVSS_UDMA_Normal_capacity_Tx_channels_blockCount        = 2;
A72_3.MCU_NAVSS_UDMA_Normal_capacity_Rx_channels_count              = 4;
A72_3.MCU_NAVSS_UDMA_Normal_capacity_Tx_channels_count              = 4;
A72_3.MCU_NAVSS_UDMA_Normal_capacity_Tx_channels_blockCount         = 2;
A72_3.MCU_NAVSS_Ring_accelerator_Free_rings_count                   = 16;

MAIN_0_R5_0.Main_NAVSS_Interrupt_router_count                             = 28;
MAIN_0_R5_0.Main_NAVSS_UDMA_Interrupt_aggregator_Global_events_count      = 256;
MAIN_0_R5_0.MCU_NAVSS_Ring_accelerator_Free_rings_count                   = 16;
MAIN_0_R5_0.MCU_NAVSS_UDMA_Rx_free_flows_count                            = 8;
MAIN_0_R5_0.MCU_NAVSS_Interrupt_aggregator_Virtual_interrupts_count       = 16;
MAIN_0_R5_0.MCU_NAVSS_Interrupt_aggregator_Global_events_count            = 128;
MAIN_0_R5_0.allocOrder                                                    = 5;
MAIN_0_R5_0.Main_GPIO_Interrupt_router_count                              = 8;
MAIN_0_R5_0.Main_NAVSS_UDMA_Normal_capacity_Tx_channels_blockCount        = 2;
MAIN_0_R5_0.Main_NAVSS_UDMA_Normal_capacity_Rx_channels_count             = 8;
MAIN_0_R5_0.Main_NAVSS_UDMA_Normal_capacity_Tx_channels_count             = 8;
MAIN_0_R5_0.Main_NAVSS_Ring_accelerator_Free_rings_count                  = 256;
MAIN_0_R5_0.Main_NAVSS_Ring_accelerator_ring_monitors_count               = 16;
MAIN_0_R5_0.Main_NAVSS_Non_secure_proxies_count                           = 16;
MAIN_0_R5_0.MCU_NAVSS_UDMA_Normal_capacity_Tx_channels_blockCount         = 2;
MAIN_0_R5_0.MCU_NAVSS_UDMA_Normal_capacity_Rx_channels_count              = 4;
MAIN_0_R5_0.MCU_NAVSS_UDMA_Normal_capacity_Tx_channels_count              = 4;
MAIN_0_R5_0.MCU_NAVSS_Ring_accelerator_ring_monitors_count                = 5;
MAIN_0_R5_0.MCU_NAVSS_Non_secure_proxies_count                            = 8;
MAIN_0_R5_0.Main_NAVSS_UDMA_Interrupt_aggregator_Virtual_interrupts_count = 32;
MAIN_0_R5_0.Main_NAVSS_UDMA_High_capacity_Rx_channels_count               = 1;
MAIN_0_R5_0.Main_NAVSS_UDMA_High_capacity_Tx_channels_count               = 1;

MAIN_0_R5_2.Main_NAVSS_Interrupt_router_count                             = 28;
MAIN_0_R5_2.Main_NAVSS_UDMA_Rx_free_flows_count                           = 8;
MAIN_0_R5_2.Main_NAVSS_UDMA_Ultra_high_capacity_Rx_channels_count         = 2;
MAIN_0_R5_2.Main_NAVSS_UDMA_Ultra_high_capacity_Tx_channels_count         = 2;
MAIN_0_R5_2.Main_NAVSS_UDMA_Interrupt_aggregator_Virtual_interrupts_count = 24;
MAIN_0_R5_2.Main_NAVSS_UDMA_Interrupt_aggregator_Global_events_count      = 512;
MAIN_0_R5_2.MCU_NAVSS_UDMA_Rx_free_flows_count                            = 4;
MAIN_0_R5_2.MCU_NAVSS_Interrupt_aggregator_Virtual_interrupts_count       = 16;
MAIN_0_R5_2.MCU_NAVSS_Interrupt_aggregator_Global_events_count            = 128;
MAIN_0_R5_2.allocOrder                                                    = 6;
MAIN_0_R5_2.Main_GPIO_Interrupt_router_count                              = 8;
MAIN_0_R5_2.Main_NAVSS_UDMA_Normal_capacity_Tx_channels_blockCount        = 2;
MAIN_0_R5_2.Main_NAVSS_UDMA_Normal_capacity_Rx_channels_count             = 8;
MAIN_0_R5_2.Main_NAVSS_UDMA_Normal_capacity_Tx_channels_count             = 8;
MAIN_0_R5_2.Main_NAVSS_Ring_accelerator_Free_rings_count                  = 256;
MAIN_0_R5_2.Main_NAVSS_Ring_accelerator_ring_monitors_count               = 8;
MAIN_0_R5_2.Main_NAVSS_Non_secure_proxies_count                           = 16;
MAIN_0_R5_2.MCU_NAVSS_UDMA_Normal_capacity_Tx_channels_blockCount         = 2;
MAIN_0_R5_2.MCU_NAVSS_UDMA_Normal_capacity_Rx_channels_count              = 4;
MAIN_0_R5_2.MCU_NAVSS_UDMA_Normal_capacity_Tx_channels_count              = 4;
MAIN_0_R5_2.MCU_NAVSS_Ring_accelerator_Free_rings_count                   = 16;
MAIN_0_R5_2.MCU_NAVSS_Ring_accelerator_ring_monitors_count                = 5;
MAIN_0_R5_2.MCU_NAVSS_Non_secure_proxies_count                            = 8;

MCU_0_R5_0.Main_2_MCU_Level_Interrupt_router_count                       = 32;
MCU_0_R5_0.Main_2_MCU_Pulse_Interrupt_router_count                       = 24;
MCU_0_R5_0.Main_NAVSS_Non_secure_proxies_count                           = 4;
MCU_0_R5_0.Main_NAVSS_Ring_accelerator_ring_monitors_count               = 1;
MCU_0_R5_0.MCU_NAVSS_Ring_accelerator_Free_rings_count                   = 32;
MCU_0_R5_0.MCU_NAVSS_UDMA_Rx_free_flows_count                            = 8;
MCU_0_R5_0.MCU_NAVSS_Interrupt_aggregator_Virtual_interrupts_count       = 64;
MCU_0_R5_0.MCU_NAVSS_Interrupt_aggregator_Global_events_count            = 256;
MCU_0_R5_0.allocOrder                                                    = 3;
MCU_0_R5_0.Main_GPIO_Interrupt_router_count                              = 8;
MCU_0_R5_0.Wakeup_GPIO_Interrupt_router_count                            = 8;
MCU_0_R5_0.Main_NAVSS_Interrupt_router_count                             = 4;
MCU_0_R5_0.Main_NAVSS_UDMA_Normal_capacity_Tx_channels_blockCount        = 2;
MCU_0_R5_0.MCU_NAVSS_UDMA_Normal_capacity_Tx_channels_blockCount         = 2;
MCU_0_R5_0.Main_NAVSS_Ring_accelerator_Free_rings_count                  = 32;
MCU_0_R5_0.MCU_NAVSS_UDMA_Normal_capacity_Rx_channels_count              = 4;
MCU_0_R5_0.MCU_NAVSS_UDMA_Normal_capacity_Tx_channels_count              = 4;
MCU_0_R5_0.MCU_NAVSS_Ring_accelerator_ring_monitors_count                = 6;
MCU_0_R5_0.MCU_NAVSS_Non_secure_proxies_count                            = 16;
MCU_0_R5_0.Main_NAVSS_UDMA_Interrupt_aggregator_Virtual_interrupts_count = 16;
MCU_0_R5_0.Main_NAVSS_UDMA_Interrupt_aggregator_Global_events_count      = 128;
MCU_0_R5_0.MCU_NAVSS_UDMA_High_capacity_Rx_channels_count                = 1;
MCU_0_R5_0.MCU_NAVSS_UDMA_High_capacity_Tx_channels_count                = 1;
MCU_0_R5_0.MCU_NAVSS_Interrupt_router_count                              = 20;

MCU_0_R5_2.Main_2_MCU_Level_Interrupt_router_count                       = 32;
MCU_0_R5_2.Main_2_MCU_Pulse_Interrupt_router_count                       = 24;
MCU_0_R5_2.Main_NAVSS_Non_secure_proxies_count                           = 4;
MCU_0_R5_2.Main_NAVSS_Ring_accelerator_ring_monitors_count               = 1;
MCU_0_R5_2.MCU_NAVSS_Interrupt_router_count                              = 28;
MCU_0_R5_2.MCU_NAVSS_UDMA_Rx_free_flows_count                            = 4;
MCU_0_R5_2.allocOrder                                                    = 4;
MCU_0_R5_2.Main_GPIO_Interrupt_router_count                              = 8;
MCU_0_R5_2.Wakeup_GPIO_Interrupt_router_count                            = 8;
MCU_0_R5_2.Main_NAVSS_Interrupt_router_count                             = 4;
MCU_0_R5_2.Main_NAVSS_UDMA_Normal_capacity_Tx_channels_blockCount        = 2;
MCU_0_R5_2.Main_NAVSS_Ring_accelerator_Free_rings_count                  = 32;
MCU_0_R5_2.MCU_NAVSS_UDMA_Normal_capacity_Rx_channels_count              = 4;
MCU_0_R5_2.MCU_NAVSS_UDMA_Normal_capacity_Tx_channels_count              = 4;
MCU_0_R5_2.MCU_NAVSS_UDMA_Normal_capacity_Tx_channels_blockCount         = 2;
MCU_0_R5_2.MCU_NAVSS_Ring_accelerator_Free_rings_count                   = 32;
MCU_0_R5_2.MCU_NAVSS_Ring_accelerator_ring_monitors_count                = 6;
MCU_0_R5_2.MCU_NAVSS_Non_secure_proxies_count                            = 16;
MCU_0_R5_2.Main_NAVSS_UDMA_Interrupt_aggregator_Virtual_interrupts_count = 16;
MCU_0_R5_2.Main_NAVSS_UDMA_Interrupt_aggregator_Global_events_count      = 128;
MCU_0_R5_2.MCU_NAVSS_Interrupt_aggregator_Virtual_interrupts_count       = 32;
MCU_0_R5_2.MCU_NAVSS_Interrupt_aggregator_Global_events_count            = 128;
