/**
 * @cliArgs --device "J721S2_TDA4VE_TDA4AL_TDA4VL_AM68x" --package "ALZ" --part "Default" --product "K3-Respart-Tool@1.0"
 * @versions {"tool":"1.18.0+3266"}
 */

/**
 * Import the modules used in this configuration.
 */
const A72_2       = scripting.addModule("/modules/j721s2/A72_2");
const A72_3       = scripting.addModule("/modules/j721s2/A72_3");
const C7X_0_1     = scripting.addModule("/modules/j721s2/C7X_0_1");
const C7X_1_1     = scripting.addModule("/modules/j721s2/C7X_1_1");
const MAIN_0_R5_0 = scripting.addModule("/modules/j721s2/MAIN_0_R5_0");
const MAIN_0_R5_2 = scripting.addModule("/modules/j721s2/MAIN_0_R5_2");
const MAIN_1_R5_0 = scripting.addModule("/modules/j721s2/MAIN_1_R5_0");
const MAIN_1_R5_2 = scripting.addModule("/modules/j721s2/MAIN_1_R5_2");
const MCU_0_R5_0  = scripting.addModule("/modules/j721s2/MCU_0_R5_0");
const MCU_0_R5_2  = scripting.addModule("/modules/j721s2/MCU_0_R5_2");

/**
 * Write custom configuration values to the imported modules.
 */
A72_2.allocOrder                                                 = 1;
A72_2.Main_NAVSS_UDMA_Rx_free_flows_count                        = 16;
A72_2.Main_NAVSS_Ring_accelerator_ring_monitors_count            = 3;
A72_2.Main_NAVSS_Non_secure_proxies_count                        = 4;
A72_2.Main_NAVSS_Ring_accelerator_virt_id_range_start            = 2;
A72_2.Main_NAVSS_Ring_accelerator_virt_id_range_count            = 5;
A72_2.MCU_NAVSS_UDMA_Normal_capacity_Rx_channels_count           = 9;
A72_2.MCU_NAVSS_UDMA_Normal_capacity_Tx_channels_count           = 9;
A72_2.MCU_NAVSS_UDMA_Normal_capacity_Tx_channels_blockCount      = 4;
A72_2.MCU_NAVSS_UDMA_Rx_free_flows_count                         = 8;
A72_2.MCU_NAVSS_Ring_accelerator_Free_rings_count                = 20;
A72_2.MCU_NAVSS_Ring_accelerator_ring_monitors_count             = 3;
A72_2.MCU_NAVSS_Non_secure_proxies_count                         = 4;
A72_2.Main_NAVSS_Interrupt_router_count                          = 100;
A72_2.Main_GPIO_Interrupt_router_count                           = 12;
A72_2.Wakeup_GPIO_Interrupt_router_count                         = 6;
A72_2.Main_NAVSS_Interrupt_aggregator_Virtual_interrupts_count   = 86;
A72_2.Main_NAVSS_UDMA_Interrupt_aggregator_Global_events_count   = 1024;
A72_2.MCU_NAVSS_Interrupt_aggregator_Virtual_interrupts_count    = 32;
A72_2.MCU_NAVSS_Interrupt_aggregator_Global_events_count         = 128;
A72_2.Main_NAVSS_UDMA_Normal_capacity_Tx_channels_blockCount     = 6;
A72_2.Main_NAVSS_Block_Copy_DMA_Split_TR_Rx_channels_count       = 16;
A72_2.Main_NAVSS_Block_Copy_DMA_Split_TR_Tx_channels_count       = 8;
A72_2.Main_NAVSS_UDMA_High_capacity_Tx_channels_blockCount       = 1;
A72_2.Main_NAVSS_UDMA_Ultra_High_capacity_Tx_channels_blockCount = 1;
A72_2.Main_NAVSS_Ring_accelerator_Free_rings_count               = 128;
A72_2.Main_NAVSS_UDMA_Normal_capacity_Rx_channels_count          = 22;
A72_2.Main_NAVSS_UDMA_Normal_capacity_Tx_channels_count          = 22;

A72_3.allocOrder                                               = 2;
A72_3.Main_NAVSS_UDMA_Rx_free_flows_count                      = 16;
A72_3.Main_NAVSS_Ring_accelerator_ring_monitors_count          = 2;
A72_3.Main_NAVSS_Non_secure_proxies_count                      = 4;
A72_3.Main_NAVSS_Ring_accelerator_virt_id_range_start          = 7;
A72_3.Main_NAVSS_Ring_accelerator_virt_id_range_count          = 1;
A72_3.MCU_NAVSS_UDMA_Normal_capacity_Rx_channels_count         = 6;
A72_3.MCU_NAVSS_UDMA_Normal_capacity_Tx_channels_count         = 6;
A72_3.MCU_NAVSS_UDMA_Rx_free_flows_count                       = 4;
A72_3.MCU_NAVSS_Ring_accelerator_Free_rings_count              = 8;
A72_3.MCU_NAVSS_Ring_accelerator_ring_monitors_count           = 2;
A72_3.MCU_NAVSS_Non_secure_proxies_count                       = 4;
A72_3.Main_NAVSS_Interrupt_router_count                        = 32;
A72_3.Main_GPIO_Interrupt_router_count                         = 12;
A72_3.Wakeup_GPIO_Interrupt_router_count                       = 6;
A72_3.Main_NAVSS_Interrupt_aggregator_Virtual_interrupts_count = 32;
A72_3.Main_NAVSS_UDMA_Interrupt_aggregator_Global_events_count = 512;
A72_3.MCU_NAVSS_Interrupt_aggregator_Virtual_interrupts_count  = 16;
A72_3.MCU_NAVSS_Interrupt_aggregator_Global_events_count       = 128;
A72_3.Main_NAVSS_Ring_accelerator_Free_rings_count             = 10;
A72_3.Main_NAVSS_UDMA_Normal_capacity_Rx_channels_count        = 6;
A72_3.Main_NAVSS_UDMA_Normal_capacity_Tx_channels_count        = 6;

C7X_0_1.allocOrder                                               = 3;
C7X_0_1.Main_NAVSS_UDMA_Normal_capacity_Rx_channels_count        = 4;
C7X_0_1.Main_NAVSS_UDMA_Normal_capacity_Tx_channels_count        = 4;
C7X_0_1.Main_NAVSS_UDMA_Normal_capacity_Tx_channels_blockCount   = 2;
C7X_0_1.Main_NAVSS_UDMA_Extended_Tx_channels_count               = 16;
C7X_0_1.Main_NAVSS_Ring_accelerator_Free_rings_count             = 32;
C7X_0_1.Main_NAVSS_Ring_accelerator_ring_monitors_count          = 3;
C7X_0_1.Main_NAVSS_Non_secure_proxies_count                      = 4;
C7X_0_1.MCU_NAVSS_UDMA_Normal_capacity_Rx_channels_count         = 1;
C7X_0_1.MCU_NAVSS_UDMA_Normal_capacity_Tx_channels_count         = 1;
C7X_0_1.MCU_NAVSS_UDMA_Normal_capacity_Tx_channels_blockCount    = 1;
C7X_0_1.MCU_NAVSS_Ring_accelerator_Free_rings_count              = 8;
C7X_0_1.MCU_NAVSS_Ring_accelerator_ring_monitors_count           = 3;
C7X_0_1.MCU_NAVSS_Non_secure_proxies_count                       = 4;
C7X_0_1.Main_NAVSS_Interrupt_aggregator_Virtual_interrupts_count = 12;
C7X_0_1.Main_NAVSS_UDMA_Interrupt_aggregator_Global_events_count = 256;
C7X_0_1.MCU_NAVSS_Interrupt_aggregator_Virtual_interrupts_count  = 8;
C7X_0_1.MCU_NAVSS_Interrupt_aggregator_Global_events_count       = 64;
C7X_0_1.Main_NAVSS_Interrupt_router_count                        = 21;

C7X_1_1.allocOrder                                               = 4;
C7X_1_1.Main_NAVSS_UDMA_Normal_capacity_Tx_channels_blockCount   = 2;
C7X_1_1.Main_NAVSS_UDMA_Normal_capacity_Tx_channels_count        = 4;
C7X_1_1.Main_NAVSS_UDMA_Normal_capacity_Rx_channels_count        = 4;
C7X_1_1.Main_NAVSS_UDMA_Extended_Tx_channels_count               = 12;
C7X_1_1.MCU_NAVSS_UDMA_Normal_capacity_Rx_channels_count         = 1;
C7X_1_1.MCU_NAVSS_UDMA_Normal_capacity_Tx_channels_count         = 1;
C7X_1_1.MCU_NAVSS_UDMA_Normal_capacity_Tx_channels_blockCount    = 1;
C7X_1_1.MCU_NAVSS_Ring_accelerator_Free_rings_count              = 8;
C7X_1_1.MCU_NAVSS_Ring_accelerator_ring_monitors_count           = 3;
C7X_1_1.MCU_NAVSS_Non_secure_proxies_count                       = 4;
C7X_1_1.Main_NAVSS_Interrupt_aggregator_Virtual_interrupts_count = 12;
C7X_1_1.Main_NAVSS_UDMA_Interrupt_aggregator_Global_events_count = 256;
C7X_1_1.MCU_NAVSS_Interrupt_aggregator_Virtual_interrupts_count  = 8;
C7X_1_1.MCU_NAVSS_Interrupt_aggregator_Global_events_count       = 64;
C7X_1_1.Main_NAVSS_Interrupt_router_count                        = 21;
C7X_1_1.Main_NAVSS_Ring_accelerator_Free_rings_count             = 32;
C7X_1_1.Main_NAVSS_Ring_accelerator_ring_monitors_count          = 3;
C7X_1_1.Main_NAVSS_Non_secure_proxies_count                      = 4;

MAIN_0_R5_0.allocOrder                                                 = 5;
MAIN_0_R5_0.Main_NAVSS_UDMA_Extended_Tx_channels_count                 = 2;
MAIN_0_R5_0.Main_NAVSS_Ring_accelerator_Free_rings_count               = 182;
MAIN_0_R5_0.Main_NAVSS_Ring_accelerator_ring_monitors_count            = 6;
MAIN_0_R5_0.Main_NAVSS_Non_secure_proxies_count                        = 12;
MAIN_0_R5_0.MCU_NAVSS_UDMA_Normal_capacity_Rx_channels_count           = 2;
MAIN_0_R5_0.MCU_NAVSS_UDMA_Normal_capacity_Tx_channels_count           = 2;
MAIN_0_R5_0.MCU_NAVSS_UDMA_Normal_capacity_Tx_channels_blockCount      = 1;
MAIN_0_R5_0.MCU_NAVSS_UDMA_Rx_free_flows_count                         = 8;
MAIN_0_R5_0.MCU_NAVSS_Ring_accelerator_Free_rings_count                = 16;
MAIN_0_R5_0.MCU_NAVSS_Ring_accelerator_ring_monitors_count             = 3;
MAIN_0_R5_0.MCU_NAVSS_Non_secure_proxies_count                         = 16;
MAIN_0_R5_0.Main_NAVSS_Interrupt_router_count                          = 28;
MAIN_0_R5_0.Main_GPIO_Interrupt_router_count                           = 4;
MAIN_0_R5_0.Wakeup_GPIO_Interrupt_router_count                         = 2;
MAIN_0_R5_0.Main_NAVSS_Interrupt_aggregator_Virtual_interrupts_count   = 28;
MAIN_0_R5_0.Main_NAVSS_UDMA_Interrupt_aggregator_Global_events_count   = 512;
MAIN_0_R5_0.MCU_NAVSS_Interrupt_aggregator_Virtual_interrupts_count    = 24;
MAIN_0_R5_0.MCU_NAVSS_Interrupt_aggregator_Global_events_count         = 128;
MAIN_0_R5_0.Main_NAVSS_UDMA_Normal_capacity_Rx_channels_count          = 12;
MAIN_0_R5_0.Main_NAVSS_UDMA_Normal_capacity_Tx_channels_count          = 12;
MAIN_0_R5_0.Main_NAVSS_UDMA_Normal_capacity_Tx_channels_blockCount     = 6;
MAIN_0_R5_0.Main_NAVSS_Block_Copy_DMA_Split_TR_Rx_channels_count       = 16;
MAIN_0_R5_0.Main_NAVSS_Block_Copy_DMA_Split_TR_Tx_channels_count       = 8;
MAIN_0_R5_0.Main_NAVSS_UDMA_Extended_Tx_channels_hwa_start             = 117;
MAIN_0_R5_0.Main_NAVSS_UDMA_Ultra_High_capacity_Tx_channels_blockCount = 1;
MAIN_0_R5_0.Main_NAVSS_UDMA_High_capacity_Tx_channels_blockCount       = 1;
MAIN_0_R5_0.Main_NAVSS_UDMA_Extended_Tx_channels_hwa_count             = 96;

MAIN_0_R5_2.allocOrder                                               = 6;
MAIN_0_R5_2.Main_NAVSS_UDMA_Extended_Tx_channels_count               = 2;
MAIN_0_R5_2.Main_NAVSS_UDMA_Extended_Tx_channels_hwa_start           = 309;
MAIN_0_R5_2.Main_NAVSS_UDMA_Extended_Tx_channels_hwa_count           = 32;
MAIN_0_R5_2.Main_NAVSS_Ring_accelerator_Free_rings_count             = 40;
MAIN_0_R5_2.Main_NAVSS_Ring_accelerator_ring_monitors_count          = 3;
MAIN_0_R5_2.Main_NAVSS_Non_secure_proxies_count                      = 4;
MAIN_0_R5_2.MCU_NAVSS_UDMA_Normal_capacity_Rx_channels_count         = 1;
MAIN_0_R5_2.MCU_NAVSS_UDMA_Normal_capacity_Tx_channels_count         = 1;
MAIN_0_R5_2.MCU_NAVSS_UDMA_Normal_capacity_Tx_channels_blockCount    = 1;
MAIN_0_R5_2.MCU_NAVSS_UDMA_Rx_free_flows_count                       = 4;
MAIN_0_R5_2.MCU_NAVSS_Ring_accelerator_Free_rings_count              = 8;
MAIN_0_R5_2.MCU_NAVSS_Ring_accelerator_ring_monitors_count           = 3;
MAIN_0_R5_2.MCU_NAVSS_Non_secure_proxies_count                       = 4;
MAIN_0_R5_2.Main_NAVSS_Interrupt_router_count                        = 28;
MAIN_0_R5_2.Main_GPIO_Interrupt_router_count                         = 4;
MAIN_0_R5_2.Wakeup_GPIO_Interrupt_router_count                       = 2;
MAIN_0_R5_2.Main_NAVSS_Interrupt_aggregator_Virtual_interrupts_count = 8;
MAIN_0_R5_2.Main_NAVSS_UDMA_Interrupt_aggregator_Global_events_count = 256;
MAIN_0_R5_2.MCU_NAVSS_Interrupt_aggregator_Virtual_interrupts_count  = 8;
MAIN_0_R5_2.MCU_NAVSS_Interrupt_aggregator_Global_events_count       = 128;
MAIN_0_R5_2.Main_NAVSS_UDMA_Normal_capacity_Tx_channels_blockCount   = 1;
MAIN_0_R5_2.Main_NAVSS_UDMA_Normal_capacity_Rx_channels_count        = 1;
MAIN_0_R5_2.Main_NAVSS_UDMA_Normal_capacity_Tx_channels_count        = 4;

MAIN_1_R5_0.allocOrder                                               = 7;
MAIN_1_R5_0.Main_NAVSS_Ring_accelerator_Free_rings_count             = 10;
MAIN_1_R5_0.Main_NAVSS_Ring_accelerator_ring_monitors_count          = 3;
MAIN_1_R5_0.Main_NAVSS_Non_secure_proxies_count                      = 4;
MAIN_1_R5_0.MCU_NAVSS_UDMA_Normal_capacity_Rx_channels_count         = 1;
MAIN_1_R5_0.MCU_NAVSS_UDMA_Normal_capacity_Tx_channels_count         = 1;
MAIN_1_R5_0.MCU_NAVSS_UDMA_Normal_capacity_Tx_channels_blockCount    = 1;
MAIN_1_R5_0.MCU_NAVSS_UDMA_Rx_free_flows_count                       = 4;
MAIN_1_R5_0.MCU_NAVSS_Ring_accelerator_Free_rings_count              = 8;
MAIN_1_R5_0.MCU_NAVSS_Ring_accelerator_ring_monitors_count           = 3;
MAIN_1_R5_0.MCU_NAVSS_Non_secure_proxies_count                       = 4;
MAIN_1_R5_0.Main_NAVSS_Interrupt_router_count                        = 28;
MAIN_1_R5_0.Main_GPIO_Interrupt_router_count                         = 4;
MAIN_1_R5_0.Main_NAVSS_Interrupt_aggregator_Virtual_interrupts_count = 12;
MAIN_1_R5_0.Main_NAVSS_UDMA_Interrupt_aggregator_Global_events_count = 256;
MAIN_1_R5_0.MCU_NAVSS_Interrupt_aggregator_Virtual_interrupts_count  = 16;
MAIN_1_R5_0.MCU_NAVSS_Interrupt_aggregator_Global_events_count       = 128;
MAIN_1_R5_0.Main_NAVSS_UDMA_Normal_capacity_Tx_channels_blockCount   = 1;
MAIN_1_R5_0.Main_NAVSS_UDMA_Normal_capacity_Tx_channels_count        = 2;
MAIN_1_R5_0.Main_NAVSS_UDMA_Normal_capacity_Rx_channels_count        = 2;

MAIN_1_R5_2.allocOrder                                               = 8;
MAIN_1_R5_2.Main_NAVSS_Ring_accelerator_Free_rings_count             = 10;
MAIN_1_R5_2.Main_NAVSS_Ring_accelerator_ring_monitors_count          = 3;
MAIN_1_R5_2.Main_NAVSS_Non_secure_proxies_count                      = 4;
MAIN_1_R5_2.MCU_NAVSS_UDMA_Normal_capacity_Rx_channels_count         = 1;
MAIN_1_R5_2.MCU_NAVSS_UDMA_Normal_capacity_Tx_channels_count         = 1;
MAIN_1_R5_2.MCU_NAVSS_UDMA_Normal_capacity_Tx_channels_blockCount    = 1;
MAIN_1_R5_2.MCU_NAVSS_UDMA_Rx_free_flows_count                       = 4;
MAIN_1_R5_2.MCU_NAVSS_Ring_accelerator_Free_rings_count              = 8;
MAIN_1_R5_2.MCU_NAVSS_Ring_accelerator_ring_monitors_count           = 3;
MAIN_1_R5_2.MCU_NAVSS_Non_secure_proxies_count                       = 4;
MAIN_1_R5_2.Main_NAVSS_Interrupt_router_count                        = 28;
MAIN_1_R5_2.Main_GPIO_Interrupt_router_count                         = 4;
MAIN_1_R5_2.Main_NAVSS_Interrupt_aggregator_Virtual_interrupts_count = 12;
MAIN_1_R5_2.Main_NAVSS_UDMA_Interrupt_aggregator_Global_events_count = 256;
MAIN_1_R5_2.MCU_NAVSS_Interrupt_aggregator_Virtual_interrupts_count  = 16;
MAIN_1_R5_2.MCU_NAVSS_Interrupt_aggregator_Global_events_count       = 128;
MAIN_1_R5_2.Main_NAVSS_UDMA_Normal_capacity_Rx_channels_count        = 2;
MAIN_1_R5_2.Main_NAVSS_UDMA_Normal_capacity_Tx_channels_count        = 2;
MAIN_1_R5_2.Main_NAVSS_UDMA_Normal_capacity_Tx_channels_blockCount   = 1;

MCU_0_R5_0.allocOrder                                               = 9;
MCU_0_R5_0.Main_NAVSS_Ring_accelerator_Free_rings_count             = 6;
MCU_0_R5_0.Main_NAVSS_Ring_accelerator_ring_monitors_count          = 1;
MCU_0_R5_0.Main_NAVSS_Non_secure_proxies_count                      = 4;
MCU_0_R5_0.MCU_NAVSS_UDMA_High_capacity_Rx_channels_count           = 2;
MCU_0_R5_0.MCU_NAVSS_UDMA_High_capacity_Tx_channels_count           = 2;
MCU_0_R5_0.MCU_NAVSS_UDMA_Normal_capacity_Rx_channels_count         = 3;
MCU_0_R5_0.MCU_NAVSS_UDMA_Normal_capacity_Tx_channels_count         = 3;
MCU_0_R5_0.MCU_NAVSS_UDMA_Normal_capacity_Tx_channels_blockCount    = 2;
MCU_0_R5_0.MCU_NAVSS_UDMA_Rx_free_flows_count                       = 8;
MCU_0_R5_0.MCU_NAVSS_Ring_accelerator_Free_rings_count              = 32;
MCU_0_R5_0.MCU_NAVSS_Ring_accelerator_ring_monitors_count           = 3;
MCU_0_R5_0.MCU_NAVSS_Non_secure_proxies_count                       = 4;
MCU_0_R5_0.Main_NAVSS_Interrupt_router_count                        = 4;
MCU_0_R5_0.MCU_NAVSS_Interrupt_router_count                         = 12;
MCU_0_R5_0.Main_GPIO_Interrupt_router_count                         = 8;
MCU_0_R5_0.Wakeup_GPIO_Interrupt_router_count                       = 8;
MCU_0_R5_0.Main_2_MCU_Level_Interrupt_router_count                  = 32;
MCU_0_R5_0.Main_2_MCU_Pulse_Interrupt_router_count                  = 24;
MCU_0_R5_0.Main_NAVSS_UDMA_Interrupt_aggregator_Global_events_count = 32;
MCU_0_R5_0.MCU_NAVSS_Interrupt_aggregator_Virtual_interrupts_count  = 64;
MCU_0_R5_0.MCU_NAVSS_Interrupt_aggregator_Global_events_count       = 256;
MCU_0_R5_0.Main_NAVSS_UDMA_Normal_capacity_Tx_channels_blockCount   = 2;

MCU_0_R5_2.allocOrder                                               = 10;
MCU_0_R5_2.Main_NAVSS_Ring_accelerator_Free_rings_count             = 6;
MCU_0_R5_2.Main_NAVSS_Ring_accelerator_ring_monitors_count          = 1;
MCU_0_R5_2.Main_NAVSS_Non_secure_proxies_count                      = 4;
MCU_0_R5_2.MCU_NAVSS_UDMA_Normal_capacity_Rx_channels_count         = 2;
MCU_0_R5_2.MCU_NAVSS_UDMA_Normal_capacity_Tx_channels_count         = 2;
MCU_0_R5_2.MCU_NAVSS_UDMA_Rx_free_flows_count                       = 4;
MCU_0_R5_2.MCU_NAVSS_Ring_accelerator_Free_rings_count              = 12;
MCU_0_R5_2.MCU_NAVSS_Ring_accelerator_ring_monitors_count           = 3;
MCU_0_R5_2.MCU_NAVSS_Non_secure_proxies_count                       = 4;
MCU_0_R5_2.Main_NAVSS_Interrupt_router_count                        = 4;
MCU_0_R5_2.MCU_NAVSS_Interrupt_router_count                         = 20;
MCU_0_R5_2.Main_GPIO_Interrupt_router_count                         = 8;
MCU_0_R5_2.Wakeup_GPIO_Interrupt_router_count                       = 8;
MCU_0_R5_2.Main_2_MCU_Level_Interrupt_router_count                  = 24;
MCU_0_R5_2.Main_2_MCU_Pulse_Interrupt_router_count                  = 16;
MCU_0_R5_2.Main_NAVSS_UDMA_Interrupt_aggregator_Global_events_count = 32;
MCU_0_R5_2.MCU_NAVSS_Interrupt_aggregator_Virtual_interrupts_count  = 4;
MCU_0_R5_2.MCU_NAVSS_Interrupt_aggregator_Global_events_count       = 64;
MCU_0_R5_2.Main_NAVSS_UDMA_Normal_capacity_Tx_channels_blockCount   = 2;
