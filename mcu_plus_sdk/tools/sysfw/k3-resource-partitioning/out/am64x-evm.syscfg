/**
 * @cliArgs --device "AM64x" --package "ALV" --part "Default" --product "K3-Respart-Tool@1.0"
 * @versions {"tool":"1.19.0+3426"}
 */

/**
 * Import the modules used in this configuration.
 */
const A53_2            = scripting.addModule("/modules/am64x/A53_2");
const M4_0             = scripting.addModule("/modules/am64x/M4_0");
const MAIN_0_R5_1      = scripting.addModule("/modules/am64x/MAIN_0_R5_1");
const MAIN_0_R5_3      = scripting.addModule("/modules/am64x/MAIN_0_R5_3");
const MAIN_1_R5_1      = scripting.addModule("/modules/am64x/MAIN_1_R5_1");
const MAIN_1_R5_3      = scripting.addModule("/modules/am64x/MAIN_1_R5_3");
const resourceSharing  = scripting.addModule("/modules/resourceSharing", {}, false);
const resourceSharing1 = resourceSharing.addInstance();
const resourceSharing2 = resourceSharing.addInstance();
const resourceSharing3 = resourceSharing.addInstance();
const resourceSharing4 = resourceSharing.addInstance();
const resourceSharing5 = resourceSharing.addInstance();

/**
 * Write custom configuration values to the imported modules.
 */
A53_2.allocOrder                                          = 1;
A53_2.Compare_event_Interrupt_Router_count                = 16;
A53_2.Block_Copy_DMA_Block_copy_channels_count            = 12;
A53_2.Block_Copy_DMA_Split_TR_Rx_channels_count           = 6;
A53_2.Block_Copy_DMA_Split_TR_Tx_channels_count           = 6;
A53_2.DMASS_Interrupt_aggregator_Virtual_interrupts_count = 35;
A53_2.DMASS_Interrupt_aggregator_Global_events_count      = 512;
A53_2.Packet_DMA_Rings_for_SA2UL_Tx_channel1_count        = 8;
A53_2.Packet_DMA_Rings_for_SA2UL_Rx_channel2_count        = 8;
A53_2.Packet_DMA_Rings_for_SA2UL_Rx_channel3_count        = 8;
A53_2.Packet_DMA_Free_Tx_channels_count                   = 4;
A53_2.Packet_DMA_SA2UL_Tx_channel1_count                  = 1;
A53_2.Packet_DMA_Free_Rx_channels_count                   = 4;
A53_2.Packet_DMA_CPSW_Rx_channel_count                    = 1;
A53_2.Packet_DMA_SA2UL_Rx_channel2_count                  = 1;
A53_2.Packet_DMA_SA2UL_Rx_channel3_count                  = 1;
A53_2.Packet_DMA_virt_id_range_start                      = 2;
A53_2.Packet_DMA_virt_id_range_count                      = 2;
A53_2.Packet_DMA_Rings_for_CPSW_Tx_channel_count          = 64;
A53_2.Packet_DMA_CPSW_Tx_channels_count                   = 8;
A53_2.Packet_DMA_Rings_for_CPSW_Rx_channel_count          = 16;
A53_2.MCU_GPIO_Interrupt_Router_count                     = 4;
A53_2.Main_GPIO_Interrupt_Router_count                    = 12;
A53_2.Packet_DMA_ICSSG0_Tx_channels_count                 = 8;
A53_2.Packet_DMA_ICSSG1_Tx_channels_count                 = 8;
A53_2.Packet_DMA_Rings_for_ICSSG0_Tx_channel_count        = 8;
A53_2.Packet_DMA_Rings_for_ICSSG1_Tx_channel_count        = 8;
A53_2.Packet_DMA_ICSSG1_Rx_channel_count                  = 4;
A53_2.Packet_DMA_ICSSG0_Rx_channel_count                  = 4;
A53_2.Packet_DMA_Rings_for_ICSSG1_Rx_channel_count        = 64;
A53_2.Packet_DMA_Rings_for_ICSSG0_Rx_channel_count        = 64;

M4_0.allocOrder                                          = 6;
M4_0.MCU_GPIO_Interrupt_Router_count                     = 4;
M4_0.Block_Copy_DMA_Block_copy_channels_count            = 1;
M4_0.DMASS_Interrupt_aggregator_Virtual_interrupts_count = 16;
M4_0.DMASS_Interrupt_aggregator_Global_events_count      = 96;
M4_0.Packet_DMA_Free_Tx_channels_count                   = 1;
M4_0.Packet_DMA_Free_Rx_channels_count                   = 1;

MAIN_0_R5_1.allocOrder                                          = 2;
MAIN_0_R5_1.Compare_event_Interrupt_Router_count                = 4;
MAIN_0_R5_1.Block_Copy_DMA_Block_copy_channels_count            = 6;
MAIN_0_R5_1.Block_Copy_DMA_Split_TR_Rx_channels_count           = 6;
MAIN_0_R5_1.Block_Copy_DMA_Split_TR_Tx_channels_count           = 6;
MAIN_0_R5_1.DMASS_Interrupt_aggregator_Virtual_interrupts_count = 14;
MAIN_0_R5_1.DMASS_Interrupt_aggregator_Global_events_count      = 256;
MAIN_0_R5_1.Packet_DMA_Free_Tx_channels_count                   = 3;
MAIN_0_R5_1.Packet_DMA_Free_Rx_channels_count                   = 3;
MAIN_0_R5_1.Packet_DMA_Rings_for_IPC_count                      = 2;
MAIN_0_R5_1.shareResource                                       = "MAIN_0_R5_0";

MAIN_0_R5_3.allocOrder                                          = 3;
MAIN_0_R5_3.Compare_event_Interrupt_Router_count                = 4;
MAIN_0_R5_3.Block_Copy_DMA_Block_copy_channels_count            = 2;
MAIN_0_R5_3.Block_Copy_DMA_Split_TR_Rx_channels_count           = 2;
MAIN_0_R5_3.Block_Copy_DMA_Split_TR_Tx_channels_count           = 2;
MAIN_0_R5_3.DMASS_Interrupt_aggregator_Virtual_interrupts_count = 14;
MAIN_0_R5_3.DMASS_Interrupt_aggregator_Global_events_count      = 192;
MAIN_0_R5_3.Packet_DMA_Free_Tx_channels_count                   = 2;
MAIN_0_R5_3.Packet_DMA_Free_Rx_channels_count                   = 2;
MAIN_0_R5_3.Packet_DMA_Rings_for_IPC_count                      = 2;

MAIN_1_R5_1.allocOrder                                          = 4;
MAIN_1_R5_1.Compare_event_Interrupt_Router_count                = 4;
MAIN_1_R5_1.Main_GPIO_Interrupt_Router_count                    = 2;
MAIN_1_R5_1.Block_Copy_DMA_Block_copy_channels_count            = 4;
MAIN_1_R5_1.Block_Copy_DMA_Split_TR_Rx_channels_count           = 4;
MAIN_1_R5_1.Block_Copy_DMA_Split_TR_Tx_channels_count           = 4;
MAIN_1_R5_1.DMASS_Interrupt_aggregator_Virtual_interrupts_count = 14;
MAIN_1_R5_1.DMASS_Interrupt_aggregator_Global_events_count      = 256;
MAIN_1_R5_1.Packet_DMA_Free_Tx_channels_count                   = 4;
MAIN_1_R5_1.Packet_DMA_Free_Rx_channels_count                   = 4;
MAIN_1_R5_1.Packet_DMA_Rings_for_IPC_count                      = 2;

MAIN_1_R5_3.allocOrder                                          = 5;
MAIN_1_R5_3.Compare_event_Interrupt_Router_count                = 4;
MAIN_1_R5_3.Main_GPIO_Interrupt_Router_count                    = 2;
MAIN_1_R5_3.Block_Copy_DMA_Block_copy_channels_count            = 2;
MAIN_1_R5_3.Block_Copy_DMA_Split_TR_Rx_channels_count           = 2;
MAIN_1_R5_3.Block_Copy_DMA_Split_TR_Tx_channels_count           = 2;
MAIN_1_R5_3.DMASS_Interrupt_aggregator_Virtual_interrupts_count = 14;
MAIN_1_R5_3.DMASS_Interrupt_aggregator_Global_events_count      = 192;
MAIN_1_R5_3.Packet_DMA_Free_Tx_channels_count                   = 2;
MAIN_1_R5_3.Packet_DMA_Free_Rx_channels_count                   = 2;
MAIN_1_R5_3.Packet_DMA_Rings_for_IPC_count                      = 2;

resourceSharing1.$name              = "modules_resourceSharing0";
resourceSharing1.resourceName       = "Packet DMA CPSW Tx channels";
resourceSharing1.sharedFromHostName = "A53_2";
resourceSharing1.sharedToHostName   = "MAIN_0_R5_0";

resourceSharing2.$name              = "modules_resourceSharing1";
resourceSharing2.resourceName       = "Packet DMA CPSW Rx channel";
resourceSharing2.sharedFromHostName = "A53_2";
resourceSharing2.sharedToHostName   = "MAIN_0_R5_0";

resourceSharing3.$name              = "modules_resourceSharing2";
resourceSharing3.resourceName       = "Packet DMA CPSW Rx flows";
resourceSharing3.sharedFromHostName = "A53_2";
resourceSharing3.sharedToHostName   = "MAIN_0_R5_0";

resourceSharing4.$name              = "modules_resourceSharing3";
resourceSharing4.resourceName       = "Packet DMA Rings for CPSW Tx channel";
resourceSharing4.sharedFromHostName = "A53_2";
resourceSharing4.sharedToHostName   = "MAIN_0_R5_0";

resourceSharing5.$name              = "modules_resourceSharing4";
resourceSharing5.resourceName       = "Packet DMA Rings for CPSW Rx channel";
resourceSharing5.sharedFromHostName = "A53_2";
resourceSharing5.sharedToHostName   = "MAIN_0_R5_0";
