/**
 * @cliArgs --device "J721E_DRA829_TDA4VM_AM752x" --package "ALF" --part "Default" --product "K3-Respart-Tool@1.0"
 * @versions {"tool":"1.10.0+2163"}
 */

/**
 * Import the modules used in this configuration.
 */
const firewallConfig  = scripting.addModule("/modules/firewallConfig", {}, false);
const firewallConfig1 = firewallConfig.addInstance();
const A72_2           = scripting.addModule("/modules/j721e/A72_2");
const A72_3           = scripting.addModule("/modules/j721e/A72_3");
const C6X_0_1         = scripting.addModule("/modules/j721e/C6X_0_1");
const C6X_1_1         = scripting.addModule("/modules/j721e/C6X_1_1");
const C7X_1           = scripting.addModule("/modules/j721e/C7X_1");
const MAIN_0_R5_0     = scripting.addModule("/modules/j721e/MAIN_0_R5_0");
const MAIN_0_R5_2     = scripting.addModule("/modules/j721e/MAIN_0_R5_2");
const MAIN_1_R5_0     = scripting.addModule("/modules/j721e/MAIN_1_R5_0");
const MAIN_1_R5_2     = scripting.addModule("/modules/j721e/MAIN_1_R5_2");
const MCU_0_R5_0      = scripting.addModule("/modules/j721e/MCU_0_R5_0");
const MCU_0_R5_2      = scripting.addModule("/modules/j721e/MCU_0_R5_2");
const qosConfig       = scripting.addModule("/modules/qosConfig", {}, false);
const qosConfig1      = qosConfig.addInstance();
const qosConfig2      = qosConfig.addInstance();
const qosConfig3      = qosConfig.addInstance();
const qosConfig4      = qosConfig.addInstance();
const qosConfig5      = qosConfig.addInstance();
const qosConfig6      = qosConfig.addInstance();
const qosConfig7      = qosConfig.addInstance();
const qosConfig8      = qosConfig.addInstance();
const qosConfig9      = qosConfig.addInstance();
const qosConfig10     = qosConfig.addInstance();
const qosConfig11     = qosConfig.addInstance();

/**
 * Write custom configuration values to the imported modules.
 */
firewallConfig1.$name                                  = "PVU";
firewallConfig1.device                                 = "PVU";
firewallConfig1.regions[0].$name                       = "modules_firewallRegion1";
firewallConfig1.regions[0].perms[0].$name              = "modules_firewallPermissions1";
firewallConfig1.regions[0].perms[0].s_user_rd          = false;
firewallConfig1.regions[0].perms[0].s_user_wr          = false;
firewallConfig1.regions[0].perms[0].s_user_cache       = false;
firewallConfig1.regions[0].perms[0].s_user_debug       = false;
firewallConfig1.regions[0].perms[0].s_supervisor_wr    = false;
firewallConfig1.regions[0].perms[0].s_supervisor_debug = false;
firewallConfig1.regions[0].perms[0].s_supervisor_rd    = false;
firewallConfig1.regions[0].perms[0].s_supervisor_cache = false;
firewallConfig1.regions[0].perms[0].ns_user_deb        = false;
firewallConfig1.regions[0].perms[0].ns_user_cache      = false;
firewallConfig1.regions[0].perms[0].ns_user_wr         = false;
firewallConfig1.regions[0].perms[0].ns_user_rd         = false;
firewallConfig1.regions[0].perms[0].hostName           = "A72_2";

A72_2.Main_NAVSS_UDMA_Interrupt_aggregator_Virtual_interrupts_count = 86;
A72_2.Main_NAVSS_UDMA_Interrupt_aggregator_Global_events_count      = 1024;
A72_2.Main_NAVSS_Non_secure_proxies_count                           = 4;
A72_2.Main_NAVSS_Ring_accelerator_Free_rings_count                  = 150;
A72_2.Main_NAVSS_Ring_accelerator_ring_monitors_count               = 3;
A72_2.Main_NAVSS_UDMA_Rx_free_flows_count                           = 16;
A72_2.Main_NAVSS_UDMA_High_capacity_Rx_channels_count               = 4;
A72_2.Main_NAVSS_UDMA_Ultra_high_capacity_Rx_channels_count         = 2;
A72_2.Main_NAVSS_UDMA_High_capacity_Tx_channels_count               = 4;
A72_2.Main_NAVSS_UDMA_Ultra_high_capacity_Tx_channels_count         = 2;
A72_2.Main_NAVSS_Interrupt_router_count                             = 100;
A72_2.MCU_NAVSS_Interrupt_aggregator_Virtual_interrupts_count       = 32;
A72_2.MCU_NAVSS_Interrupt_aggregator_Global_events_count            = 128;
A72_2.MCU_NAVSS_Non_secure_proxies_count                            = 4;
A72_2.MCU_NAVSS_Ring_accelerator_Free_rings_count                   = 20;
A72_2.MCU_NAVSS_Ring_accelerator_ring_monitors_count                = 3;
A72_2.MCU_NAVSS_UDMA_Rx_free_flows_count                            = 8;
A72_2.Main_NAVSS_Ring_accelerator_virt_id_range_start               = 2;
A72_2.Main_NAVSS_Ring_accelerator_virt_id_range_count               = 5;
A72_2.allocOrder                                                    = 1;
A72_2.Main_GPIO_Interrupt_router_count                              = 12;
A72_2.Wakeup_GPIO_Interrupt_router_count                            = 6;
A72_2.Main_NAVSS_UDMA_Normal_capacity_Tx_channels_blockCount        = 8;
A72_2.MCU_NAVSS_UDMA_Normal_capacity_Rx_channels_count              = 9;
A72_2.MCU_NAVSS_UDMA_Normal_capacity_Tx_channels_count              = 9;
A72_2.MCU_NAVSS_UDMA_Normal_capacity_Tx_channels_blockCount         = 4;
A72_2.Main_NAVSS_UDMA_Normal_capacity_Rx_channels_count             = 47;
A72_2.Main_NAVSS_UDMA_Normal_capacity_Tx_channels_count             = 47;

A72_3.Main_NAVSS_UDMA_Interrupt_aggregator_Virtual_interrupts_count = 32;
A72_3.Main_NAVSS_UDMA_Interrupt_aggregator_Global_events_count      = 512;
A72_3.Main_NAVSS_Non_secure_proxies_count                           = 4;
A72_3.Main_NAVSS_Ring_accelerator_Free_rings_count                  = 40;
A72_3.Main_NAVSS_Ring_accelerator_ring_monitors_count               = 2;
A72_3.Main_NAVSS_UDMA_Rx_free_flows_count                           = 16;
A72_3.Main_NAVSS_Interrupt_router_count                             = 32;
A72_3.MCU_NAVSS_Interrupt_aggregator_Virtual_interrupts_count       = 16;
A72_3.MCU_NAVSS_Interrupt_aggregator_Global_events_count            = 128;
A72_3.MCU_NAVSS_Non_secure_proxies_count                            = 4;
A72_3.MCU_NAVSS_Ring_accelerator_Free_rings_count                   = 8;
A72_3.MCU_NAVSS_Ring_accelerator_ring_monitors_count                = 2;
A72_3.MCU_NAVSS_UDMA_Rx_free_flows_count                            = 4;
A72_3.MCU_NAVSS_UDMA_Normal_capacity_Rx_channels_count              = 6;
A72_3.MCU_NAVSS_UDMA_Normal_capacity_Tx_channels_count              = 6;
A72_3.Main_NAVSS_Ring_accelerator_virt_id_range_start               = 7;
A72_3.Main_NAVSS_Ring_accelerator_virt_id_range_count               = 1;
A72_3.allocOrder                                                    = 2;
A72_3.Main_GPIO_Interrupt_router_count                              = 12;
A72_3.Wakeup_GPIO_Interrupt_router_count                            = 6;
A72_3.Main_NAVSS_UDMA_Normal_capacity_Rx_channels_count             = 1;
A72_3.Main_NAVSS_UDMA_Normal_capacity_Tx_channels_count             = 1;

C6X_0_1.Interrupt_router_for_C6X_subsystem0_count                     = 93;
C6X_0_1.Main_GPIO_Interrupt_router_count                              = 4;
C6X_0_1.Main_NAVSS_UDMA_Interrupt_aggregator_Virtual_interrupts_count = 12;
C6X_0_1.Main_NAVSS_UDMA_Interrupt_aggregator_Global_events_count      = 256;
C6X_0_1.Main_NAVSS_Non_secure_proxies_count                           = 4;
C6X_0_1.Main_NAVSS_Ring_accelerator_Free_rings_count                  = 38;
C6X_0_1.Main_NAVSS_Ring_accelerator_ring_monitors_count               = 3;
C6X_0_1.Main_NAVSS_UDMA_Extended_Tx_channels_count                    = 6;
C6X_0_1.Main_NAVSS_Interrupt_router_count                             = 24;
C6X_0_1.MCU_NAVSS_Interrupt_aggregator_Virtual_interrupts_count       = 8;
C6X_0_1.MCU_NAVSS_Interrupt_aggregator_Global_events_count            = 64;
C6X_0_1.MCU_NAVSS_Non_secure_proxies_count                            = 4;
C6X_0_1.MCU_NAVSS_Ring_accelerator_Free_rings_count                   = 8;
C6X_0_1.MCU_NAVSS_Ring_accelerator_ring_monitors_count                = 3;
C6X_0_1.allocOrder                                                    = 8;
C6X_0_1.Main_NAVSS_UDMA_Normal_capacity_Rx_channels_count             = 8;
C6X_0_1.Main_NAVSS_UDMA_Normal_capacity_Tx_channels_count             = 8;
C6X_0_1.Main_NAVSS_UDMA_Normal_capacity_Tx_channels_blockCount        = 8;
C6X_0_1.MCU_NAVSS_UDMA_Normal_capacity_Rx_channels_count              = 1;
C6X_0_1.MCU_NAVSS_UDMA_Normal_capacity_Tx_channels_count              = 1;
C6X_0_1.MCU_NAVSS_UDMA_Normal_capacity_Tx_channels_blockCount         = 1;

C6X_1_1.Interrupt_router_for_C6X_subsystem1_count                     = 93;
C6X_1_1.Main_GPIO_Interrupt_router_count                              = 4;
C6X_1_1.Main_NAVSS_UDMA_Interrupt_aggregator_Virtual_interrupts_count = 12;
C6X_1_1.Main_NAVSS_UDMA_Interrupt_aggregator_Global_events_count      = 256;
C6X_1_1.Main_NAVSS_Non_secure_proxies_count                           = 4;
C6X_1_1.Main_NAVSS_Ring_accelerator_Free_rings_count                  = 12;
C6X_1_1.Main_NAVSS_Ring_accelerator_ring_monitors_count               = 3;
C6X_1_1.Main_NAVSS_UDMA_Extended_Tx_channels_count                    = 6;
C6X_1_1.Main_NAVSS_Interrupt_router_count                             = 24;
C6X_1_1.MCU_NAVSS_Interrupt_aggregator_Virtual_interrupts_count       = 8;
C6X_1_1.MCU_NAVSS_Interrupt_aggregator_Global_events_count            = 64;
C6X_1_1.MCU_NAVSS_Non_secure_proxies_count                            = 4;
C6X_1_1.MCU_NAVSS_Ring_accelerator_Free_rings_count                   = 8;
C6X_1_1.MCU_NAVSS_Ring_accelerator_ring_monitors_count                = 3;
C6X_1_1.allocOrder                                                    = 9;
C6X_1_1.Main_NAVSS_UDMA_Normal_capacity_Rx_channels_count             = 6;
C6X_1_1.Main_NAVSS_UDMA_Normal_capacity_Tx_channels_count             = 6;
C6X_1_1.Main_NAVSS_UDMA_Normal_capacity_Tx_channels_blockCount        = 2;
C6X_1_1.MCU_NAVSS_UDMA_Normal_capacity_Rx_channels_count              = 1;
C6X_1_1.MCU_NAVSS_UDMA_Normal_capacity_Tx_channels_count              = 1;
C6X_1_1.MCU_NAVSS_UDMA_Normal_capacity_Tx_channels_blockCount         = 1;

C7X_1.Main_NAVSS_UDMA_Interrupt_aggregator_Virtual_interrupts_count = 12;
C7X_1.Main_NAVSS_UDMA_Interrupt_aggregator_Global_events_count      = 256;
C7X_1.Main_NAVSS_Non_secure_proxies_count                           = 4;
C7X_1.Main_NAVSS_Ring_accelerator_Free_rings_count                  = 32;
C7X_1.Main_NAVSS_Ring_accelerator_ring_monitors_count               = 3;
C7X_1.Main_NAVSS_UDMA_Extended_Tx_channels_count                    = 16;
C7X_1.Main_NAVSS_Interrupt_router_count                             = 46;
C7X_1.MCU_NAVSS_Interrupt_aggregator_Virtual_interrupts_count       = 8;
C7X_1.MCU_NAVSS_Interrupt_aggregator_Global_events_count            = 64;
C7X_1.MCU_NAVSS_Non_secure_proxies_count                            = 4;
C7X_1.MCU_NAVSS_Ring_accelerator_Free_rings_count                   = 8;
C7X_1.MCU_NAVSS_Ring_accelerator_ring_monitors_count                = 3;
C7X_1.allocOrder                                                    = 7;
C7X_1.Main_NAVSS_UDMA_Normal_capacity_Rx_channels_count             = 4;
C7X_1.Main_NAVSS_UDMA_Normal_capacity_Tx_channels_count             = 4;
C7X_1.Main_NAVSS_UDMA_Normal_capacity_Tx_channels_blockCount        = 2;
C7X_1.MCU_NAVSS_UDMA_Normal_capacity_Rx_channels_count              = 1;
C7X_1.MCU_NAVSS_UDMA_Normal_capacity_Tx_channels_count              = 1;
C7X_1.MCU_NAVSS_UDMA_Normal_capacity_Tx_channels_blockCount         = 1;

MAIN_0_R5_0.Main_GPIO_Interrupt_router_count                              = 4;
MAIN_0_R5_0.Interrupt_router_for_Main_R5F_Subsystem0_count                = 128;
MAIN_0_R5_0.Wakeup_GPIO_Interrupt_router_count                            = 2;
MAIN_0_R5_0.Main_NAVSS_UDMA_Interrupt_aggregator_Virtual_interrupts_count = 28;
MAIN_0_R5_0.Main_NAVSS_UDMA_Interrupt_aggregator_Global_events_count      = 512;
MAIN_0_R5_0.Main_NAVSS_Non_secure_proxies_count                           = 12;
MAIN_0_R5_0.Main_NAVSS_Ring_accelerator_Free_rings_count                  = 182;
MAIN_0_R5_0.Main_NAVSS_Ring_accelerator_ring_monitors_count               = 6;
MAIN_0_R5_0.Main_NAVSS_UDMA_High_capacity_Rx_channels_count               = 6;
MAIN_0_R5_0.Main_NAVSS_UDMA_Ultra_high_capacity_Rx_channels_count         = 2;
MAIN_0_R5_0.Main_NAVSS_UDMA_High_capacity_Tx_channels_count               = 6;
MAIN_0_R5_0.Main_NAVSS_UDMA_Ultra_high_capacity_Tx_channels_count         = 2;
MAIN_0_R5_0.Main_NAVSS_Interrupt_router_count                             = 28;
MAIN_0_R5_0.MCU_NAVSS_Interrupt_aggregator_Virtual_interrupts_count       = 24;
MAIN_0_R5_0.MCU_NAVSS_Interrupt_aggregator_Global_events_count            = 128;
MAIN_0_R5_0.MCU_NAVSS_Non_secure_proxies_count                            = 16;
MAIN_0_R5_0.MCU_NAVSS_Ring_accelerator_Free_rings_count                   = 16;
MAIN_0_R5_0.MCU_NAVSS_Ring_accelerator_ring_monitors_count                = 3;
MAIN_0_R5_0.MCU_NAVSS_UDMA_Rx_free_flows_count                            = 8;
MAIN_0_R5_0.Main_NAVSS_UDMA_Extended_Tx_channels_hwa_start                = 172;
MAIN_0_R5_0.Main_NAVSS_UDMA_Extended_Tx_channels_hwa_count                = 96;
MAIN_0_R5_0.Main_NAVSS_UDMA_Extended_Tx_channels_count                    = 2;
MAIN_0_R5_0.allocOrder                                                    = 10;
MAIN_0_R5_0.Main_NAVSS_UDMA_Normal_capacity_Tx_channels_count             = 10;
MAIN_0_R5_0.Main_NAVSS_UDMA_Normal_capacity_Rx_channels_count             = 16;
MAIN_0_R5_0.Main_NAVSS_UDMA_Normal_capacity_Tx_channels_blockCount        = 4;
MAIN_0_R5_0.MCU_NAVSS_UDMA_Normal_capacity_Rx_channels_count              = 2;
MAIN_0_R5_0.MCU_NAVSS_UDMA_Normal_capacity_Tx_channels_count              = 2;
MAIN_0_R5_0.MCU_NAVSS_UDMA_Normal_capacity_Tx_channels_blockCount         = 1;

MAIN_0_R5_2.Main_GPIO_Interrupt_router_count                              = 4;
MAIN_0_R5_2.Interrupt_router_for_Main_R5F_Subsystem0_count                = 128;
MAIN_0_R5_2.Wakeup_GPIO_Interrupt_router_count                            = 2;
MAIN_0_R5_2.Main_NAVSS_UDMA_Interrupt_aggregator_Virtual_interrupts_count = 8;
MAIN_0_R5_2.Main_NAVSS_UDMA_Interrupt_aggregator_Global_events_count      = 256;
MAIN_0_R5_2.Main_NAVSS_Non_secure_proxies_count                           = 4;
MAIN_0_R5_2.Main_NAVSS_Ring_accelerator_Free_rings_count                  = 40;
MAIN_0_R5_2.Main_NAVSS_Ring_accelerator_ring_monitors_count               = 3;
MAIN_0_R5_2.Main_NAVSS_UDMA_Normal_capacity_Tx_channels_count             = 6;
MAIN_0_R5_2.Main_NAVSS_Interrupt_router_count                             = 28;
MAIN_0_R5_2.MCU_NAVSS_Interrupt_aggregator_Virtual_interrupts_count       = 8;
MAIN_0_R5_2.MCU_NAVSS_Interrupt_aggregator_Global_events_count            = 128;
MAIN_0_R5_2.MCU_NAVSS_Non_secure_proxies_count                            = 4;
MAIN_0_R5_2.MCU_NAVSS_Ring_accelerator_Free_rings_count                   = 8;
MAIN_0_R5_2.MCU_NAVSS_Ring_accelerator_ring_monitors_count                = 3;
MAIN_0_R5_2.MCU_NAVSS_UDMA_Rx_free_flows_count                            = 4;
MAIN_0_R5_2.allocOrder                                                    = 11;
MAIN_0_R5_2.Main_NAVSS_UDMA_Extended_Tx_channels_hwa_start                = 268;
MAIN_0_R5_2.Main_NAVSS_UDMA_Extended_Tx_channels_hwa_count                = 32;
MAIN_0_R5_2.Main_NAVSS_UDMA_Extended_Tx_channels_count                    = 2;
MAIN_0_R5_2.Main_NAVSS_UDMA_Normal_capacity_Rx_channels_count             = 1;
MAIN_0_R5_2.Main_NAVSS_UDMA_Normal_capacity_Tx_channels_blockCount        = 1;
MAIN_0_R5_2.MCU_NAVSS_UDMA_Normal_capacity_Rx_channels_count              = 1;
MAIN_0_R5_2.MCU_NAVSS_UDMA_Normal_capacity_Tx_channels_count              = 1;
MAIN_0_R5_2.MCU_NAVSS_UDMA_Normal_capacity_Tx_channels_blockCount         = 1;

MAIN_1_R5_0.Main_GPIO_Interrupt_router_count                              = 4;
MAIN_1_R5_0.Interrupt_router_for_Main_R5F_Subsystem1_count                = 128;
MAIN_1_R5_0.Main_NAVSS_UDMA_Interrupt_aggregator_Virtual_interrupts_count = 12;
MAIN_1_R5_0.Main_NAVSS_UDMA_Interrupt_aggregator_Global_events_count      = 256;
MAIN_1_R5_0.Main_NAVSS_Non_secure_proxies_count                           = 4;
MAIN_1_R5_0.Main_NAVSS_Ring_accelerator_Free_rings_count                  = 10;
MAIN_1_R5_0.Main_NAVSS_Ring_accelerator_ring_monitors_count               = 3;
MAIN_1_R5_0.Main_NAVSS_Interrupt_router_count                             = 28;
MAIN_1_R5_0.MCU_NAVSS_Interrupt_aggregator_Virtual_interrupts_count       = 16;
MAIN_1_R5_0.MCU_NAVSS_Interrupt_aggregator_Global_events_count            = 128;
MAIN_1_R5_0.MCU_NAVSS_Non_secure_proxies_count                            = 4;
MAIN_1_R5_0.MCU_NAVSS_Ring_accelerator_Free_rings_count                   = 8;
MAIN_1_R5_0.MCU_NAVSS_Ring_accelerator_ring_monitors_count                = 3;
MAIN_1_R5_0.MCU_NAVSS_UDMA_Rx_free_flows_count                            = 4;
MAIN_1_R5_0.allocOrder                                                    = 5;
MAIN_1_R5_0.Main_NAVSS_UDMA_Normal_capacity_Rx_channels_count             = 4;
MAIN_1_R5_0.Main_NAVSS_UDMA_Normal_capacity_Tx_channels_count             = 4;
MAIN_1_R5_0.Main_NAVSS_UDMA_Normal_capacity_Tx_channels_blockCount        = 2;
MAIN_1_R5_0.MCU_NAVSS_UDMA_Normal_capacity_Rx_channels_count              = 1;
MAIN_1_R5_0.MCU_NAVSS_UDMA_Normal_capacity_Tx_channels_count              = 1;
MAIN_1_R5_0.MCU_NAVSS_UDMA_Normal_capacity_Tx_channels_blockCount         = 1;

MAIN_1_R5_2.Main_GPIO_Interrupt_router_count                              = 4;
MAIN_1_R5_2.Interrupt_router_for_Main_R5F_Subsystem1_count                = 128;
MAIN_1_R5_2.Main_NAVSS_UDMA_Interrupt_aggregator_Virtual_interrupts_count = 12;
MAIN_1_R5_2.Main_NAVSS_UDMA_Interrupt_aggregator_Global_events_count      = 256;
MAIN_1_R5_2.Main_NAVSS_Non_secure_proxies_count                           = 4;
MAIN_1_R5_2.Main_NAVSS_Ring_accelerator_Free_rings_count                  = 10;
MAIN_1_R5_2.Main_NAVSS_Ring_accelerator_ring_monitors_count               = 3;
MAIN_1_R5_2.Main_NAVSS_Interrupt_router_count                             = 28;
MAIN_1_R5_2.MCU_NAVSS_Interrupt_aggregator_Virtual_interrupts_count       = 16;
MAIN_1_R5_2.MCU_NAVSS_Interrupt_aggregator_Global_events_count            = 128;
MAIN_1_R5_2.MCU_NAVSS_Non_secure_proxies_count                            = 4;
MAIN_1_R5_2.MCU_NAVSS_Ring_accelerator_Free_rings_count                   = 8;
MAIN_1_R5_2.MCU_NAVSS_Ring_accelerator_ring_monitors_count                = 3;
MAIN_1_R5_2.MCU_NAVSS_UDMA_Rx_free_flows_count                            = 4;
MAIN_1_R5_2.allocOrder                                                    = 6;
MAIN_1_R5_2.Main_NAVSS_UDMA_Normal_capacity_Rx_channels_count             = 4;
MAIN_1_R5_2.Main_NAVSS_UDMA_Normal_capacity_Tx_channels_count             = 4;
MAIN_1_R5_2.Main_NAVSS_UDMA_Normal_capacity_Tx_channels_blockCount        = 2;
MAIN_1_R5_2.MCU_NAVSS_UDMA_Normal_capacity_Rx_channels_count              = 1;
MAIN_1_R5_2.MCU_NAVSS_UDMA_Normal_capacity_Tx_channels_count              = 1;
MAIN_1_R5_2.MCU_NAVSS_UDMA_Normal_capacity_Tx_channels_blockCount         = 1;

MCU_0_R5_0.Main_2_MCU_Level_Interrupt_router_count                  = 32;
MCU_0_R5_0.Main_2_MCU_Pulse_Interrupt_router_count                  = 24;
MCU_0_R5_0.Main_GPIO_Interrupt_router_count                         = 8;
MCU_0_R5_0.Wakeup_GPIO_Interrupt_router_count                       = 8;
MCU_0_R5_0.Main_NAVSS_UDMA_Interrupt_aggregator_Global_events_count = 32;
MCU_0_R5_0.Main_NAVSS_Non_secure_proxies_count                      = 4;
MCU_0_R5_0.Main_NAVSS_Ring_accelerator_Free_rings_count             = 6;
MCU_0_R5_0.Main_NAVSS_Interrupt_router_count                        = 4;
MCU_0_R5_0.MCU_NAVSS_Interrupt_aggregator_Virtual_interrupts_count  = 64;
MCU_0_R5_0.MCU_NAVSS_Interrupt_aggregator_Global_events_count       = 256;
MCU_0_R5_0.MCU_NAVSS_Non_secure_proxies_count                       = 4;
MCU_0_R5_0.MCU_NAVSS_Ring_accelerator_Free_rings_count              = 32;
MCU_0_R5_0.MCU_NAVSS_Ring_accelerator_ring_monitors_count           = 3;
MCU_0_R5_0.MCU_NAVSS_UDMA_Rx_free_flows_count                       = 8;
MCU_0_R5_0.MCU_NAVSS_UDMA_High_capacity_Rx_channels_count           = 2;
MCU_0_R5_0.MCU_NAVSS_UDMA_High_capacity_Tx_channels_count           = 2;
MCU_0_R5_0.Main_NAVSS_Ring_accelerator_ring_monitors_count          = 1;
MCU_0_R5_0.allocOrder                                               = 3;
MCU_0_R5_0.Main_NAVSS_UDMA_Normal_capacity_Tx_channels_blockCount   = 2;
MCU_0_R5_0.MCU_NAVSS_UDMA_Normal_capacity_Rx_channels_count         = 3;
MCU_0_R5_0.MCU_NAVSS_UDMA_Normal_capacity_Tx_channels_count         = 3;
MCU_0_R5_0.MCU_NAVSS_UDMA_Normal_capacity_Tx_channels_blockCount    = 2;
MCU_0_R5_0.MCU_NAVSS_Interrupt_router_count                         = 20;

MCU_0_R5_2.Main_2_MCU_Level_Interrupt_router_count                  = 32;
MCU_0_R5_2.Main_2_MCU_Pulse_Interrupt_router_count                  = 24;
MCU_0_R5_2.Main_GPIO_Interrupt_router_count                         = 8;
MCU_0_R5_2.Wakeup_GPIO_Interrupt_router_count                       = 8;
MCU_0_R5_2.Main_NAVSS_UDMA_Interrupt_aggregator_Global_events_count = 32;
MCU_0_R5_2.Main_NAVSS_Non_secure_proxies_count                      = 4;
MCU_0_R5_2.Main_NAVSS_Ring_accelerator_Free_rings_count             = 6;
MCU_0_R5_2.Main_NAVSS_Ring_accelerator_ring_monitors_count          = 1;
MCU_0_R5_2.Main_NAVSS_Interrupt_router_count                        = 4;
MCU_0_R5_2.MCU_NAVSS_Interrupt_aggregator_Virtual_interrupts_count  = 4;
MCU_0_R5_2.MCU_NAVSS_Interrupt_aggregator_Global_events_count       = 64;
MCU_0_R5_2.MCU_NAVSS_Non_secure_proxies_count                       = 4;
MCU_0_R5_2.MCU_NAVSS_Ring_accelerator_Free_rings_count              = 12;
MCU_0_R5_2.MCU_NAVSS_Ring_accelerator_ring_monitors_count           = 3;
MCU_0_R5_2.MCU_NAVSS_UDMA_Rx_free_flows_count                       = 4;
MCU_0_R5_2.MCU_NAVSS_UDMA_Normal_capacity_Rx_channels_count         = 2;
MCU_0_R5_2.MCU_NAVSS_UDMA_Normal_capacity_Tx_channels_count         = 2;
MCU_0_R5_2.MCU_NAVSS_Interrupt_router_count                         = 28;
MCU_0_R5_2.allocOrder                                               = 4;
MCU_0_R5_2.Main_NAVSS_UDMA_Normal_capacity_Tx_channels_blockCount   = 2;

qosConfig1.deviceName = "K3_DSS_MAIN_0";
qosConfig1.chan       = ["0","1"];
qosConfig1.$name      = "DSS_PIPE_VID1";
qosConfig1.orderId    = 15;
qosConfig1.virtId     = 2;
qosConfig1.atype      = 1;

qosConfig2.deviceName = "K3_DSS_MAIN_0";
qosConfig2.chan       = ["2","3"];
qosConfig2.atype      = 1;
qosConfig2.orderId    = 13;
qosConfig2.$name      = "DSS_PIPE_VIDL1";
qosConfig2.virtId     = 3;

qosConfig3.deviceName = "K3_DSS_MAIN_0";
qosConfig3.chan       = ["4","5"];
qosConfig3.atype      = 1;
qosConfig3.virtId     = 2;
qosConfig3.orderId    = 11;
qosConfig3.$name      = "DSS_PIPE_VID2";

qosConfig4.$name      = "DSS_PIPE_VIDL2";
qosConfig4.deviceName = "K3_DSS_MAIN_0";
qosConfig4.chan       = ["6","7"];
qosConfig4.virtId     = 2;
qosConfig4.orderId    = 9;
qosConfig4.atype      = 1;

qosConfig5.$name      = "DSS_PIPE_WB";
qosConfig5.deviceName = "K3_DSS_MAIN_0";
qosConfig5.atype      = 1;
qosConfig5.virtId     = 2;
qosConfig5.orderId    = 7;
qosConfig5.chan       = ["8","9"];

qosConfig6.deviceName = "EMMC8SS_16FFC_MAIN_0";
qosConfig6.$name      = "EMMC_MMC0";
qosConfig6.atype      = 1;
qosConfig6.virtId     = 3;

qosConfig7.$name      = "SD_MMC1";
qosConfig7.deviceName = "EMMCSD4SS_MAIN_0";
qosConfig7.atype      = 1;
qosConfig7.virtId     = 2;

qosConfig8.$name      = "vGPU0";
qosConfig8.deviceName = "J7_LASCAR_GPU_WRAP_MAIN_0";
qosConfig8.chan       = ["0","1","2","3"];
qosConfig8.atype      = 1;
qosConfig8.virtId     = 2;

qosConfig9.$name      = "vGPU1";
qosConfig9.deviceName = "J7_LASCAR_GPU_WRAP_MAIN_0";
qosConfig9.chan       = ["4","5","6","7"];
qosConfig9.atype      = 1;
qosConfig9.virtId     = 3;

qosConfig10.$name      = "USB0";
qosConfig10.deviceName = "USB3P0SS_16FFC_MAIN_0";
qosConfig10.atype      = 1;
qosConfig10.virtId     = 2;

qosConfig11.$name      = "USB1";
qosConfig11.deviceName = "USB3P0SS_16FFC_MAIN_1";
qosConfig11.atype      = 1;
qosConfig11.virtId     = 3;
