/**
 * @cliArgs --device "AM243x_ALV_beta" --package "ALV" --part "ALV" --product "K3-Respart-Tool@1.0"
 * @versions {"tool":"1.14.0+2667"}
 */

/**
 * Import the modules used in this configuration.
 */
const M4_0         = scripting.addModule("/modules/am243x/M4_0");
const MAIN_0_R5_0  = scripting.addModule("/modules/am243x/MAIN_0_R5_0");
const MAIN_0_R5_1  = scripting.addModule("/modules/am243x/MAIN_0_R5_1");
const MAIN_0_R5_3  = scripting.addModule("/modules/am243x/MAIN_0_R5_3");
const MAIN_1_R5_1  = scripting.addModule("/modules/am243x/MAIN_1_R5_1");
const MAIN_1_R5_3  = scripting.addModule("/modules/am243x/MAIN_1_R5_3");
const boardConfig  = scripting.addModule("/modules/boardConfig", {}, false);
const boardConfig1 = boardConfig.addInstance();

/**
 * Write custom configuration values to the imported modules.
 */
M4_0.allocOrder                                          = 6;
M4_0.Block_Copy_DMA_Block_copy_channels_count            = 1;
M4_0.Packet_DMA_Free_Tx_channels_count                   = 1;
M4_0.Packet_DMA_Free_Rx_channels_count                   = 1;
M4_0.MCU_GPIO_Interrupt_Router_count                     = 4;
M4_0.DMASS_Interrupt_aggregator_Virtual_interrupts_count = 16;
M4_0.DMASS_Interrupt_aggregator_Global_events_count      = 96;

MAIN_0_R5_0.allocOrder                                          = 1;
MAIN_0_R5_0.Block_Copy_DMA_Block_copy_channels_count            = 12;
MAIN_0_R5_0.Block_Copy_DMA_Split_TR_Rx_channels_count           = 6;
MAIN_0_R5_0.Block_Copy_DMA_Split_TR_Tx_channels_count           = 6;
MAIN_0_R5_0.Packet_DMA_Free_Tx_channels_count                   = 4;
MAIN_0_R5_0.Packet_DMA_Free_Rx_channels_count                   = 4;
MAIN_0_R5_0.Packet_DMA_CPSW_Tx_channels_count                   = 8;
MAIN_0_R5_0.Packet_DMA_CPSW_Rx_channel_count                    = 1;
MAIN_0_R5_0.Packet_DMA_SA2UL_Tx_channel1_count                  = 1;
MAIN_0_R5_0.Packet_DMA_SA2UL_Rx_channel2_count                  = 1;
MAIN_0_R5_0.Packet_DMA_SA2UL_Rx_channel3_count                  = 1;
MAIN_0_R5_0.Packet_DMA_ICSSG0_Tx_channels_count                 = 8;
MAIN_0_R5_0.Packet_DMA_ICSSG0_Rx_channel_count                  = 4;
MAIN_0_R5_0.Packet_DMA_ICSSG1_Tx_channels_count                 = 8;
MAIN_0_R5_0.Packet_DMA_ICSSG1_Rx_channel_count                  = 4;
MAIN_0_R5_0.Packet_DMA_Rings_for_CPSW_Tx_channel_count          = 64;
MAIN_0_R5_0.Packet_DMA_Rings_for_CPSW_Rx_channel_count          = 16;
MAIN_0_R5_0.Packet_DMA_Rings_for_SA2UL_Tx_channel1_count        = 8;
MAIN_0_R5_0.Packet_DMA_Rings_for_SA2UL_Rx_channel2_count        = 8;
MAIN_0_R5_0.Packet_DMA_Rings_for_SA2UL_Rx_channel3_count        = 8;
MAIN_0_R5_0.Packet_DMA_Rings_for_ICSSG0_Tx_channel_count        = 8;
MAIN_0_R5_0.Packet_DMA_Rings_for_ICSSG0_Rx_channel_count        = 64;
MAIN_0_R5_0.Packet_DMA_Rings_for_ICSSG1_Tx_channel_count        = 8;
MAIN_0_R5_0.Packet_DMA_Rings_for_ICSSG1_Rx_channel_count        = 64;
MAIN_0_R5_0.Packet_DMA_virt_id_range_start                      = 2;
MAIN_0_R5_0.Packet_DMA_virt_id_range_count                      = 2;
MAIN_0_R5_0.Compare_event_Interrupt_Router_count                = 16;
MAIN_0_R5_0.Main_GPIO_Interrupt_Router_count                    = 12;
MAIN_0_R5_0.MCU_GPIO_Interrupt_Router_count                     = 4;
MAIN_0_R5_0.DMASS_Interrupt_aggregator_Global_events_count      = 512;
MAIN_0_R5_0.DMASS_Interrupt_aggregator_Virtual_interrupts_count = 14;

MAIN_0_R5_1.allocOrder                                          = 2;
MAIN_0_R5_1.Block_Copy_DMA_Block_copy_channels_count            = 6;
MAIN_0_R5_1.Block_Copy_DMA_Split_TR_Rx_channels_count           = 6;
MAIN_0_R5_1.Block_Copy_DMA_Split_TR_Tx_channels_count           = 6;
MAIN_0_R5_1.Packet_DMA_Free_Tx_channels_count                   = 3;
MAIN_0_R5_1.Packet_DMA_Free_Rx_channels_count                   = 3;
MAIN_0_R5_1.Packet_DMA_Rings_for_IPC_count                      = 2;
MAIN_0_R5_1.Compare_event_Interrupt_Router_count                = 4;
MAIN_0_R5_1.DMASS_Interrupt_aggregator_Virtual_interrupts_count = 14;
MAIN_0_R5_1.DMASS_Interrupt_aggregator_Global_events_count      = 256;

MAIN_0_R5_3.allocOrder                                          = 3;
MAIN_0_R5_3.Block_Copy_DMA_Block_copy_channels_count            = 2;
MAIN_0_R5_3.Block_Copy_DMA_Split_TR_Rx_channels_count           = 2;
MAIN_0_R5_3.Block_Copy_DMA_Split_TR_Tx_channels_count           = 2;
MAIN_0_R5_3.Packet_DMA_Free_Tx_channels_count                   = 2;
MAIN_0_R5_3.Packet_DMA_Free_Rx_channels_count                   = 2;
MAIN_0_R5_3.Packet_DMA_Rings_for_IPC_count                      = 2;
MAIN_0_R5_3.Compare_event_Interrupt_Router_count                = 4;
MAIN_0_R5_3.DMASS_Interrupt_aggregator_Virtual_interrupts_count = 14;
MAIN_0_R5_3.DMASS_Interrupt_aggregator_Global_events_count      = 192;

MAIN_1_R5_1.allocOrder                                          = 4;
MAIN_1_R5_1.Block_Copy_DMA_Block_copy_channels_count            = 4;
MAIN_1_R5_1.Block_Copy_DMA_Split_TR_Rx_channels_count           = 4;
MAIN_1_R5_1.Block_Copy_DMA_Split_TR_Tx_channels_count           = 4;
MAIN_1_R5_1.Packet_DMA_Free_Tx_channels_count                   = 4;
MAIN_1_R5_1.Packet_DMA_Free_Rx_channels_count                   = 4;
MAIN_1_R5_1.Packet_DMA_Rings_for_IPC_count                      = 2;
MAIN_1_R5_1.Compare_event_Interrupt_Router_count                = 4;
MAIN_1_R5_1.Main_GPIO_Interrupt_Router_count                    = 2;
MAIN_1_R5_1.DMASS_Interrupt_aggregator_Virtual_interrupts_count = 14;
MAIN_1_R5_1.DMASS_Interrupt_aggregator_Global_events_count      = 256;

MAIN_1_R5_3.allocOrder                                          = 5;
MAIN_1_R5_3.Block_Copy_DMA_Block_copy_channels_count            = 2;
MAIN_1_R5_3.Block_Copy_DMA_Split_TR_Rx_channels_count           = 2;
MAIN_1_R5_3.Block_Copy_DMA_Split_TR_Tx_channels_count           = 2;
MAIN_1_R5_3.Packet_DMA_Free_Tx_channels_count                   = 2;
MAIN_1_R5_3.Packet_DMA_Free_Rx_channels_count                   = 2;
MAIN_1_R5_3.Packet_DMA_Rings_for_IPC_count                      = 2;
MAIN_1_R5_3.Compare_event_Interrupt_Router_count                = 4;
MAIN_1_R5_3.Main_GPIO_Interrupt_Router_count                    = 2;
MAIN_1_R5_3.DMASS_Interrupt_aggregator_Virtual_interrupts_count = 14;
MAIN_1_R5_3.DMASS_Interrupt_aggregator_Global_events_count      = 192;

boardConfig1.$name   = "modules_boardConfig0";
boardConfig1.ramSize = 2;
