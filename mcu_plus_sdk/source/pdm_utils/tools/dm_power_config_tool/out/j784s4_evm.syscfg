/**
 * These arguments were used when this file was generated. They will be automatically applied on subsequent loads
 * via the GUI or CLI. Run CLI with '--help' for additional information on how to override these arguments.
 * @cliArgs --device "J784S4_TDA4AP_TDA4VP_TDA4AH_TDA4VH_AM69x" --package "ALY" --part "Default" --product "DM-Configuration-Tool@1.0.0-alpha"
 * @versions {"tool":"1.20.0+3587"}
 */

/**
 * Import the modules used in this configuration.
 */
const dm_power_config  = scripting.addModule("/dm_power_config_tool/dm_power_config", {}, false);
const dm_power_config1 = dm_power_config.addInstance();
const dm_power_config2 = dm_power_config.addInstance();
const dm_power_config3 = dm_power_config.addInstance();

/**
 * Write custom configuration values to the imported modules.
 */
dm_power_config1.$name = "BOARD_ECU_FC";

dm_power_config2.$name = "BOARD_ECU_SRV";

dm_power_config3.$name = "BOARD_ECU_AVP4";
