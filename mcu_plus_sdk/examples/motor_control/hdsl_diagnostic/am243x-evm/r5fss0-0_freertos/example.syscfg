/**
 * @cliArgs --device "AM243x_ALV_beta" --package "ALV" --part "ALV" --context "r5fss0-0" --product "MCU_PLUS_SDK_AM243x@08.03.00"
 * @versions {"tool":"1.13.0+2553"}
 */

/**
 * Import the modules used in this configuration.
 */
const gpio       = scripting.addModule("/drivers/gpio/gpio", {}, false);
const gpio1      = gpio.addInstance();
const i2c        = scripting.addModule("/drivers/i2c/i2c", {}, false);
const i2c1       = i2c.addInstance();
const pruicss    = scripting.addModule("/drivers/pruicss/pruicss", {}, false);
const pruicss1   = pruicss.addInstance();
const pruicss2   = pruicss.addInstance();
const debug_log  = scripting.addModule("/kernel/dpl/debug_log");
const mpu_armv7  = scripting.addModule("/kernel/dpl/mpu_armv7", {}, false);
const mpu_armv71 = mpu_armv7.addInstance();
const mpu_armv72 = mpu_armv7.addInstance();
const mpu_armv73 = mpu_armv7.addInstance();
const mpu_armv74 = mpu_armv7.addInstance();
const mpu_armv75 = mpu_armv7.addInstance();
const mpu_armv76 = mpu_armv7.addInstance();
const hdsl       = scripting.addModule("/motor_control/position_sense/hdsl", {}, false);
const hdsl1      = hdsl.addInstance();

/**
 * Write custom configuration values to the imported modules.
 */
gpio1.$name                = "CONFIG_GPIO0";
gpio1.GPIO.gpioPin.$assign = "ball.R20";

i2c1.$name       = "CONFIG_I2C0";
i2c1.I2C.$assign = "I2C1";

pruicss2.$name    = "CONFIG_PRU_ICSS1";
pruicss2.instance = "ICSSG1";

debug_log.enableCssLog  = false;
debug_log.enableUartLog = true;
debug_log.uartLog.$name = "CONFIG_UART0";

mpu_armv71.$name             = "CONFIG_MPU_REGION0";
mpu_armv71.size              = 31;
mpu_armv71.attributes        = "Device";
mpu_armv71.accessPermissions = "Supervisor RD+WR, User RD";

mpu_armv72.$name             = "CONFIG_MPU_REGION1";
mpu_armv72.accessPermissions = "Supervisor RD+WR, User RD";
mpu_armv72.size              = 15;

mpu_armv73.$name             = "CONFIG_MPU_REGION2";
mpu_armv73.size              = 15;
mpu_armv73.baseAddr          = 0x41010000;
mpu_armv73.accessPermissions = "Supervisor RD+WR, User RD";

mpu_armv74.$name             = "CONFIG_MPU_REGION3";
mpu_armv74.size              = 21;
mpu_armv74.baseAddr          = 0x70000000;
mpu_armv74.accessPermissions = "Supervisor RD+WR, User RD";

mpu_armv75.$name             = "CONFIG_MPU_REGION4";
mpu_armv75.size              = 28;
mpu_armv75.baseAddr          = 0x60000000;
mpu_armv75.accessPermissions = "Supervisor RD+WR, User RD";

mpu_armv76.$name    = "CONFIG_MPU_REGION5";
mpu_armv76.size     = 31;
mpu_armv76.baseAddr = 0x80000000;

hdsl1.$name                  = "CONFIG_HDSL0";
hdsl1.PRU_ICSSG0_PRU.$assign = "PRU_ICSSG0_PRU1";

pruicss1.$name = "CONFIG_PRU_ICSS0";
hdsl1.pru      = pruicss1;

/**
 * Pinmux solution for unlocked pins/peripherals. This ensures that minor changes to the automatic solver in a future
 * version of the tool will not impact the pinmux you originally saw.  These lines can be completely deleted in order to
 * re-solve from scratch.
 */
gpio1.GPIO.$suggestSolution                 = "GPIO0";
i2c1.I2C.SCL.$suggestSolution               = "ball.C18";
i2c1.I2C.SDA.$suggestSolution               = "ball.B19";
debug_log.uartLog.UART.$suggestSolution     = "USART0";
debug_log.uartLog.UART.RXD.$suggestSolution = "ball.D15";
debug_log.uartLog.UART.TXD.$suggestSolution = "ball.C16";
hdsl1.PRU_ICSSG0_PRU.GPO2.$suggestSolution  = "ball.V3";
hdsl1.PRU_ICSSG0_PRU.GPO1.$suggestSolution  = "ball.W2";
hdsl1.PRU_ICSSG0_PRU.GPO0.$suggestSolution  = "ball.Y2";
hdsl1.PRU_ICSSG0_PRU.GPI13.$suggestSolution = "ball.T6";
hdsl1.PRU_ICSSG0_PRU.GPO5.$suggestSolution  = "ball.P4";
hdsl1.PRU_ICSSG0_PRU.GPO4.$suggestSolution  = "ball.W3";
hdsl1.PRU_ICSSG0_PRU.GPO3.$suggestSolution  = "ball.T4";
hdsl1.PRU_ICSSG0_PRU.GPI14.$suggestSolution = "ball.U6";
hdsl1.PRU_ICSSG0_PRU.GPO8.$suggestSolution  = "ball.R1";
hdsl1.PRU_ICSSG0_PRU.GPO12.$suggestSolution = "ball.Y4";
hdsl1.PRU_ICSSG0_PRU.GPO6.$suggestSolution  = "ball.R5";
hdsl1.PRU_ICSSG0_PRU.GPI11.$suggestSolution = "ball.W4";
