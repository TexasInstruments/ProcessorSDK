/**
 * @cliArgs --device "AM243x_ALV_beta" --package "ALV" --part "ALV" --context "r5fss0-0" --product "MCU_PLUS_SDK_AM243x@08.03.00"
 * @versions {"tool":"1.13.0+2553"}
 */

/**
 * Import the modules used in this configuration.
 */
const i2c        = scripting.addModule("/drivers/i2c/i2c", {}, false);
const i2c1       = i2c.addInstance();
const uart       = scripting.addModule("/drivers/uart/uart", {}, false);
const uart1      = uart.addInstance();
const mpu_armv7  = scripting.addModule("/kernel/dpl/mpu_armv7", {}, false);
const mpu_armv71 = mpu_armv7.addInstance();
const mpu_armv72 = mpu_armv7.addInstance();
const mpu_armv73 = mpu_armv7.addInstance();
const mpu_armv74 = mpu_armv7.addInstance();
const mpu_armv75 = mpu_armv7.addInstance();
const mpu_armv76 = mpu_armv7.addInstance();
const tamagawa   = scripting.addModule("/motor_control/position_sense/tamagawa", {}, false);
const tamagawa1  = tamagawa.addInstance();

/**
 * Write custom configuration values to the imported modules.
 */
i2c1.$name = "CONFIG_I2C0";

uart1.$name        = "CONFIG_UART0";
uart1.UART.$assign = "USART0";

mpu_armv71.$name             = "CONFIG_MPU_REGION0";
mpu_armv71.size              = 31;
mpu_armv71.accessPermissions = "Supervisor RD+WR, User RD";
mpu_armv71.attributes        = "Device";
mpu_armv71.allowExecute      = false;

mpu_armv72.$name             = "CONFIG_MPU_REGION1";
mpu_armv72.size              = 15;
mpu_armv72.accessPermissions = "Supervisor RD+WR, User RD";

mpu_armv73.$name             = "CONFIG_MPU_REGION2";
mpu_armv73.baseAddr          = 0x41010000;
mpu_armv73.size              = 15;
mpu_armv73.accessPermissions = "Supervisor RD+WR, User RD";

mpu_armv74.$name             = "CONFIG_MPU_REGION3";
mpu_armv74.size              = 21;
mpu_armv74.accessPermissions = "Supervisor RD+WR, User RD";

mpu_armv75.$name             = "CONFIG_MPU_REGION4";
mpu_armv75.baseAddr          = 0x60000000;
mpu_armv75.size              = 28;
mpu_armv75.accessPermissions = "Supervisor RD, User RD";

mpu_armv76.$name    = "CONFIG_MPU_REGION5";
mpu_armv76.size     = 31;
mpu_armv76.baseAddr = 0x80000000;

tamagawa1.$name                     = "CONFIG_TAMAGAWA0";
tamagawa1.PRU_ICSSG0_UART.RXD.$used = true;
tamagawa1.PRU_ICSSG0_UART.TXD.$used = true;

const pruicss  = scripting.addModule("/drivers/pruicss/pruicss", {}, false);
const pruicss1 = pruicss.addInstance({}, false);
pruicss1.$name = "CONFIG_PRU_ICSS0";
tamagawa1.pru  = pruicss1;

/**
 * Pinmux solution for unlocked pins/peripherals. This ensures that minor changes to the automatic solver in a future
 * version of the tool will not impact the pinmux you originally saw.  These lines can be completely deleted in order to
 * re-solve from scratch.
 */
i2c1.I2C.$suggestSolution                      = "I2C1";
i2c1.I2C.SCL.$suggestSolution                  = "ball.C18";
i2c1.I2C.SDA.$suggestSolution                  = "ball.B19";
uart1.UART.RXD.$suggestSolution                = "ball.D15";
uart1.UART.TXD.$suggestSolution                = "ball.C16";
tamagawa1.PRU_ICSSG0_UART.$suggestSolution     = "PRU_ICSSG0_UART0";
tamagawa1.PRU_ICSSG0_UART.RXD.$suggestSolution = "ball.Y5";
tamagawa1.PRU_ICSSG0_UART.TXD.$suggestSolution = "ball.V6";
