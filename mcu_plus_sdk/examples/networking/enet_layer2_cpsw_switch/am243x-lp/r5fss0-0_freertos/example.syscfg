/**
 * @cliArgs --device "AM243x_ALX_beta" --package "ALX" --part "ALX" --context "r5fss0-0" --product "MCU_PLUS_SDK@07.03.01"
 * @versions {"tool":"1.12.1+2446"}
 */

/**
 * Import the modules used in this configuration.
 */
const gpio       = scripting.addModule("/drivers/gpio/gpio", {}, false);
const gpio1      = gpio.addInstance();
const pruicss    = scripting.addModule("/drivers/pruicss/pruicss", {}, false);
const pruicss1   = pruicss.addInstance();
const debug_log  = scripting.addModule("/kernel/dpl/debug_log");
const mpu_armv7  = scripting.addModule("/kernel/dpl/mpu_armv7", {}, false);
const mpu_armv71 = mpu_armv7.addInstance();
const mpu_armv72 = mpu_armv7.addInstance();
const mpu_armv73 = mpu_armv7.addInstance();
const mpu_armv74 = mpu_armv7.addInstance();
const mpu_armv75 = mpu_armv7.addInstance();
const mpu_armv76 = mpu_armv7.addInstance();
const enet_cpsw  = scripting.addModule("/networking/enet_cpsw/enet_cpsw", {}, false);
const enet_cpsw1 = enet_cpsw.addInstance();
const enet_cpsw2 = enet_cpsw.addInstance();

/**
 * Write custom configuration values to the imported modules.
 */
gpio1.$name                = "CONFIG_GPIO0";
gpio1.pinDir               = "OUTPUT";
gpio1.GPIO.gpioPin.$assign = "ball.AA11";

pruicss1.$name = "CONFIG_PRU_ICSS0";

debug_log.enableUartLog        = true;
debug_log.enableCssLog         = false;
debug_log.uartLog.$name        = "CONFIG_UART0";
debug_log.uartLog.UART.$assign = "USART0";

mpu_armv71.$name             = "CONFIG_MPU_REGION0";
mpu_armv71.size              = 31;
mpu_armv71.attributes        = "Device";
mpu_armv71.accessPermissions = "Supervisor RD+WR, User RD";
mpu_armv71.allowExecute      = false;

mpu_armv72.$name             = "CONFIG_MPU_REGION1";
mpu_armv72.size              = 15;
mpu_armv72.accessPermissions = "Supervisor RD+WR, User RD";

mpu_armv73.$name             = "CONFIG_MPU_REGION2";
mpu_armv73.baseAddr          = 0x41010000;
mpu_armv73.size              = 15;
mpu_armv73.accessPermissions = "Supervisor RD+WR, User RD";

mpu_armv74.$name             = "CONFIG_MPU_REGION3";
mpu_armv74.accessPermissions = "Supervisor RD+WR, User RD";
mpu_armv74.baseAddr          = 0x70000000;
mpu_armv74.size              = 23;

mpu_armv75.$name             = "CONFIG_MPU_REGION5";
mpu_armv75.accessPermissions = "Supervisor RD+WR, User RD";
mpu_armv75.baseAddr          = 0xA5000000;
mpu_armv75.size              = 23;
mpu_armv75.attributes        = "NonCached";

mpu_armv76.$name    = "CONFIG_MPU_REGION6";
mpu_armv76.size     = 27;
mpu_armv76.baseAddr = 0x60000000;

enet_cpsw1.$name                           = "CONFIG_ENET_CPSW0";
enet_cpsw1.phyAddr1                        = 3;
enet_cpsw1.phyAddr2                        = 15;
enet_cpsw1.txDmaChannel[0].$name           = "ENET_DMA_TX_CH0";
enet_cpsw1.rxDmaChannel[0].$name           = "ENET_DMA_RX_CH0";
enet_cpsw1.pinmux[0].$name                 = "ENET_CPSW_PINMUX0";
enet_cpsw1.pinmux[0].phyToMacInterfaceMode = "RGMII";
enet_cpsw1.pinmux[0].RGMII.$assign         = "RGMII1";
enet_cpsw1.pinmux[0].RGMII.RD0.$assign     = "ball.T5";
enet_cpsw1.pinmux[0].RGMII.RD1.$assign     = "ball.R2";
enet_cpsw1.pinmux[0].RGMII.RD2.$assign     = "ball.U2";
enet_cpsw1.pinmux[0].RGMII.RD3.$assign     = "ball.T1";
enet_cpsw1.pinmux[0].RGMII.RX_CTL.$assign  = "ball.Y3";
enet_cpsw1.pinmux[0].RGMII.RXC.$assign     = "ball.U1";
enet_cpsw1.pinmux[0].RGMII.TD0.$assign     = "ball.Y14";
enet_cpsw1.pinmux[0].RGMII.TD1.$assign     = "ball.Y16";
enet_cpsw1.pinmux[0].RGMII.TD2.$assign     = "ball.U13";
enet_cpsw1.pinmux[0].RGMII.TD3.$assign     = "ball.AA14";
enet_cpsw1.pinmux[0].RGMII.TX_CTL.$assign  = "ball.W16";
enet_cpsw1.pinmux[0].RGMII.TXC.$assign     = "ball.W13";

enet_cpsw2.$name                           = "CONFIG_ENET_CPSW1";
enet_cpsw2.txDmaChannel[0].$name           = "ENET_DMA_TX_CH1";
enet_cpsw2.rxDmaChannel[0].$name           = "ENET_DMA_RX_CH1";
enet_cpsw2.pinmux[0].$name                 = "ENET_CPSW_PINMUX1";
enet_cpsw2.pinmux[0].phyToMacInterfaceMode = "RGMII";

const udma         = scripting.addModule("/drivers/udma/udma", {}, false);
const udma1        = udma.addInstance({}, false);
enet_cpsw1.udmaDrv = udma1;
enet_cpsw2.udmaDrv = udma1;

/**
 * Pinmux solution for unlocked pins/peripherals. This ensures that minor changes to the automatic solver in a future
 * version of the tool will not impact the pinmux you originally saw.  These lines can be completely deleted in order to
 * re-solve from scratch.
 */
gpio1.GPIO.$suggestSolution                        = "GPIO0";
debug_log.uartLog.UART.RXD.$suggestSolution        = "ball.B10";
debug_log.uartLog.UART.TXD.$suggestSolution        = "ball.B11";
enet_cpsw2.pinmux[0].RGMII.$suggestSolution        = "RGMII2";
enet_cpsw2.pinmux[0].RGMII.RD0.$suggestSolution    = "ball.AA10";
enet_cpsw2.pinmux[0].RGMII.RD1.$suggestSolution    = "ball.Y10";
enet_cpsw2.pinmux[0].RGMII.RD2.$suggestSolution    = "ball.Y11";
enet_cpsw2.pinmux[0].RGMII.RD3.$suggestSolution    = "ball.V12";
enet_cpsw2.pinmux[0].RGMII.RX_CTL.$suggestSolution = "ball.Y12";
enet_cpsw2.pinmux[0].RGMII.RXC.$suggestSolution    = "ball.V10";
enet_cpsw2.pinmux[0].RGMII.TD0.$suggestSolution    = "ball.Y6";
enet_cpsw2.pinmux[0].RGMII.TD1.$suggestSolution    = "ball.AA8";
enet_cpsw2.pinmux[0].RGMII.TD2.$suggestSolution    = "ball.Y9";
enet_cpsw2.pinmux[0].RGMII.TD3.$suggestSolution    = "ball.W9";
enet_cpsw2.pinmux[0].RGMII.TX_CTL.$suggestSolution = "ball.V9";
enet_cpsw2.pinmux[0].RGMII.TXC.$suggestSolution    = "ball.Y8";
