/**
 * @cliArgs --device "AM263x_beta" --package "ZCZ" --part "AM263x" --context "r5fss0-1" --product "MCU_PLUS_SDK@07.03.01"
 * @versions {"tool":"1.12.1+2446"}
 */

/**
 * Import the modules used in this configuration.
 */
const eeprom     = scripting.addModule("/board/eeprom/eeprom", {}, false);
const eeprom1    = eeprom.addInstance();
const i2c        = scripting.addModule("/drivers/i2c/i2c", {}, false);
const i2c1       = i2c.addInstance();
const debug_log  = scripting.addModule("/kernel/dpl/debug_log");
const mpu_armv7  = scripting.addModule("/kernel/dpl/mpu_armv7", {}, false);
const mpu_armv71 = mpu_armv7.addInstance();
const mpu_armv72 = mpu_armv7.addInstance();
const mpu_armv73 = mpu_armv7.addInstance();
const mpu_armv74 = mpu_armv7.addInstance();
const enet_cpsw  = scripting.addModule("/networking/enet_cpsw/enet_cpsw", {}, false);
const enet_cpsw1 = enet_cpsw.addInstance();

/**
 * Write custom configuration values to the imported modules.
 */
eeprom1.$name = "CONFIG_EEPROM0";

i2c1.$name               = "CONFIG_I2C0";
eeprom1.peripheralDriver = i2c1;
i2c1.I2C.$assign         = "I2C0";

debug_log.enableUartLog            = true;
debug_log.enableCssLog             = false;
debug_log.uartLog.$name            = "CONFIG_UART0";
debug_log.uartLog.UART.$assign     = "UART0";
debug_log.uartLog.UART.RXD.$assign = "ball.A7";
debug_log.uartLog.UART.TXD.$assign = "ball.A6";

mpu_armv71.$name             = "CONFIG_MPU_REGION0";
mpu_armv71.size              = 31;
mpu_armv71.attributes        = "Device";
mpu_armv71.accessPermissions = "Supervisor RD+WR, User RD";
mpu_armv71.allowExecute      = false;

mpu_armv72.$name             = "CONFIG_MPU_REGION1";
mpu_armv72.size              = 15;
mpu_armv72.accessPermissions = "Supervisor RD+WR, User RD";

mpu_armv73.$name             = "CONFIG_MPU_REGION2";
mpu_armv73.baseAddr          = 0x80000;
mpu_armv73.size              = 15;
mpu_armv73.accessPermissions = "Supervisor RD+WR, User RD";

mpu_armv74.$name             = "CONFIG_MPU_REGION3";
mpu_armv74.accessPermissions = "Supervisor RD+WR, User RD";
mpu_armv74.baseAddr          = 0x70000000;
mpu_armv74.size              = 21;

enet_cpsw1.$name                           = "CONFIG_ENET_CPSW0";
enet_cpsw1.phyAddr2                        = 3;
enet_cpsw1.DisableMacPort2                 = true;
enet_cpsw1.LargePoolPktCount               = 96;
enet_cpsw1.txDmaChannel.create(2);
enet_cpsw1.txDmaChannel[0].$name           = "ENET_DMA_TX_CH0";
enet_cpsw1.txDmaChannel[1].$name           = "ENET_DMA_TX_CH_PTP";
enet_cpsw1.rxDmaChannel.create(2);
enet_cpsw1.rxDmaChannel[0].$name           = "ENET_DMA_RX_CH0";
enet_cpsw1.rxDmaChannel[1].$name           = "ENET_DMA_RX_CH_PTP";
enet_cpsw1.rxDmaChannel[1].AllocMacAddr    = false;
enet_cpsw1.pinmux[0].$name                 = "ENET_CPSW_PINMUX0";
enet_cpsw1.pinmux[0].phyToMacInterfaceMode = "RGMII";
enet_cpsw1.pinmux[0].RGMII.$assign         = "RGMII1";
enet_cpsw1.pinmux[0].RGMII.RD0.$assign     = "ball.U17";
enet_cpsw1.pinmux[0].RGMII.RD1.$assign     = "ball.T17";
enet_cpsw1.pinmux[0].RGMII.RD2.$assign     = "ball.U18";
enet_cpsw1.pinmux[0].RGMII.RD3.$assign     = "ball.T18";
enet_cpsw1.pinmux[0].RGMII.RX_CTL.$assign  = "ball.R18";
enet_cpsw1.pinmux[0].RGMII.RXC.$assign     = "ball.R17";
enet_cpsw1.pinmux[0].RGMII.TD0.$assign     = "ball.P16";
enet_cpsw1.pinmux[0].RGMII.TD1.$assign     = "ball.P17";
enet_cpsw1.pinmux[0].RGMII.TD2.$assign     = "ball.P18";
enet_cpsw1.pinmux[0].RGMII.TD3.$assign     = "ball.N17";
enet_cpsw1.pinmux[0].RGMII.TX_CTL.$assign  = "ball.M18";
enet_cpsw1.pinmux[0].RGMII.TXC.$assign     = "ball.N18";

/**
 * Pinmux solution for unlocked pins/peripherals. This ensures that minor changes to the automatic solver in a future
 * version of the tool will not impact the pinmux you originally saw.  These lines can be completely deleted in order to
 * re-solve from scratch.
 */
i2c1.I2C.SCL.$suggestSolution = "ball.A13";
i2c1.I2C.SDA.$suggestSolution = "ball.B13";
